/dts-v1/;

/ {
	compatible = "rockchip,rk3399-eaidk-android", "rockchip,rk3399";
	interrupt-parent = <0x1>;
	#address-cells = <0x2>;
	#size-cells = <0x2>;

	ddr_timing: ddr_timing {
		compatible = "rockchip,ddr-timing";
		ddr3_speed_bin = <0x15>;
		pd_idle = <0x0>;
		sr_idle = <0x0>;
		sr_mc_gate_idle = <0x0>;
		srpd_lite_idle = <0x0>;
		standby_idle = <0x0>;
		auto_lp_dis_freq = <0x29a>;
		ddr3_dll_dis_freq = <0x12c>;
		phy_dll_dis_freq = <0x104>;
		ddr3_odt_dis_freq = <0x29a>;
		ddr3_drv = <0x28>;
		ddr3_odt = <0x78>;
		phy_ddr3_ca_drv = <0x28>;
		phy_ddr3_dq_drv = <0x28>;
		phy_ddr3_odt = <0xf0>;
		lpddr3_odt_dis_freq = <0x29a>;
		lpddr3_drv = <0x22>;
		lpddr3_odt = <0xf0>;
		phy_lpddr3_ca_drv = <0x22>;
		phy_lpddr3_dq_drv = <0x22>;
		phy_lpddr3_odt = <0xf0>;
		lpddr4_odt_dis_freq = <0x320>;
		lpddr4_drv = <0xf0>;
		lpddr4_dq_odt = <0x28>;
		lpddr4_ca_odt = <0x0>;
		phy_lpddr4_ca_drv = <0x28>;
		phy_lpddr4_ck_cs_drv = <0x28>;
		phy_lpddr4_dq_drv = <0x3c>;
		phy_lpddr4_odt = <0x28>;
		phandle = <0x8d>;
	};

	aliases {
		i2c0 = "/i2c@ff3c0000";
		i2c1 = "/i2c@ff110000";
		i2c2 = "/i2c@ff120000";
		i2c3 = "/i2c@ff130000";
		i2c4 = "/i2c@ff3d0000";
		i2c5 = "/i2c@ff140000";
		i2c6 = "/i2c@ff150000";
		i2c7 = "/i2c@ff160000";
		i2c8 = "/i2c@ff3e0000";
		serial0 = "/serial@ff180000";
		serial1 = "/serial@ff190000";
		serial2 = "/serial@ff1a0000";
		serial3 = "/serial@ff1b0000";
		serial4 = "/serial@ff370000";
		dsi0 = "/dsi@ff960000";
		dsi1 = "/dsi@ff968000";
		ddr_timing = "/ddr_timing";
		cpu_l0 = "/cpus/cpu@0";
		cpu_l1 = "/cpus/cpu@1";
		cpu_l2 = "/cpus/cpu@2";
		cpu_l3 = "/cpus/cpu@3";
		cpu_b0 = "/cpus/cpu@100";
		cpu_b1 = "/cpus/cpu@101";
		CPU_SLEEP = "/cpus/idle-states/cpu-sleep";
		CLUSTER_SLEEP = "/cpus/idle-states/cluster-sleep";
		xin24m = "/xin24m";
		dummy_cpll = "/dummy_cpll";
		dummy_vpll = "/dummy_vpll";
		dmac_bus = "/amba/dma-controller@ff6d0000";
		dmac_peri = "/amba/dma-controller@ff6e0000";
		gmac = "/ethernet@fe300000";
		sdio0 = "/dwmmc@fe310000";
		sdmmc = "/dwmmc@fe320000";
		sdhci = "/sdhci@fe330000";
		usb_host0_ehci = "/usb@fe380000";
		usb_host0_ohci = "/usb@fe3a0000";
		usb_host1_ehci = "/usb@fe3c0000";
		usb_host1_ohci = "/usb@fe3e0000";
		usbdrd3_0 = "/usb@fe800000";
		usbdrd_dwc3_0 = "/usb@fe800000/dwc3@fe800000";
		usbdrd3_1 = "/usb@fe900000";
		usbdrd_dwc3_1 = "/usb@fe900000/dwc3@fe900000";
		cdn_dp = "/dp@fec00000";
		dp_in = "/dp@fec00000/ports/port";
		dp_in_vopb = "/dp@fec00000/ports/port/endpoint@0";
		dp_in_vopl = "/dp@fec00000/ports/port/endpoint@1";
		gic = "/interrupt-controller@fee00000";
		its = "/interrupt-controller@fee00000/interrupt-controller@fee20000";
		ppi_cluster0 = "/interrupt-controller@fee00000/ppi-partitions/interrupt-partition-0";
		ppi_cluster1 = "/interrupt-controller@fee00000/ppi-partitions/interrupt-partition-1";
		saradc = "/saradc@ff100000";
		vdd_cpu_b = "/i2c@ff3c0000/syr827@40";
		vdd_gpu = "/i2c@ff3c0000/syr828@41";
		rk808 = "/i2c@ff3c0000/pmic@1b";
		vdd_center = "/i2c@ff3c0000/pmic@1b/regulators/DCDC_REG1";
		vdd_cpu_l = "/i2c@ff3c0000/pmic@1b/regulators/DCDC_REG2";
		vcc_ddr = "/i2c@ff3c0000/pmic@1b/regulators/DCDC_REG3";
		vcc_1v8 = "/i2c@ff3c0000/pmic@1b/regulators/DCDC_REG4";
		vcc1v8_dvp = "/i2c@ff3c0000/pmic@1b/regulators/LDO_REG1";
		vcc_avdd_2v8 = "/i2c@ff3c0000/pmic@1b/regulators/LDO_REG2";
		vcc1v8_pmupll = "/i2c@ff3c0000/pmic@1b/regulators/LDO_REG3";
		vcc_sdio = "/i2c@ff3c0000/pmic@1b/regulators/LDO_REG4";
		vcca3v0_codec = "/i2c@ff3c0000/pmic@1b/regulators/LDO_REG5";
		vcc_1v5 = "/i2c@ff3c0000/pmic@1b/regulators/LDO_REG6";
		vcca1v8_codec = "/i2c@ff3c0000/pmic@1b/regulators/LDO_REG7";
		vcc_3v0 = "/i2c@ff3c0000/pmic@1b/regulators/LDO_REG8";
		vcc3v3_s3 = "/i2c@ff3c0000/pmic@1b/regulators/SWITCH_REG1";
		vcc3v3_s0 = "/i2c@ff3c0000/pmic@1b/regulators/SWITCH_REG2";
		rt5651 = "/i2c@ff110000/rt5651@1a";
		es7243 = "/i2c@ff110000/es7243@13";
		ina219x41c2 = "/i2c@ff120000/ina219@41";
		ina219x47c6 = "/i2c@ff150000/ina219@47";
		ina219x40c7 = "/i2c@ff160000/ina219@40";
		uart0 = "/serial@ff180000";
		uart1 = "/serial@ff190000";
		uart2 = "/serial@ff1a0000";
		uart3 = "/serial@ff1b0000";
		spi0 = "/spi@ff1c0000";
		spi1 = "/spi@ff1d0000";
		spi2 = "/spi@ff1e0000";
		spi4 = "/spi@ff1f0000";
		spi5 = "/spi@ff200000";
		thermal_zones = "/thermal-zones";
		soc_thermal = "/thermal-zones/soc-thermal";
		threshold = "/thermal-zones/soc-thermal/trips/trip-point-0";
		target = "/thermal-zones/soc-thermal/trips/trip-point-1";
		soc_crit = "/thermal-zones/soc-thermal/trips/soc-crit";
		gpu_thermal = "/thermal-zones/gpu-thermal";
		tsadc = "/tsadc@ff260000";
		qos_emmc = "/qos@ffa58000";
		qos_gmac = "/qos@ffa5c000";
		qos_pcie = "/qos@ffa60080";
		qos_usb_host0 = "/qos@ffa60100";
		qos_usb_host1 = "/qos@ffa60180";
		qos_usb_otg0 = "/qos@ffa70000";
		qos_usb_otg1 = "/qos@ffa70080";
		qos_sd = "/qos@ffa74000";
		qos_sdioaudio = "/qos@ffa76000";
		qos_hdcp = "/qos@ffa90000";
		qos_iep = "/qos@ffa98000";
		qos_isp0_m0 = "/qos@ffaa0000";
		qos_isp0_m1 = "/qos@ffaa0080";
		qos_isp1_m0 = "/qos@ffaa8000";
		qos_isp1_m1 = "/qos@ffaa8080";
		qos_rga_r = "/qos@ffab0000";
		qos_rga_w = "/qos@ffab0080";
		qos_video_m0 = "/qos@ffab8000";
		qos_video_m1_r = "/qos@ffac0000";
		qos_video_m1_w = "/qos@ffac0080";
		qos_vop_big_r = "/qos@ffac8000";
		qos_vop_big_w = "/qos@ffac8080";
		qos_vop_little = "/qos@ffad0000";
		qos_perihp = "/qos@ffad8080";
		qos_gpu = "/qos@ffae0000";
		pmu = "/power-management@ff310000";
		power = "/power-management@ff310000/power-controller";
		pmugrf = "/syscon@ff320000";
		pmu_io_domains = "/syscon@ff320000/io-domains";
		pmu_pvtm = "/syscon@ff320000/pmu-pvtm";
		spi3 = "/spi@ff350000";
		uart4 = "/serial@ff370000";
		fusb0 = "/i2c@ff3d0000/fusb30x@22";
		gt1x = "/i2c@ff3d0000/gt1x@14";
		pcie_phy = "/pcie-phy";
		pcie0 = "/pcie@f8000000";
		pcie0_intc = "/pcie@f8000000/interrupt-controller";
		pwm0 = "/pwm@ff420000";
		pwm1 = "/pwm@ff420010";
		pwm2 = "/pwm@ff420020";
		pwm3 = "/pwm@ff420030";
		dfi = "/dfi@ff630000";
		dmc = "/dmc";
		vpu = "/vpu_service@ff650000";
		vpu_mmu = "/iommu@ff650800";
		rkvdec = "/rkvdec@ff660000";
		vdec_mmu = "/iommu@ff660480";
		iep = "/iep@ff670000";
		iep_mmu = "/iommu@ff670800";
		rga = "/rga@ff680000";
		efuse0 = "/efuse@ff690000";
		efuse_id = "/efuse@ff690000/id@7";
		cpub_leakage = "/efuse@ff690000/cpub-leakage@17";
		gpu_leakage = "/efuse@ff690000/gpu-leakage@18";
		center_leakage = "/efuse@ff690000/center-leakage@19";
		cpul_leakage = "/efuse@ff690000/cpul-leakage@1a";
		logic_leakage = "/efuse@ff690000/logic-leakage@1b";
		wafer_info = "/efuse@ff690000/wafer-info@1c";
		pmucru = "/pmu-clock-controller@ff750000";
		cru = "/clock-controller@ff760000";
		grf = "/syscon@ff770000";
		io_domains = "/syscon@ff770000/io-domains";
		emmc_phy = "/syscon@ff770000/phy@f780";
		u2phy0 = "/syscon@ff770000/usb2-phy@e450";
		u2phy0_otg = "/syscon@ff770000/usb2-phy@e450/otg-port";
		u2phy0_host = "/syscon@ff770000/usb2-phy@e450/host-port";
		u2phy1 = "/syscon@ff770000/usb2-phy@e460";
		u2phy1_otg = "/syscon@ff770000/usb2-phy@e460/otg-port";
		u2phy1_host = "/syscon@ff770000/usb2-phy@e460/host-port";
		mipi_dphy_rx0 = "/syscon@ff770000/mipi-dphy-rx0";
		pvtm = "/syscon@ff770000/pvtm";
		tcphy0 = "/phy@ff7c0000";
		tcphy0_dp = "/phy@ff7c0000/dp-port";
		tcphy0_usb3 = "/phy@ff7c0000/usb3-port";
		tcphy1 = "/phy@ff800000";
		tcphy1_dp = "/phy@ff800000/dp-port";
		tcphy1_usb3 = "/phy@ff800000/usb3-port";
		rktimer = "/rktimer@ff850000";
		spdif = "/spdif@ff870000";
		i2s0 = "/i2s@ff880000";
		i2s1 = "/i2s@ff890000";
		i2s2 = "/i2s@ff8a0000";
		gpu = "/gpu@ff9a0000";
		gpu_power_model = "/gpu@ff9a0000/power_model";
		vopl = "/vop@ff8f0000";
		vopl_out = "/vop@ff8f0000/port";
		vopl_out_dsi = "/vop@ff8f0000/port/endpoint@0";
		vopl_out_edp = "/vop@ff8f0000/port/endpoint@1";
		vopl_out_hdmi = "/vop@ff8f0000/port/endpoint@2";
		vopl_out_dp = "/vop@ff8f0000/port/endpoint@3";
		vopl_out_dsi1 = "/vop@ff8f0000/port/endpoint@4";
		vop1_pwm = "/voppwm@ff8f01a0";
		vopl_mmu = "/iommu@ff8f3f00";
		vopb = "/vop@ff900000";
		vopb_out = "/vop@ff900000/port";
		vopb_out_edp = "/vop@ff900000/port/endpoint@0";
		vopb_out_dsi = "/vop@ff900000/port/endpoint@1";
		vopb_out_hdmi = "/vop@ff900000/port/endpoint@2";
		vopb_out_dp = "/vop@ff900000/port/endpoint@3";
		vopb_out_dsi1 = "/vop@ff900000/port/endpoint@4";
		vop0_pwm = "/voppwm@ff9001a0";
		vopb_mmu = "/iommu@ff903f00";
		rkisp1_0 = "/rkisp1@ff910000";
		isp0_mmu = "/iommu@ff914000";
		rkisp1_1 = "/rkisp1@ff920000";
		isp1_mmu = "/iommu@ff924000";
		hdmi = "/hdmi@ff940000";
		hdmi_in = "/hdmi@ff940000/ports/port";
		hdmi_in_vopb = "/hdmi@ff940000/ports/port/endpoint@0";
		hdmi_in_vopl = "/hdmi@ff940000/ports/port/endpoint@1";
		dsi = "/dsi@ff960000";
		dsi_in_vopb = "/dsi@ff960000/ports/port/endpoint@0";
		dsi_in_vopl = "/dsi@ff960000/ports/port/endpoint@1";
		timing0 = "/dsi@ff960000/panel@0/display-timings/timing0";
		dsi1_in_vopb = "/dsi@ff968000/ports/port/endpoint@0";
		dsi1_in_vopl = "/dsi@ff968000/ports/port/endpoint@1";
		mipi_dphy_tx1rx1 = "/mipi-dphy-tx1rx1@0xff968000";
		edp = "/edp@ff970000";
		edp_in = "/edp@ff970000/ports/port@0";
		edp_in_vopb = "/edp@ff970000/ports/port@0/endpoint@0";
		edp_in_vopl = "/edp@ff970000/ports/port@0/endpoint@1";
		hdmi_hdcp2 = "/hdmi-hdcp2@ff988000";
		display_subsystem = "/display-subsystem";
		route_hdmi = "/display-subsystem/route/route-hdmi";
		route_dsi = "/display-subsystem/route/route-dsi";
		route_dsi1 = "/display-subsystem/route/route-dsi1";
		route_edp = "/display-subsystem/route/route-edp";
		nocp_cci_msch0 = "/nocp-cci-msch0@ffa86000";
		nocp_gpu_msch0 = "/nocp-gpu-msch0@ffa86400";
		nocp_hp_msch0 = "/nocp-hp-msch0@ffa86800";
		nocp_lp_msch0 = "/nocp-lp-msch0@ffa86c00";
		nocp_video_msch0 = "/nocp-video-msch0@ffa87000";
		nocp_vio0_msch0 = "/nocp-vio0-msch0@ffa87400";
		nocp_vio1_msch0 = "/nocp-vio1-msch0@ffa87800";
		nocp_cci_msch1 = "/nocp-cci-msch1@ffa8e000";
		nocp_gpu_msch1 = "/nocp-gpu-msch1@ffa8e400";
		nocp_hp_msch1 = "/nocp-hp-msch1@ffa8e800";
		nocp_lp_msch1 = "/nocp-lp-msch1@ffa8ec00";
		nocp_video_msch1 = "/nocp-video-msch1@ffa8f000";
		nocp_vio0_msch1 = "/nocp-vio0-msch1@ffa8f400";
		nocp_vio1_msch1 = "/nocp-vio1-msch1@ffa8f800";
		pinctrl = "/pinctrl";
		gpio0 = "/pinctrl/gpio0@ff720000";
		gpio1 = "/pinctrl/gpio1@ff730000";
		gpio2 = "/pinctrl/gpio2@ff780000";
		gpio3 = "/pinctrl/gpio3@ff788000";
		gpio4 = "/pinctrl/gpio4@ff790000";
		pcfg_pull_up = "/pinctrl/pcfg-pull-up";
		pcfg_pull_down = "/pinctrl/pcfg-pull-down";
		pcfg_pull_none = "/pinctrl/pcfg-pull-none";
		pcfg_pull_up_20ma = "/pinctrl/pcfg-pull-up-20ma";
		pcfg_pull_none_20ma = "/pinctrl/pcfg-pull-none-20ma";
		pcfg_pull_none_18ma = "/pinctrl/pcfg-pull-none-18ma";
		pcfg_pull_none_12ma = "/pinctrl/pcfg-pull-none-12ma";
		pcfg_pull_up_8ma = "/pinctrl/pcfg-pull-up-8ma";
		pcfg_pull_down_4ma = "/pinctrl/pcfg-pull-down-4ma";
		pcfg_pull_up_2ma = "/pinctrl/pcfg-pull-up-2ma";
		pcfg_pull_down_12ma = "/pinctrl/pcfg-pull-down-12ma";
		pcfg_pull_none_13ma = "/pinctrl/pcfg-pull-none-13ma";
		pcfg_output_high = "/pinctrl/pcfg-output-high";
		pcfg_output_low = "/pinctrl/pcfg-output-low";
		pcfg_input = "/pinctrl/pcfg-input";
		emmc_pwr = "/pinctrl/emmc/emmc-pwr";
		rgmii_pins = "/pinctrl/gmac/rgmii-pins";
		rmii_pins = "/pinctrl/gmac/rmii-pins";
		i2c0_xfer = "/pinctrl/i2c0/i2c0-xfer";
		i2c1_xfer = "/pinctrl/i2c1/i2c1-xfer";
		i2c2_xfer = "/pinctrl/i2c2/i2c2-xfer";
		i2c3_xfer = "/pinctrl/i2c3/i2c3-xfer";
		i2c3_gpio = "/pinctrl/i2c3/i2c3_gpio";
		i2c4_xfer = "/pinctrl/i2c4/i2c4-xfer";
		i2c5_xfer = "/pinctrl/i2c5/i2c5-xfer";
		i2c6_xfer = "/pinctrl/i2c6/i2c6-xfer";
		i2c7_xfer = "/pinctrl/i2c7/i2c7-xfer";
		i2c8_xfer = "/pinctrl/i2c8/i2c8-xfer";
		i2s0_8ch_bus = "/pinctrl/i2s0/i2s0-8ch-bus";
		i2s_8ch_mclk = "/pinctrl/i2s0/i2s-8ch-mclk";
		i2s1_2ch_bus = "/pinctrl/i2s1/i2s1-2ch-bus";
		sdio0_bus1 = "/pinctrl/sdio0/sdio0-bus1";
		sdio0_bus4 = "/pinctrl/sdio0/sdio0-bus4";
		sdio0_cmd = "/pinctrl/sdio0/sdio0-cmd";
		sdio0_clk = "/pinctrl/sdio0/sdio0-clk";
		sdio0_cd = "/pinctrl/sdio0/sdio0-cd";
		sdio0_pwr = "/pinctrl/sdio0/sdio0-pwr";
		sdio0_bkpwr = "/pinctrl/sdio0/sdio0-bkpwr";
		sdio0_wp = "/pinctrl/sdio0/sdio0-wp";
		sdio0_int = "/pinctrl/sdio0/sdio0-int";
		sdmmc_bus1 = "/pinctrl/sdmmc/sdmmc-bus1";
		sdmmc_bus4 = "/pinctrl/sdmmc/sdmmc-bus4";
		sdmmc_clk = "/pinctrl/sdmmc/sdmmc-clk";
		sdmmc_cmd = "/pinctrl/sdmmc/sdmmc-cmd";
		sdmmc_cd = "/pinctrl/sdmmc/sdmcc-cd";
		sdmmc_wp = "/pinctrl/sdmmc/sdmmc-wp";
		spdif_bus = "/pinctrl/spdif/spdif-bus";
		spdif_bus_1 = "/pinctrl/spdif/spdif-bus-1";
		spi0_clk = "/pinctrl/spi0/spi0-clk";
		spi0_cs0 = "/pinctrl/spi0/spi0-cs0";
		spi0_cs1 = "/pinctrl/spi0/spi0-cs1";
		spi0_tx = "/pinctrl/spi0/spi0-tx";
		spi0_rx = "/pinctrl/spi0/spi0-rx";
		spi1_clk = "/pinctrl/spi1/spi1-clk";
		spi1_cs0 = "/pinctrl/spi1/spi1-cs0";
		spi1_rx = "/pinctrl/spi1/spi1-rx";
		spi1_tx = "/pinctrl/spi1/spi1-tx";
		spi2_clk = "/pinctrl/spi2/spi2-clk";
		spi2_cs0 = "/pinctrl/spi2/spi2-cs0";
		spi2_rx = "/pinctrl/spi2/spi2-rx";
		spi2_tx = "/pinctrl/spi2/spi2-tx";
		spi3_clk = "/pinctrl/spi3/spi3-clk";
		spi3_cs0 = "/pinctrl/spi3/spi3-cs0";
		spi3_rx = "/pinctrl/spi3/spi3-rx";
		spi3_tx = "/pinctrl/spi3/spi3-tx";
		spi4_clk = "/pinctrl/spi4/spi4-clk";
		spi4_cs0 = "/pinctrl/spi4/spi4-cs0";
		spi4_rx = "/pinctrl/spi4/spi4-rx";
		spi4_tx = "/pinctrl/spi4/spi4-tx";
		spi5_clk = "/pinctrl/spi5/spi5-clk";
		spi5_cs0 = "/pinctrl/spi5/spi5-cs0";
		spi5_rx = "/pinctrl/spi5/spi5-rx";
		spi5_tx = "/pinctrl/spi5/spi5-tx";
		otp_gpio = "/pinctrl/tsadc/otp-gpio";
		otp_out = "/pinctrl/tsadc/otp-out";
		uart0_xfer = "/pinctrl/uart0/uart0-xfer";
		uart0_cts = "/pinctrl/uart0/uart0-cts";
		uart0_rts = "/pinctrl/uart0/uart0-rts";
		uart1_xfer = "/pinctrl/uart1/uart1-xfer";
		uart2a_xfer = "/pinctrl/uart2a/uart2a-xfer";
		uart2b_xfer = "/pinctrl/uart2b/uart2b-xfer";
		uart2c_xfer = "/pinctrl/uart2c/uart2c-xfer";
		uart3_xfer = "/pinctrl/uart3/uart3-xfer";
		uart3_cts = "/pinctrl/uart3/uart3-cts";
		uart3_rts = "/pinctrl/uart3/uart3-rts";
		uart4_xfer = "/pinctrl/uart4/uart4-xfer";
		uarthdcp_xfer = "/pinctrl/uarthdcp/uarthdcp-xfer";
		pwm0_pin = "/pinctrl/pwm0/pwm0-pin";
		pwm0_pin_pull_down = "/pinctrl/pwm0/pwm0-pin-pull-down";
		vop0_pwm_pin = "/pinctrl/pwm0/vop0-pwm-pin";
		vop1_pwm_pin = "/pinctrl/pwm0/vop1-pwm-pin";
		pwm1_pin = "/pinctrl/pwm1/pwm1-pin";
		pwm1_pin_pull_down = "/pinctrl/pwm1/pwm1-pin-pull-down";
		pwm2_pin = "/pinctrl/pwm2/pwm2-pin";
		pwm2_pin_pull_down = "/pinctrl/pwm2/pwm2-pin-pull-down";
		pwm3a_pin = "/pinctrl/pwm3a/pwm3a-pin";
		pwm3a_pin_pull_down = "/pinctrl/pwm3a/pwm3a-pin-pull-down";
		pwm3b_pin = "/pinctrl/pwm3b/pwm3b-pin";
		pwm3b_pin_pull_down = "/pinctrl/pwm3b/pwm3b-pin-pull-down";
		edp_hpd = "/pinctrl/edp/edp-hpd";
		hdmi_i2c_xfer = "/pinctrl/hdmi/hdmi-i2c-xfer";
		hdmi_cec = "/pinctrl/hdmi/hdmi-cec";
		pcie_clkreqn = "/pinctrl/pcie/pci-clkreqn";
		pcie_clkreqnb = "/pinctrl/pcie/pci-clkreqnb";
		pcie_clkreqn_cpm = "/pinctrl/pcie/pci-clkreqn-cpm";
		pcie_clkreqnb_cpm = "/pinctrl/pcie/pci-clkreqnb-cpm";
		pmic_int_l = "/pinctrl/pmic/pmic-int-l";
		vsel1_gpio = "/pinctrl/pmic/vsel1-gpio";
		vsel2_gpio = "/pinctrl/pmic/vsel2-gpio";
		host_vbus_drv_usb3 = "/pinctrl/usb/host-vbus-drv-usb3";
		host_vbus_drv_usb2 = "/pinctrl/usb/host-vbus-drv-usb2";
		vcc_sd_h = "/pinctrl/vcc_sd/vcc-sd-h";
		fusb0_int = "/pinctrl/fusb30x/fusb0-int";
		wifi_enable_h = "/pinctrl/sdio-pwrseq/wifi-enable-h";
		uart0_gpios = "/pinctrl/wireless-bluetooth/uart0-gpios";
		hp_det = "/pinctrl/headphone/hp-det";
		leds_gpio = "/pinctrl/gpio-leds/leds-gpio";
		cif_clkout = "/pinctrl/isp/cif-clkout";
		isp_dvp_d0d7 = "/pinctrl/isp/isp-dvp-d0d7";
		isp_shutter = "/pinctrl/isp/isp-shutter";
		isp_flash_trigger = "/pinctrl/isp/isp-flash-trigger";
		isp_prelight = "/pinctrl/isp/isp-prelight";
		isp_flash_trigger_as_gpio = "/pinctrl/isp/isp_flash_trigger_as_gpio";
		rockchip_suspend = "/rockchip-suspend";
		RK3399_CPU_COST_0 = "/energy-costs/rk3399-core-cost0";
		RK3399_CPU_COST_1 = "/energy-costs/rk3399-core-cost1";
		RK3399_CLUSTER_COST_0 = "/energy-costs/rk3399-cluster-cost0";
		RK3399_CLUSTER_COST_1 = "/energy-costs/rk3399-cluster-cost1";
		cluster0_opp = "/opp-table0";
		cluster1_opp = "/opp-table1";
		gpu_opp_table = "/opp-table2";
		dmc_opp_table = "/opp-table3";
		vcc5v0_sys = "/vcc5v0-sys";
		vcc3v3_sys = "/vcc3v3-sys";
		vcc5v0_host_usb3 = "/vcc5v0-host-usb3-regulator";
		vcc5v0_host_usb2 = "/vcc5v0-host-usb2-regulator";
		vcc_sd = "/vcc-sd";
		vcc_phy = "/vcc-phy-regulator";
		vdd_log = "/vdd-log";
		clkin_gmac = "/external-gmac-clock";
		sdio_pwrseq = "/sdio-pwrseq";
		backlight = "/backlight";
		leds = "/gpio-leds";
		rk_headset = "/rk-headset";
		rockchip_msm261s4030h0_codec = "/rockchip-msm261s4030h0-codec";
		rockchip_msm261s4030h0 = "/rockchip-msm261s4030h0";
		ramoops_mem = "/ramoops_mem";
		fiq_debugger = "/fiq-debugger";
		drm_logo = "/reserved-memory/drm-logo@00000000";
		secure_memory = "/reserved-memory/secure-memory@20000000";
		stb_devinfo = "/reserved-memory/stb-devinfo@00000000";
		rk_key = "/rockchip-key";
		isp0 = "/isp@ff910000";
		isp1 = "/isp@ff920000";
		hdmi_dp_sound = "/hdmi-dp-sound";
		extbrd = "/extbrd";
	};

	cpus {
		#address-cells = <0x2>;
		#size-cells = <0x0>;

		cpu-map {

			cluster0 {

				core0 {
					cpu = <0x2>;
				};

				core1 {
					cpu = <0x3>;
				};

				core2 {
					cpu = <0x4>;
				};

				core3 {
					cpu = <0x5>;
				};
			};

			cluster1 {

				core0 {
					cpu = <0x6>;
				};

				core1 {
					cpu = <0x7>;
				};
			};
		};

		cpu_l0: cpu@0 {
			device_type = "cpu";
			compatible = "arm,cortex-a53", "arm,armv8";
			reg = <0x0 0x0>;
			enable-method = "psci";
			#cooling-cells = <0x2>;
			dynamic-power-coefficient = <0x64>;
			clocks = <0x8 0x8>;
			cpu-idle-states = <0x9 0xa>;
			operating-points-v2 = <0xb>;
			sched-energy-costs = <0xc 0xd>;
			cpu-supply = <0xe>;
			phandle = <0x2>;
		};

		cpu_l1: cpu@1 {
			device_type = "cpu";
			compatible = "arm,cortex-a53", "arm,armv8";
			reg = <0x0 0x1>;
			enable-method = "psci";
			clocks = <0x8 0x8>;
			cpu-idle-states = <0x9 0xa>;
			operating-points-v2 = <0xb>;
			sched-energy-costs = <0xc 0xd>;
			cpu-supply = <0xe>;
			phandle = <0x3>;
		};

		cpu_l2: cpu@2 {
			device_type = "cpu";
			compatible = "arm,cortex-a53", "arm,armv8";
			reg = <0x0 0x2>;
			enable-method = "psci";
			clocks = <0x8 0x8>;
			cpu-idle-states = <0x9 0xa>;
			operating-points-v2 = <0xb>;
			sched-energy-costs = <0xc 0xd>;
			cpu-supply = <0xe>;
			phandle = <0x4>;
		};

		cpu_l3: cpu@3 {
			device_type = "cpu";
			compatible = "arm,cortex-a53", "arm,armv8";
			reg = <0x0 0x3>;
			enable-method = "psci";
			clocks = <0x8 0x8>;
			cpu-idle-states = <0x9 0xa>;
			operating-points-v2 = <0xb>;
			sched-energy-costs = <0xc 0xd>;
			cpu-supply = <0xe>;
			phandle = <0x5>;
		};

		cpu_b0: cpu@100 {
			device_type = "cpu";
			compatible = "arm,cortex-a72", "arm,armv8";
			reg = <0x0 0x100>;
			enable-method = "psci";
			#cooling-cells = <0x2>;
			dynamic-power-coefficient = <0x1b4>;
			clocks = <0x8 0x9>;
			cpu-idle-states = <0x9 0xa>;
			operating-points-v2 = <0xf>;
			sched-energy-costs = <0x10 0x11>;
			cpu-supply = <0x12>;
			phandle = <0x6>;
		};

		cpu_b1: cpu@101 {
			device_type = "cpu";
			compatible = "arm,cortex-a72", "arm,armv8";
			reg = <0x0 0x101>;
			enable-method = "psci";
			clocks = <0x8 0x9>;
			cpu-idle-states = <0x9 0xa>;
			operating-points-v2 = <0xf>;
			sched-energy-costs = <0x10 0x11>;
			cpu-supply = <0x12>;
			phandle = <0x7>;
		};

		idle-states {
			entry-method = "psci";

			CPU_SLEEP: cpu-sleep {
				compatible = "arm,idle-state";
				local-timer-stop;
				arm,psci-suspend-param = <0x10000>;
				entry-latency-us = <0x78>;
				exit-latency-us = <0xfa>;
				min-residency-us = <0x384>;
				phandle = <0x9>;
			};

			CLUSTER_SLEEP: cluster-sleep {
				compatible = "arm,idle-state";
				local-timer-stop;
				arm,psci-suspend-param = <0x1010000>;
				entry-latency-us = <0x190>;
				exit-latency-us = <0x1f4>;
				min-residency-us = <0x7d0>;
				phandle = <0xa>;
			};
		};
	};

	pmu_a53 {
		compatible = "arm,cortex-a53-pmu";
		interrupts = <0x1 0x7 0x8 0x13>;
	};

	pmu_a72 {
		compatible = "arm,cortex-a72-pmu";
		interrupts = <0x1 0x7 0x8 0x14>;
	};

	psci {
		compatible = "arm,psci-1.0";
		method = "smc";
	};

	timer {
		compatible = "arm,armv8-timer";
		interrupts = <0x1 0xd 0x8 0x0 0x1 0xe 0x8 0x0 0x1 0xb 0x8 0x0 0x1 0xa 0x8 0x0>;
	};

	xin24m: xin24m {
		compatible = "fixed-clock";
		clock-frequency = <0x16e3600>;
		clock-output-names = "xin24m";
		#clock-cells = <0x0>;
		phandle = <0xdf>;
	};

	dummy_cpll: dummy_cpll {
		compatible = "fixed-clock";
		clock-frequency = <0x0>;
		clock-output-names = "dummy_cpll";
		#clock-cells = <0x0>;
		phandle = <0xe0>;
	};

	dummy_vpll: dummy_vpll {
		compatible = "fixed-clock";
		clock-frequency = <0x0>;
		clock-output-names = "dummy_vpll";
		#clock-cells = <0x0>;
		phandle = <0xe1>;
	};

	amba {
		compatible = "arm,amba-bus";
		#address-cells = <0x2>;
		#size-cells = <0x2>;
		ranges;

		dmac_bus: dma-controller@ff6d0000 {
			compatible = "arm,pl330", "arm,primecell";
			reg = <0x0 0xff6d0000 0x0 0x4000>;
			interrupts = <0x0 0x5 0x4 0x0 0x0 0x6 0x4 0x0>;
			#dma-cells = <0x1>;
			clocks = <0x8 0xd3>;
			clock-names = "apb_pclk";
			peripherals-req-type-burst;
			phandle = <0x95>;
		};

		dmac_peri: dma-controller@ff6e0000 {
			compatible = "arm,pl330", "arm,primecell";
			reg = <0x0 0xff6e0000 0x0 0x4000>;
			interrupts = <0x0 0x7 0x4 0x0 0x0 0x8 0x4 0x0>;
			#dma-cells = <0x1>;
			clocks = <0x8 0xd4>;
			clock-names = "apb_pclk";
			peripherals-req-type-burst;
			phandle = <0xe2>;
		};
	};

	gmac: ethernet@fe300000 {
		compatible = "rockchip,rk3399-gmac";
		reg = <0x0 0xfe300000 0x0 0x10000>;
		rockchip,grf = <0x15>;
		interrupts = <0x0 0xc 0x4 0x0>;
		interrupt-names = "macirq";
		clocks = <0x8 0x69 0x8 0x67 0x8 0x68 0x8 0x66 0x8 0x6a 0x8 0xd5 0x8 0x166>;
		clock-names = "stmmaceth", "mac_clk_rx", "mac_clk_tx", "clk_mac_ref", "clk_mac_refout", "aclk_mac", "pclk_mac";
		resets = <0x8 0x89>;
		reset-names = "stmmaceth";
		power-domains = <0x16 0x16>;
		status = "okay";
		phy-supply = <0x17>;
		phy-mode = "rgmii";
		clock_in_out = "input";
		snps,reset-gpio = <0x18 0xf 0x1>;
		snps,reset-active-low;
		snps,reset-delays-us = <0x0 0x2710 0xc350>;
		assigned-clocks = <0x8 0xa6>;
		assigned-clock-parents = <0x19>;
		pinctrl-names = "default";
		pinctrl-0 = <0x1a>;
		tx_delay = <0x28>;
		rx_delay = <0x11>;
		phandle = <0xe3>;
	};

	sdio0: dwmmc@fe310000 {
		compatible = "rockchip,rk3399-dw-mshc", "rockchip,rk3288-dw-mshc";
		reg = <0x0 0xfe310000 0x0 0x4000>;
		interrupts = <0x0 0x40 0x4 0x0>;
		clock-freq-min-max = <0x30d40 0x2faf080>;
		clocks = <0x8 0x1ee 0x8 0x4d 0x8 0x9c 0x8 0x9d>;
		clock-names = "biu", "ciu", "ciu-drive", "ciu-sample";
		fifo-depth = <0x100>;
		power-domains = <0x16 0x1c>;
		status = "okay";
		clock-frequency = <0x2faf080>;
		supports-sdio;
		bus-width = <0x4>;
		disable-wp;
		cap-sd-highspeed;
		cap-sdio-irq;
		keep-power-in-suspend;
		mmc-pwrseq = <0x1b>;
		non-removable;
		num-slots = <0x1>;
		pinctrl-names = "default";
		pinctrl-0 = <0x1c 0x1d 0x1e>;
		sd-uhs-sdr104;
		phandle = <0xe4>;
	};

	sdmmc: dwmmc@fe320000 {
		compatible = "rockchip,rk3399-dw-mshc", "rockchip,rk3288-dw-mshc";
		reg = <0x0 0xfe320000 0x0 0x4000>;
		interrupts = <0x0 0x41 0x4 0x0>;
		clock-freq-min-max = <0x186a0 0x8f0d180>;
		clocks = <0x8 0x1ce 0x8 0x4c 0x8 0x9a 0x8 0x9b>;
		clock-names = "biu", "ciu", "ciu-drive", "ciu-sample";
		fifo-depth = <0x100>;
		power-domains = <0x16 0x1b>;
		status = "okay";
		clock-frequency = <0x8f0d180>;
		supports-sd;
		bus-width = <0x4>;
		cap-mmc-highspeed;
		cap-sd-highspeed;
		disable-wp;
		num-slots = <0x1>;
		vmmc-supply = <0x1f>;
		vqmmc-supply = <0x20>;
		pinctrl-names = "default";
		pinctrl-0 = <0x21 0x22 0x23 0x24>;
		phandle = <0xe5>;
	};

	sdhci: sdhci@fe330000 {
		compatible = "rockchip,rk3399-sdhci-5.1", "arasan,sdhci-5.1";
		reg = <0x0 0xfe330000 0x0 0x10000>;
		interrupts = <0x0 0xb 0x4 0x0>;
		arasan,soc-ctl-syscon = <0x15>;
		assigned-clocks = <0x8 0x4e>;
		assigned-clock-rates = <0xbebc200>;
		clocks = <0x8 0x4e 0x8 0xf0>;
		clock-names = "clk_xin", "clk_ahb";
		clock-output-names = "emmc_cardclock";
		#clock-cells = <0x0>;
		phys = <0x25>;
		phy-names = "phy_arasan";
		power-domains = <0x16 0x17>;
		status = "okay";
		bus-width = <0x8>;
		mmc-hs400-1_8v;
		supports-emmc;
		non-removable;
		keep-power-in-suspend;
		mmc-hs400-enhanced-strobe;
		assigned-clock-parents = <0x8 0x5>;
		phandle = <0x94>;
	};

	usb_host0_ehci: usb@fe380000 {
		compatible = "generic-ehci";
		reg = <0x0 0xfe380000 0x0 0x20000>;
		interrupts = <0x0 0x1a 0x4 0x0>;
		clocks = <0x8 0x1c8 0x8 0x1c9 0x8 0xa8>;
		clock-names = "hclk_host0", "hclk_host0_arb", "usbphy0_480m";
		phys = <0x26>;
		phy-names = "usb";
		power-domains = <0x16 0xe>;
		status = "okay";
		phandle = <0xe6>;
	};

	usb_host0_ohci: usb@fe3a0000 {
		compatible = "generic-ohci";
		reg = <0x0 0xfe3a0000 0x0 0x20000>;
		interrupts = <0x0 0x1c 0x4 0x0>;
		clocks = <0x8 0x1c8 0x8 0x1c9 0x8 0xa8>;
		clock-names = "hclk_host0", "hclk_host0_arb", "usbphy0_480m";
		phys = <0x26>;
		phy-names = "usb";
		power-domains = <0x16 0xe>;
		status = "okay";
		phandle = <0xe7>;
	};

	usb_host1_ehci: usb@fe3c0000 {
		compatible = "generic-ehci";
		reg = <0x0 0xfe3c0000 0x0 0x20000>;
		interrupts = <0x0 0x1e 0x4 0x0>;
		clocks = <0x8 0x1ca 0x8 0x1cb 0x8 0xa9>;
		clock-names = "hclk_host1", "hclk_host1_arb", "usbphy1_480m";
		phys = <0x27>;
		phy-names = "usb";
		power-domains = <0x16 0xe>;
		status = "okay";
		phandle = <0xe8>;
	};

	usb_host1_ohci: usb@fe3e0000 {
		compatible = "generic-ohci";
		reg = <0x0 0xfe3e0000 0x0 0x20000>;
		interrupts = <0x0 0x20 0x4 0x0>;
		clocks = <0x8 0x1ca 0x8 0x1cb 0x8 0xa9>;
		clock-names = "hclk_host1", "hclk_host1_arb", "usbphy1_480m";
		phys = <0x27>;
		phy-names = "usb";
		power-domains = <0x16 0xe>;
		status = "okay";
		phandle = <0xe9>;
	};

	usbdrd3_0: usb@fe800000 {
		compatible = "rockchip,rk3399-dwc3";
		clocks = <0x8 0x81 0x8 0x83 0x8 0xf6 0x8 0xf9>;
		clock-names = "ref_clk", "suspend_clk", "bus_clk", "grf_clk";
		power-domains = <0x16 0x18>;
		resets = <0x8 0x125>;
		reset-names = "usb3-otg";
		#address-cells = <0x2>;
		#size-cells = <0x2>;
		ranges;
		status = "okay";
		extcon = <0x28>;
		phandle = <0xea>;

		usbdrd_dwc3_0: dwc3@fe800000 {
			compatible = "snps,dwc3";
			reg = <0x0 0xfe800000 0x0 0x100000>;
			interrupts = <0x0 0x69 0x4 0x0>;
			dr_mode = "otg";
			phys = <0x29 0x2a>;
			phy-names = "usb2-phy", "usb3-phy";
			phy_type = "utmi_wide";
			snps,dis_enblslpm_quirk;
			snps,dis-u2-freeclk-exists-quirk;
			snps,dis_u2_susphy_quirk;
			snps,dis-del-phy-power-chg-quirk;
			snps,tx-ipgap-linecheck-dis-quirk;
			snps,xhci-slow-suspend-quirk;
			snps,usb3-warm-reset-on-resume-quirk;
			status = "okay";
			phandle = <0xeb>;
		};
	};

	usbdrd3_1: usb@fe900000 {
		compatible = "rockchip,rk3399-dwc3";
		clocks = <0x8 0x82 0x8 0x84 0x8 0xf7 0x8 0xf9>;
		clock-names = "ref_clk", "suspend_clk", "bus_clk", "grf_clk";
		power-domains = <0x16 0x18>;
		resets = <0x8 0x126>;
		reset-names = "usb3-otg";
		#address-cells = <0x2>;
		#size-cells = <0x2>;
		ranges;
		status = "okay";
		phandle = <0xec>;

		usbdrd_dwc3_1: dwc3@fe900000 {
			compatible = "snps,dwc3";
			reg = <0x0 0xfe900000 0x0 0x100000>;
			interrupts = <0x0 0x6e 0x4 0x0>;
			dr_mode = "host";
			phys = <0x2b 0x2c>;
			phy-names = "usb2-phy", "usb3-phy";
			phy_type = "utmi_wide";
			snps,dis_enblslpm_quirk;
			snps,dis-u2-freeclk-exists-quirk;
			snps,dis_u2_susphy_quirk;
			snps,dis-del-phy-power-chg-quirk;
			snps,tx-ipgap-linecheck-dis-quirk;
			snps,xhci-slow-suspend-quirk;
			snps,usb3-warm-reset-on-resume-quirk;
			status = "okay";
			phy-supply = <0x2d>;
			phandle = <0xed>;
		};
	};

	cdn_dp: dp@fec00000 {
		compatible = "rockchip,rk3399-cdn-dp";
		reg = <0x0 0xfec00000 0x0 0x100000>;
		interrupts = <0x0 0x9 0x4 0x0>;
		clocks = <0x8 0x72 0x8 0x175 0x8 0xa1 0x8 0x16f>;
		clock-names = "core-clk", "pclk", "spdif", "grf";
		assigned-clocks = <0x8 0x72>;
		assigned-clock-rates = <0x5f5e100>;
		power-domains = <0x16 0x15>;
		phys = <0x2e>;
		resets = <0x8 0x103 0x8 0x148 0x8 0x14a 0x8 0xfd>;
		reset-names = "spdif", "dptx", "apb", "core";
		rockchip,grf = <0x15>;
		#address-cells = <0x1>;
		#size-cells = <0x0>;
		#sound-dai-cells = <0x1>;
		status = "okay";
		extcon = <0x28>;
		phandle = <0xde>;

		ports {
			#address-cells = <0x1>;
			#size-cells = <0x0>;

			dp_in: port {
				#address-cells = <0x1>;
				#size-cells = <0x0>;
				phandle = <0xee>;

				dp_in_vopb: endpoint@0 {
					reg = <0x0>;
					remote-endpoint = <0x2f>;
					phandle = <0xa6>;
				};

				dp_in_vopl: endpoint@1 {
					reg = <0x1>;
					remote-endpoint = <0x30>;
					phandle = <0x9f>;
				};
			};
		};
	};

	gic: interrupt-controller@fee00000 {
		compatible = "arm,gic-v3";
		#interrupt-cells = <0x4>;
		#address-cells = <0x2>;
		#size-cells = <0x2>;
		ranges;
		interrupt-controller;
		reg = <0x0 0xfee00000 0x0 0x10000 0x0 0xfef00000 0x0 0xc0000 0x0 0xfff00000 0x0 0x10000 0x0 0xfff10000 0x0 0x10000 0x0 0xfff20000 0x0 0x10000>;
		interrupts = <0x1 0x9 0x4 0x0>;
		phandle = <0x1>;

		its: interrupt-controller@fee20000 {
			compatible = "arm,gic-v3-its";
			msi-controller;
			reg = <0x0 0xfee20000 0x0 0x20000>;
			phandle = <0x84>;
		};

		ppi-partitions {

			ppi_cluster0: interrupt-partition-0 {
				affinity = <0x2 0x3 0x4 0x5>;
				phandle = <0x13>;
			};

			ppi_cluster1: interrupt-partition-1 {
				affinity = <0x6 0x7>;
				phandle = <0x14>;
			};
		};
	};

	saradc: saradc@ff100000 {
		compatible = "rockchip,rk3399-saradc";
		reg = <0x0 0xff100000 0x0 0x100>;
		interrupts = <0x0 0x3e 0x4 0x0>;
		#io-channel-cells = <0x1>;
		clocks = <0x8 0x50 0x8 0x165>;
		clock-names = "saradc", "apb_pclk";
		resets = <0x8 0xd4>;
		reset-names = "saradc-apb";
		status = "okay";
		phandle = <0xd0>;
	};

	i2c0: i2c@ff3c0000 {
		compatible = "rockchip,rk3399-i2c";
		reg = <0x0 0xff3c0000 0x0 0x1000>;
		clocks = <0x31 0x9 0x31 0x1b>;
		clock-names = "i2c", "pclk";
		interrupts = <0x0 0x39 0x4 0x0>;
		pinctrl-names = "default";
		pinctrl-0 = <0x32>;
		#address-cells = <0x1>;
		#size-cells = <0x0>;
		status = "okay";
		i2c-scl-rising-time-ns = <0xa8>;
		i2c-scl-falling-time-ns = <0x4>;
		clock-frequency = <0x61a80>;
		phandle = <0xef>;

		vdd_cpu_b: syr827@40 {
			compatible = "silergy,syr827";
			reg = <0x40>;
			vin-supply = <0x33>;
			regulator-compatible = "fan53555-reg";
			pinctrl-names = "default";
			pinctrl-0 = <0x34>;
			vsel-gpios = <0x35 0x11 0x0>;
			regulator-name = "vdd_cpu_b";
			regulator-min-microvolt = <0xadf34>;
			regulator-max-microvolt = <0x16e360>;
			regulator-ramp-delay = <0x3e8>;
			fcs,suspend-voltage-selector = <0x1>;
			regulator-always-on;
			regulator-boot-on;
			regulator-initial-state = <0x3>;
			phandle = <0x12>;

			regulator-state-mem {
				regulator-off-in-suspend;
			};
		};

		vdd_gpu: syr828@41 {
			compatible = "silergy,syr828";
			reg = <0x41>;
			vin-supply = <0x33>;
			regulator-compatible = "fan53555-reg";
			pinctrl-names = "default";
			pinctrl-0 = <0x36>;
			vsel-gpios = <0x35 0xe 0x0>;
			regulator-name = "vdd_gpu";
			regulator-min-microvolt = <0xadf34>;
			regulator-max-microvolt = <0x16e360>;
			regulator-ramp-delay = <0x3e8>;
			fcs,suspend-voltage-selector = <0x1>;
			regulator-always-on;
			regulator-boot-on;
			regulator-initial-state = <0x3>;
			phandle = <0x9a>;

			regulator-state-mem {
				regulator-off-in-suspend;
			};
		};

		rk808: pmic@1b {
			compatible = "rockchip,rk808";
			reg = <0x1b>;
			interrupt-parent = <0x35>;
			interrupts = <0x15 0x8>;
			pinctrl-names = "default";
			pinctrl-0 = <0x37>;
			rockchip,system-power-controller;
			wakeup-source;
			#clock-cells = <0x1>;
			clock-output-names = "xin32k", "rk808-clkout2";
			vcc1-supply = <0x38>;
			vcc2-supply = <0x38>;
			vcc3-supply = <0x38>;
			vcc4-supply = <0x38>;
			vcc6-supply = <0x38>;
			vcc7-supply = <0x38>;
			vcc8-supply = <0x38>;
			vcc9-supply = <0x38>;
			vcc10-supply = <0x38>;
			vcc11-supply = <0x38>;
			vcc12-supply = <0x38>;
			vddio-supply = <0x39>;
			phandle = <0xc8>;

			regulators {

				vdd_center: DCDC_REG1 {
					regulator-always-on;
					regulator-boot-on;
					regulator-min-microvolt = <0xb71b0>;
					regulator-max-microvolt = <0x149970>;
					regulator-ramp-delay = <0x1771>;
					regulator-name = "vdd_center";
					phandle = <0x8f>;

					regulator-state-mem {
						regulator-off-in-suspend;
					};
				};

				vdd_cpu_l: DCDC_REG2 {
					regulator-always-on;
					regulator-boot-on;
					regulator-min-microvolt = <0xb71b0>;
					regulator-max-microvolt = <0x149970>;
					regulator-ramp-delay = <0x1771>;
					regulator-name = "vdd_cpu_l";
					phandle = <0xe>;

					regulator-state-mem {
						regulator-off-in-suspend;
					};
				};

				vcc_ddr: DCDC_REG3 {
					regulator-always-on;
					regulator-boot-on;
					regulator-name = "vcc_ddr";
					phandle = <0xf0>;

					regulator-state-mem {
						regulator-on-in-suspend;
					};
				};

				vcc_1v8: DCDC_REG4 {
					regulator-always-on;
					regulator-boot-on;
					regulator-min-microvolt = <0x1b7740>;
					regulator-max-microvolt = <0x1b7740>;
					regulator-name = "vcc_1v8";
					phandle = <0xf1>;

					regulator-state-mem {
						regulator-on-in-suspend;
						regulator-suspend-microvolt = <0x1b7740>;
					};
				};

				vcc1v8_dvp: LDO_REG1 {
					regulator-min-microvolt = <0x1b7740>;
					regulator-max-microvolt = <0x1b7740>;
					regulator-name = "vcc1v8_dvp";
					phandle = <0xf2>;

					regulator-state-mem {
						regulator-off-in-suspend;
					};
				};

				vcc_avdd_2v8: LDO_REG2 {
					regulator-min-microvolt = <0x2ab980>;
					regulator-max-microvolt = <0x2ab980>;
					regulator-name = "vcc_avdd_2v8";
					phandle = <0xf3>;

					regulator-state-mem {
						regulator-off-in-suspend;
					};
				};

				vcc1v8_pmupll: LDO_REG3 {
					regulator-always-on;
					regulator-boot-on;
					regulator-min-microvolt = <0x1b7740>;
					regulator-max-microvolt = <0x1b7740>;
					regulator-name = "vcc1v8_pmupll";
					phandle = <0xf4>;

					regulator-state-mem {
						regulator-on-in-suspend;
						regulator-suspend-microvolt = <0x1b7740>;
					};
				};

				vcc_sdio: LDO_REG4 {
					regulator-always-on;
					regulator-boot-on;
					regulator-min-microvolt = <0x1b7740>;
					regulator-max-microvolt = <0x2dc6c0>;
					regulator-name = "vcc_sdio";
					phandle = <0x20>;

					regulator-state-mem {
						regulator-on-in-suspend;
						regulator-suspend-microvolt = <0x2dc6c0>;
					};
				};

				vcca3v0_codec: LDO_REG5 {
					regulator-always-on;
					regulator-boot-on;
					regulator-min-microvolt = <0x2dc6c0>;
					regulator-max-microvolt = <0x2dc6c0>;
					regulator-name = "vcca3v0_codec";
					phandle = <0xf5>;

					regulator-state-mem {
						regulator-off-in-suspend;
					};
				};

				vcc_1v5: LDO_REG6 {
					regulator-always-on;
					regulator-boot-on;
					regulator-min-microvolt = <0x16e360>;
					regulator-max-microvolt = <0x16e360>;
					regulator-name = "vcc_1v5";
					phandle = <0xf6>;

					regulator-state-mem {
						regulator-on-in-suspend;
						regulator-suspend-microvolt = <0x16e360>;
					};
				};

				vcca1v8_codec: LDO_REG7 {
					regulator-always-on;
					regulator-boot-on;
					regulator-min-microvolt = <0x1b7740>;
					regulator-max-microvolt = <0x1b7740>;
					regulator-name = "vcca1v8_codec";
					phandle = <0x93>;

					regulator-state-mem {
						regulator-off-in-suspend;
					};
				};

				vcc_3v0: LDO_REG8 {
					regulator-always-on;
					regulator-boot-on;
					regulator-min-microvolt = <0x2dc6c0>;
					regulator-max-microvolt = <0x2dc6c0>;
					regulator-name = "vcc_3v0";
					phandle = <0x39>;

					regulator-state-mem {
						regulator-on-in-suspend;
						regulator-suspend-microvolt = <0x2dc6c0>;
					};
				};

				vcc3v3_s3: SWITCH_REG1 {
					regulator-always-on;
					regulator-boot-on;
					regulator-name = "vcc3v3_s3";
					phandle = <0xf7>;

					regulator-state-mem {
						regulator-off-in-suspend;
					};
				};

				vcc3v3_s0: SWITCH_REG2 {
					regulator-always-on;
					regulator-boot-on;
					regulator-name = "vcc3v3_s0";
					phandle = <0xf8>;

					regulator-state-mem {
						regulator-off-in-suspend;
					};
				};
			};
		};
	};

	i2c1: i2c@ff110000 {
		compatible = "rockchip,rk3399-i2c";
		reg = <0x0 0xff110000 0x0 0x1000>;
		clocks = <0x8 0x41 0x8 0x155>;
		clock-names = "i2c", "pclk";
		interrupts = <0x0 0x3b 0x4 0x0>;
		pinctrl-names = "default";
		pinctrl-0 = <0x3a>;
		#address-cells = <0x1>;
		#size-cells = <0x0>;
		status = "okay";
		i2c-scl-rising-time-ns = <0x12c>;
		i2c-scl-falling-time-ns = <0xf>;
		clock-frequency = <0x61a80>;
		phandle = <0xf9>;

		rt5651: rt5651@1a {
			#sound-dai-cells = <0x0>;
			compatible = "rockchip,rt5651";
			reg = <0x1a>;
			clocks = <0x8 0x59>;
			clock-names = "mclk";
			pinctrl-names = "default";
			pinctrl-0 = <0x3b>;
			spk-con-gpio = <0x3c 0xb 0x0>;
			hp-det-gpio = <0x3d 0x1c 0x0>;
			phandle = <0xd2>;
		};

		es7243: es7243@13 {
			status = "okay";
			compatible = "everest,es7243";
			reg = <0x13>;
			phandle = <0xfa>;
		};
	};

	i2c2: i2c@ff120000 {
		compatible = "rockchip,rk3399-i2c";
		reg = <0x0 0xff120000 0x0 0x1000>;
		clocks = <0x8 0x42 0x8 0x156>;
		clock-names = "i2c", "pclk";
		interrupts = <0x0 0x23 0x4 0x0>;
		pinctrl-names = "default";
		pinctrl-0 = <0x3e>;
		#address-cells = <0x1>;
		#size-cells = <0x0>;
		status = "okay";
		i2c-scl-rising-time-ns = <0x12c>;
		i2c-scl-falling-time-ns = <0xf>;
		clock-frequency = <0x61a80>;
		phandle = <0xfb>;

		ina219x41c2: ina219@41 {
			compatible = "ina219";
			reg = <0x41>;
			phandle = <0xfc>;
		};
	};

	i2c3: i2c@ff130000 {
		compatible = "rockchip,rk3399-i2c";
		reg = <0x0 0xff130000 0x0 0x1000>;
		clocks = <0x8 0x43 0x8 0x157>;
		clock-names = "i2c", "pclk";
		interrupts = <0x0 0x22 0x4 0x0>;
		pinctrl-names = "default";
		pinctrl-0 = <0x3f>;
		#address-cells = <0x1>;
		#size-cells = <0x0>;
		status = "disabled";
		phandle = <0xfd>;
	};

	i2c5: i2c@ff140000 {
		compatible = "rockchip,rk3399-i2c";
		reg = <0x0 0xff140000 0x0 0x1000>;
		clocks = <0x8 0x44 0x8 0x158>;
		clock-names = "i2c", "pclk";
		interrupts = <0x0 0x26 0x4 0x0>;
		pinctrl-names = "default";
		pinctrl-0 = <0x40>;
		#address-cells = <0x1>;
		#size-cells = <0x0>;
		status = "disabled";
		phandle = <0xfe>;
	};

	i2c6: i2c@ff150000 {
		compatible = "rockchip,rk3399-i2c";
		reg = <0x0 0xff150000 0x0 0x1000>;
		clocks = <0x8 0x45 0x8 0x159>;
		clock-names = "i2c", "pclk";
		interrupts = <0x0 0x25 0x4 0x0>;
		pinctrl-names = "default";
		pinctrl-0 = <0x41>;
		#address-cells = <0x1>;
		#size-cells = <0x0>;
		status = "okay";
		i2c-scl-rising-time-ns = <0x12c>;
		i2c-scl-falling-time-ns = <0xf>;
		clock-frequency = <0x61a80>;
		phandle = <0xff>;

		ina219x47c6: ina219@47 {
			compatible = "ina219";
			reg = <0x47>;
			phandle = <0x100>;
		};
	};

	i2c7: i2c@ff160000 {
		compatible = "rockchip,rk3399-i2c";
		reg = <0x0 0xff160000 0x0 0x1000>;
		clocks = <0x8 0x46 0x8 0x15a>;
		clock-names = "i2c", "pclk";
		interrupts = <0x0 0x24 0x4 0x0>;
		pinctrl-names = "default";
		pinctrl-0 = <0x42>;
		#address-cells = <0x1>;
		#size-cells = <0x0>;
		status = "okay";
		i2c-scl-rising-time-ns = <0x12c>;
		i2c-scl-falling-time-ns = <0xf>;
		clock-frequency = <0x61a80>;
		phandle = <0x101>;

		ina219x40c7: ina219@40 {
			compatible = "ina219";
			reg = <0x40>;
			phandle = <0x102>;
		};
	};

	uart0: serial@ff180000 {
		compatible = "rockchip,rk3399-uart", "snps,dw-apb-uart";
		reg = <0x0 0xff180000 0x0 0x100>;
		clocks = <0x8 0x51 0x8 0x160>;
		clock-names = "baudclk", "apb_pclk";
		interrupts = <0x0 0x63 0x4 0x0>;
		reg-shift = <0x2>;
		reg-io-width = <0x4>;
		pinctrl-names = "default";
		pinctrl-0 = <0x43 0x44>;
		status = "okay";
		assigned-clocks = <0x8 0xac>;
		assigned-clock-parents = <0x8 0x5>;
		phandle = <0x103>;
	};

	uart1: serial@ff190000 {
		compatible = "rockchip,rk3399-uart", "snps,dw-apb-uart";
		reg = <0x0 0xff190000 0x0 0x100>;
		clocks = <0x8 0x52 0x8 0x161>;
		clock-names = "baudclk", "apb_pclk";
		interrupts = <0x0 0x62 0x4 0x0>;
		reg-shift = <0x2>;
		reg-io-width = <0x4>;
		pinctrl-names = "default";
		pinctrl-0 = <0x45>;
		status = "disabled";
		assigned-clocks = <0x8 0xad>;
		assigned-clock-parents = <0x8 0x5>;
		phandle = <0x104>;
	};

	uart2: serial@ff1a0000 {
		compatible = "rockchip,rk3399-uart", "snps,dw-apb-uart";
		reg = <0x0 0xff1a0000 0x0 0x100>;
		clocks = <0x8 0x53 0x8 0x162>;
		clock-names = "baudclk", "apb_pclk";
		interrupts = <0x0 0x64 0x4 0x0>;
		reg-shift = <0x2>;
		reg-io-width = <0x4>;
		pinctrl-names = "default";
		pinctrl-0 = <0x46>;
		status = "disabled";
		assigned-clocks = <0x8 0xad>;
		assigned-clock-parents = <0x8 0x5>;
		phandle = <0x105>;
	};

	uart3: serial@ff1b0000 {
		compatible = "rockchip,rk3399-uart", "snps,dw-apb-uart";
		reg = <0x0 0xff1b0000 0x0 0x100>;
		clocks = <0x8 0x54 0x8 0x163>;
		clock-names = "baudclk", "apb_pclk";
		interrupts = <0x0 0x65 0x4 0x0>;
		reg-shift = <0x2>;
		reg-io-width = <0x4>;
		pinctrl-names = "default";
		pinctrl-0 = <0x47 0x48 0x49>;
		status = "disabled";
		assigned-clocks = <0x8 0xad>;
		assigned-clock-parents = <0x8 0x5>;
		phandle = <0x106>;
	};

	spi0: spi@ff1c0000 {
		compatible = "rockchip,rk3399-spi", "rockchip,rk3066-spi";
		reg = <0x0 0xff1c0000 0x0 0x1000>;
		clocks = <0x8 0x47 0x8 0x15b>;
		clock-names = "spiclk", "apb_pclk";
		interrupts = <0x0 0x44 0x4 0x0>;
		pinctrl-names = "default";
		pinctrl-0 = <0x4a 0x4b 0x4c 0x4d>;
		#address-cells = <0x1>;
		#size-cells = <0x0>;
		status = "disabled";
		phandle = <0x107>;
	};

	spi1: spi@ff1d0000 {
		compatible = "rockchip,rk3399-spi", "rockchip,rk3066-spi";
		reg = <0x0 0xff1d0000 0x0 0x1000>;
		clocks = <0x8 0x48 0x8 0x15c>;
		clock-names = "spiclk", "apb_pclk";
		interrupts = <0x0 0x35 0x4 0x0>;
		pinctrl-names = "default";
		pinctrl-0 = <0x4e 0x4f 0x50 0x51>;
		#address-cells = <0x1>;
		#size-cells = <0x0>;
		status = "okay";
		phandle = <0x108>;

		flash@0 {
			compatible = "gigadevice,w25q64", "jedec,spi-nor";
			#address-cells = <0x1>;
			#size-cells = <0x1>;
			reg = <0x0>;
			m25p,fast-read;
			spi-max-frequency = <0x2faf080>;
		};
	};

	spi2: spi@ff1e0000 {
		compatible = "rockchip,rk3399-spi", "rockchip,rk3066-spi";
		reg = <0x0 0xff1e0000 0x0 0x1000>;
		clocks = <0x8 0x49 0x8 0x15d>;
		clock-names = "spiclk", "apb_pclk";
		interrupts = <0x0 0x34 0x4 0x0>;
		pinctrl-names = "default";
		pinctrl-0 = <0x52 0x53 0x54 0x55>;
		#address-cells = <0x1>;
		#size-cells = <0x0>;
		status = "disabled";
		phandle = <0x109>;
	};

	spi4: spi@ff1f0000 {
		compatible = "rockchip,rk3399-spi", "rockchip,rk3066-spi";
		reg = <0x0 0xff1f0000 0x0 0x1000>;
		clocks = <0x8 0x4a 0x8 0x15e>;
		clock-names = "spiclk", "apb_pclk";
		interrupts = <0x0 0x43 0x4 0x0>;
		pinctrl-names = "default";
		pinctrl-0 = <0x56 0x57 0x58 0x59>;
		#address-cells = <0x1>;
		#size-cells = <0x0>;
		status = "disabled";
		phandle = <0x10a>;
	};

	spi5: spi@ff200000 {
		compatible = "rockchip,rk3399-spi", "rockchip,rk3066-spi";
		reg = <0x0 0xff200000 0x0 0x1000>;
		clocks = <0x8 0x4b 0x8 0x15f>;
		clock-names = "spiclk", "apb_pclk";
		interrupts = <0x0 0x84 0x4 0x0>;
		pinctrl-names = "default";
		pinctrl-0 = <0x5a 0x5b 0x5c 0x5d>;
		#address-cells = <0x1>;
		#size-cells = <0x0>;
		status = "disabled";
		phandle = <0x10b>;
	};

	thermal_zones: thermal-zones {
		phandle = <0x10c>;

		soc_thermal: soc-thermal {
			polling-delay-passive = <0x14>;
			polling-delay = <0x3e8>;
			sustainable-power = <0x3e8>;
			thermal-sensors = <0x5e 0x0>;
			phandle = <0x10d>;

			trips {

				threshold: trip-point-0 {
					temperature = <0x11170>;
					hysteresis = <0x7d0>;
					type = "passive";
					phandle = <0x10e>;
				};

				target: trip-point-1 {
					temperature = <0x14c08>;
					hysteresis = <0x7d0>;
					type = "passive";
					phandle = <0x5f>;
				};

				soc_crit: soc-crit {
					temperature = <0x17318>;
					hysteresis = <0x7d0>;
					type = "critical";
					phandle = <0x10f>;
				};
			};

			cooling-maps {

				map0 {
					trip = <0x5f>;
					cooling-device = <0x2 0xffffffff 0xffffffff>;
					contribution = <0x1000>;
				};

				map1 {
					trip = <0x5f>;
					cooling-device = <0x6 0xffffffff 0xffffffff>;
					contribution = <0x400>;
				};

				map2 {
					trip = <0x5f>;
					cooling-device = <0x60 0xffffffff 0xffffffff>;
					contribution = <0x1000>;
				};
			};
		};

		gpu_thermal: gpu-thermal {
			polling-delay-passive = <0x64>;
			polling-delay = <0x3e8>;
			thermal-sensors = <0x5e 0x1>;
			phandle = <0x110>;
		};
	};

	tsadc: tsadc@ff260000 {
		compatible = "rockchip,rk3399-tsadc";
		reg = <0x0 0xff260000 0x0 0x100>;
		interrupts = <0x0 0x61 0x4 0x0>;
		rockchip,grf = <0x15>;
		clocks = <0x8 0x4f 0x8 0x164>;
		clock-names = "tsadc", "apb_pclk";
		assigned-clocks = <0x8 0x4f>;
		assigned-clock-rates = <0xb71b0>;
		resets = <0x8 0xe8>;
		reset-names = "tsadc-apb";
		pinctrl-names = "init", "default", "sleep";
		pinctrl-0 = <0x61>;
		pinctrl-1 = <0x62>;
		pinctrl-2 = <0x61>;
		#thermal-sensor-cells = <0x1>;
		rockchip,hw-tshut-temp = <0x17318>;
		status = "okay";
		rockchip,hw-tshut-mode = <0x1>;
		rockchip,hw-tshut-polarity = <0x1>;
		phandle = <0x5e>;
	};

	qos_emmc: qos@ffa58000 {
		compatible = "syscon";
		reg = <0x0 0xffa58000 0x0 0x20>;
		phandle = <0x6a>;
	};

	qos_gmac: qos@ffa5c000 {
		compatible = "syscon";
		reg = <0x0 0xffa5c000 0x0 0x20>;
		phandle = <0x6b>;
	};

	qos_pcie: qos@ffa60080 {
		compatible = "syscon";
		reg = <0x0 0xffa60080 0x0 0x20>;
		phandle = <0x6d>;
	};

	qos_usb_host0: qos@ffa60100 {
		compatible = "syscon";
		reg = <0x0 0xffa60100 0x0 0x20>;
		phandle = <0x6e>;
	};

	qos_usb_host1: qos@ffa60180 {
		compatible = "syscon";
		reg = <0x0 0xffa60180 0x0 0x20>;
		phandle = <0x6f>;
	};

	qos_usb_otg0: qos@ffa70000 {
		compatible = "syscon";
		reg = <0x0 0xffa70000 0x0 0x20>;
		phandle = <0x72>;
	};

	qos_usb_otg1: qos@ffa70080 {
		compatible = "syscon";
		reg = <0x0 0xffa70080 0x0 0x20>;
		phandle = <0x73>;
	};

	qos_sd: qos@ffa74000 {
		compatible = "syscon";
		reg = <0x0 0xffa74000 0x0 0x20>;
		phandle = <0x70>;
	};

	qos_sdioaudio: qos@ffa76000 {
		compatible = "syscon";
		reg = <0x0 0xffa76000 0x0 0x20>;
		phandle = <0x71>;
	};

	qos_hdcp: qos@ffa90000 {
		compatible = "syscon";
		reg = <0x0 0xffa90000 0x0 0x20>;
		phandle = <0x74>;
	};

	qos_iep: qos@ffa98000 {
		compatible = "syscon";
		reg = <0x0 0xffa98000 0x0 0x20>;
		phandle = <0x63>;
	};

	qos_isp0_m0: qos@ffaa0000 {
		compatible = "syscon";
		reg = <0x0 0xffaa0000 0x0 0x20>;
		phandle = <0x75>;
	};

	qos_isp0_m1: qos@ffaa0080 {
		compatible = "syscon";
		reg = <0x0 0xffaa0080 0x0 0x20>;
		phandle = <0x76>;
	};

	qos_isp1_m0: qos@ffaa8000 {
		compatible = "syscon";
		reg = <0x0 0xffaa8000 0x0 0x20>;
		phandle = <0x77>;
	};

	qos_isp1_m1: qos@ffaa8080 {
		compatible = "syscon";
		reg = <0x0 0xffaa8080 0x0 0x20>;
		phandle = <0x78>;
	};

	qos_rga_r: qos@ffab0000 {
		compatible = "syscon";
		reg = <0x0 0xffab0000 0x0 0x20>;
		phandle = <0x64>;
	};

	qos_rga_w: qos@ffab0080 {
		compatible = "syscon";
		reg = <0x0 0xffab0080 0x0 0x20>;
		phandle = <0x65>;
	};

	qos_video_m0: qos@ffab8000 {
		compatible = "syscon";
		reg = <0x0 0xffab8000 0x0 0x20>;
		phandle = <0x66>;
	};

	qos_video_m1_r: qos@ffac0000 {
		compatible = "syscon";
		reg = <0x0 0xffac0000 0x0 0x20>;
		phandle = <0x67>;
	};

	qos_video_m1_w: qos@ffac0080 {
		compatible = "syscon";
		reg = <0x0 0xffac0080 0x0 0x20>;
		phandle = <0x68>;
	};

	qos_vop_big_r: qos@ffac8000 {
		compatible = "syscon";
		reg = <0x0 0xffac8000 0x0 0x20>;
		phandle = <0x79>;
	};

	qos_vop_big_w: qos@ffac8080 {
		compatible = "syscon";
		reg = <0x0 0xffac8080 0x0 0x20>;
		phandle = <0x7a>;
	};

	qos_vop_little: qos@ffad0000 {
		compatible = "syscon";
		reg = <0x0 0xffad0000 0x0 0x20>;
		phandle = <0x7b>;
	};

	qos_perihp: qos@ffad8080 {
		compatible = "syscon";
		reg = <0x0 0xffad8080 0x0 0x20>;
		phandle = <0x6c>;
	};

	qos_gpu: qos@ffae0000 {
		compatible = "syscon";
		reg = <0x0 0xffae0000 0x0 0x20>;
		phandle = <0x69>;
	};

	pmu: power-management@ff310000 {
		compatible = "rockchip,rk3399-pmu", "syscon", "simple-mfd";
		reg = <0x0 0xff310000 0x0 0x1000>;
		phandle = <0x111>;

		power: power-controller {
			compatible = "rockchip,rk3399-power-controller";
			#power-domain-cells = <0x1>;
			#address-cells = <0x1>;
			#size-cells = <0x0>;
			phandle = <0x16>;

			pd_iep@34 {
				reg = <0x22>;
				clocks = <0x8 0xe1 0x8 0x1dd>;
				pm_qos = <0x63>;
			};

			pd_rga@33 {
				reg = <0x21>;
				clocks = <0x8 0xdc 0x8 0x1e5>;
				pm_qos = <0x64 0x65>;
			};

			pd_vcodec@31 {
				reg = <0x1f>;
				clocks = <0x8 0xeb 0x8 0x1ea>;
				pm_qos = <0x66>;
			};

			pd_vdu@32 {
				reg = <0x20>;
				clocks = <0x8 0xed 0x8 0x1ec>;
				pm_qos = <0x67 0x68>;
			};

			pd_gpu@35 {
				reg = <0x23>;
				clocks = <0x8 0xd0>;
				pm_qos = <0x69>;
			};

			pd_edp@25 {
				reg = <0x19>;
				clocks = <0x8 0x16c>;
			};

			pd_emmc@23 {
				reg = <0x17>;
				clocks = <0x8 0xf0>;
				pm_qos = <0x6a>;
			};

			pd_gmac@22 {
				reg = <0x16>;
				clocks = <0x8 0xd5 0x8 0x166>;
				pm_qos = <0x6b>;
			};

			pd_perihp@14 {
				reg = <0xe>;
				#address-cells = <0x1>;
				#size-cells = <0x0>;
				clocks = <0x8 0xc0>;
				pm_qos = <0x6c 0x6d 0x6e 0x6f>;

				pd_sd@27 {
					reg = <0x1b>;
					clocks = <0x8 0x1ce 0x8 0x4c>;
					pm_qos = <0x70>;
				};
			};

			pd_sdioaudio@28 {
				reg = <0x1c>;
				clocks = <0x8 0x1ee>;
				pm_qos = <0x71>;
			};

			pd_usb3@24 {
				reg = <0x18>;
				clocks = <0x8 0xf4>;
				pm_qos = <0x72 0x73>;
			};

			pd_vio@15 {
				reg = <0xf>;
				#address-cells = <0x1>;
				#size-cells = <0x0>;

				pd_hdcp@21 {
					reg = <0x15>;
					clocks = <0x8 0xde 0x8 0x1e7 0x8 0x172>;
					pm_qos = <0x74>;
				};

				pd_isp0@19 {
					reg = <0x13>;
					clocks = <0x8 0xe5 0x8 0x1df>;
					pm_qos = <0x75 0x76>;
				};

				pd_isp1@20 {
					reg = <0x14>;
					clocks = <0x8 0xe6 0x8 0x1e0>;
					pm_qos = <0x77 0x78>;
				};

				pd_tcpc0@RK3399_PD_TCPC0 {
					reg = <0x8>;
					clocks = <0x8 0x7e 0x8 0x7d>;
				};

				pd_tcpc1@RK3399_PD_TCPC1 {
					reg = <0x9>;
					clocks = <0x8 0x80 0x8 0x7f>;
				};

				pd_vo@16 {
					reg = <0x10>;
					#address-cells = <0x1>;
					#size-cells = <0x0>;

					pd_vopb@17 {
						reg = <0x11>;
						clocks = <0x8 0xd9 0x8 0x1d9>;
						pm_qos = <0x79 0x7a>;
					};

					pd_vopl@18 {
						reg = <0x12>;
						clocks = <0x8 0xdb 0x8 0x1db>;
						pm_qos = <0x7b>;
					};
				};
			};
		};
	};

	pmugrf: syscon@ff320000 {
		compatible = "rockchip,rk3399-pmugrf", "syscon", "simple-mfd";
		reg = <0x0 0xff320000 0x0 0x1000>;
		#address-cells = <0x1>;
		#size-cells = <0x1>;
		phandle = <0x8b>;

		pmu_io_domains: io-domains {
			compatible = "rockchip,rk3399-pmu-io-voltage-domain";
			status = "okay";
			pmu1830-supply = <0x39>;
			phandle = <0x112>;
		};

		reboot-mode {
			compatible = "syscon-reboot-mode";
			offset = <0x300>;
			mode-bootloader = <0x5242c301>;
			mode-charge = <0x5242c30b>;
			mode-fastboot = <0x5242c309>;
			mode-loader = <0x5242c301>;
			mode-normal = <0x5242c300>;
			mode-recovery = <0x5242c303>;
			mode-ums = <0x5242c30c>;
		};

		pmu_pvtm: pmu-pvtm {
			compatible = "rockchip,rk3399-pmu-pvtm";
			clocks = <0x31 0x7>;
			clock-names = "pmu";
			resets = <0x8 0x1b>;
			reset-names = "pmu";
			status = "disabled";
			phandle = <0x113>;
		};
	};

	spi3: spi@ff350000 {
		compatible = "rockchip,rk3399-spi", "rockchip,rk3066-spi";
		reg = <0x0 0xff350000 0x0 0x1000>;
		clocks = <0x31 0x3 0x31 0x1f>;
		clock-names = "spiclk", "apb_pclk";
		interrupts = <0x0 0x3c 0x4 0x0>;
		pinctrl-names = "default";
		pinctrl-0 = <0x7c 0x7d 0x7e 0x7f>;
		#address-cells = <0x1>;
		#size-cells = <0x0>;
		status = "disabled";
		phandle = <0x114>;
	};

	uart4: serial@ff370000 {
		compatible = "rockchip,rk3399-uart", "snps,dw-apb-uart";
		reg = <0x0 0xff370000 0x0 0x100>;
		clocks = <0x31 0x6 0x31 0x22>;
		clock-names = "baudclk", "apb_pclk";
		interrupts = <0x0 0x66 0x4 0x0>;
		reg-shift = <0x2>;
		reg-io-width = <0x4>;
		pinctrl-names = "default";
		pinctrl-0 = <0x80>;
		status = "disabled";
		assigned-clocks = <0x31 0xc>;
		assigned-clock-parents = <0x31 0x1>;
		phandle = <0x115>;
	};

	i2c4: i2c@ff3d0000 {
		compatible = "rockchip,rk3399-i2c";
		reg = <0x0 0xff3d0000 0x0 0x1000>;
		clocks = <0x31 0xa 0x31 0x1c>;
		clock-names = "i2c", "pclk";
		interrupts = <0x0 0x38 0x4 0x0>;
		pinctrl-names = "default";
		pinctrl-0 = <0x81>;
		#address-cells = <0x1>;
		#size-cells = <0x0>;
		status = "okay";
		i2c-scl-rising-time-ns = <0x1db>;
		i2c-scl-falling-time-ns = <0x1a>;
		phandle = <0x116>;

		fusb0: fusb30x@22 {
			compatible = "fairchild,fusb302";
			reg = <0x22>;
			pinctrl-names = "default";
			pinctrl-0 = <0x82>;
			int-n-gpios = <0x35 0x2 0x0>;
			vbus-5v-gpios = <0x3d 0x15 0x0>;
			status = "okay";
			phandle = <0x28>;
		};

		gt1x: gt1x@14 {
			status = "okay";
			compatible = "goodix,gt1x";
			reg = <0x14>;
			goodix,rst-gpio = <0x3d 0x16 0x0>;
			goodix,irq-gpio = <0x35 0x14 0x8>;
			goodix,enable-gpio = <0x35 0xd 0x0>;
			phandle = <0x117>;
		};
	};

	i2c8: i2c@ff3e0000 {
		compatible = "rockchip,rk3399-i2c";
		reg = <0x0 0xff3e0000 0x0 0x1000>;
		clocks = <0x31 0xb 0x31 0x1d>;
		clock-names = "i2c", "pclk";
		interrupts = <0x0 0x3a 0x4 0x0>;
		pinctrl-names = "default";
		pinctrl-0 = <0x83>;
		#address-cells = <0x1>;
		#size-cells = <0x0>;
		status = "disabled";
		phandle = <0x118>;
	};

	pcie_phy: pcie-phy {
		compatible = "rockchip,rk3399-pcie-phy";
		#phy-cells = <0x0>;
		rockchip,grf = <0x15>;
		clocks = <0x8 0x8a>;
		clock-names = "refclk";
		resets = <0x8 0x87>;
		reset-names = "phy";
		status = "disabled";
		phandle = <0x86>;
	};

	pcie0: pcie@f8000000 {
		compatible = "rockchip,rk3399-pcie";
		#address-cells = <0x3>;
		#size-cells = <0x2>;
		aspm-no-l0s;
		clocks = <0x8 0xc5 0x8 0xc4 0x8 0x147 0x8 0xa0>;
		clock-names = "aclk", "aclk-perf", "hclk", "pm";
		bus-range = <0x0 0x1f>;
		max-link-speed = <0x1>;
		linux,pci-domain = <0x0>;
		msi-map = <0x0 0x84 0x0 0x1000>;
		interrupts = <0x0 0x31 0x4 0x0 0x0 0x32 0x4 0x0 0x0 0x33 0x4 0x0>;
		interrupt-names = "sys", "legacy", "client";
		#interrupt-cells = <0x1>;
		interrupt-map-mask = <0x0 0x0 0x0 0x7>;
		interrupt-map = <0x0 0x0 0x0 0x1 0x85 0x0 0x0 0x0 0x0 0x2 0x85 0x1 0x0 0x0 0x0 0x3 0x85 0x2 0x0 0x0 0x0 0x4 0x85 0x3>;
		phys = <0x86>;
		phy-names = "pcie-phy";
		ranges = <0x83000000 0x0 0xfa000000 0x0 0xfa000000 0x0 0x1e00000 0x81000000 0x0 0xfbe00000 0x0 0xfbe00000 0x0 0x100000>;
		reg = <0x0 0xf8000000 0x0 0x2000000 0x0 0xfd000000 0x0 0x1000000>;
		reg-names = "axi-base", "apb-base";
		resets = <0x8 0x82 0x8 0x83 0x8 0x84 0x8 0x85 0x8 0x86 0x8 0x81 0x8 0x80>;
		reset-names = "core", "mgmt", "mgmt-sticky", "pipe", "pm", "pclk", "aclk";
		status = "disabled";
		phandle = <0x119>;

		pcie0_intc: interrupt-controller {
			interrupt-controller;
			#address-cells = <0x0>;
			#interrupt-cells = <0x1>;
			phandle = <0x85>;
		};
	};

	pwm0: pwm@ff420000 {
		compatible = "rockchip,rk3399-pwm", "rockchip,rk3288-pwm";
		reg = <0x0 0xff420000 0x0 0x10>;
		#pwm-cells = <0x3>;
		pinctrl-names = "active";
		pinctrl-0 = <0x87>;
		clocks = <0x31 0x1e>;
		clock-names = "pwm";
		status = "okay";
		phandle = <0xcd>;
	};

	pwm1: pwm@ff420010 {
		compatible = "rockchip,rk3399-pwm", "rockchip,rk3288-pwm";
		reg = <0x0 0xff420010 0x0 0x10>;
		#pwm-cells = <0x3>;
		pinctrl-names = "active";
		pinctrl-0 = <0x88>;
		clocks = <0x31 0x1e>;
		clock-names = "pwm";
		status = "disabled";
		phandle = <0x11a>;
	};

	pwm2: pwm@ff420020 {
		compatible = "rockchip,rk3399-pwm", "rockchip,rk3288-pwm";
		reg = <0x0 0xff420020 0x0 0x10>;
		#pwm-cells = <0x3>;
		pinctrl-names = "active";
		pinctrl-0 = <0x89>;
		clocks = <0x31 0x1e>;
		clock-names = "pwm";
		status = "disabled";
		phandle = <0x11b>;
	};

	pwm3: pwm@ff420030 {
		compatible = "rockchip,rk3399-pwm", "rockchip,rk3288-pwm";
		reg = <0x0 0xff420030 0x0 0x10>;
		#pwm-cells = <0x3>;
		pinctrl-names = "active";
		pinctrl-0 = <0x8a>;
		clocks = <0x31 0x1e>;
		clock-names = "pwm";
		status = "disabled";
		phandle = <0x11c>;
	};

	dfi: dfi@ff630000 {
		reg = <0x0 0xff630000 0x0 0x4000>;
		compatible = "rockchip,rk3399-dfi";
		rockchip,pmu = <0x8b>;
		clocks = <0x8 0x179>;
		clock-names = "pclk_ddr_mon";
		status = "disabled";
		phandle = <0x8c>;
	};

	dmc: dmc {
		compatible = "rockchip,rk3399-dmc";
		devfreq-events = <0x8c>;
		interrupts = <0x0 0x1 0x4 0x0>;
		clocks = <0x8 0xaa>;
		clock-names = "dmc_clk";
		ddr_timing = <0x8d>;
		upthreshold = <0x28>;
		downdifferential = <0x14>;
		system-status-freq = <0x1 0xc3500 0x8 0x80e80 0x2 0x30d40 0x20 0x30d40 0x10 0x927c0 0x10000 0xc3500 0x2000 0xc3500 0x1000 0x61a80 0xc00 0x927c0 0x4000 0x927c0>;
		auto-min-freq = <0x30d40>;
		auto-freq-en = <0x1>;
		status = "disalbed";
		operating-points-v2 = <0x8e>;
		center-supply = <0x8f>;
		vop-bw-dmc-freq = <0x0 0x241 0x30d40 0x242 0x6a5 0x493e0 0x6a6 0x1869f 0x61a80>;
		phandle = <0xa9>;
	};

	vpu: vpu_service@ff650000 {
		compatible = "rockchip,vpu_service";
		rockchip,grf = <0x15>;
		iommus = <0x90>;
		iommu_enabled = <0x1>;
		reg = <0x0 0xff650000 0x0 0x800>;
		interrupts = <0x0 0x71 0x4 0x0 0x0 0x72 0x4 0x0>;
		interrupt-names = "irq_dec", "irq_enc";
		clocks = <0x8 0xeb 0x8 0x1ea>;
		clock-names = "aclk_vcodec", "hclk_vcodec";
		resets = <0x8 0x53 0x8 0x51>;
		reset-names = "video_h", "video_a";
		power-domains = <0x16 0x1f>;
		dev_mode = <0x0>;
		allocator = <0x1>;
		status = "okay";
		phandle = <0x11d>;
	};

	vpu_mmu: iommu@ff650800 {
		compatible = "rockchip,iommu";
		reg = <0x0 0xff650800 0x0 0x40>;
		interrupts = <0x0 0x73 0x4 0x0>;
		interrupt-names = "vpu_mmu";
		clocks = <0x8 0xeb 0x8 0x1ea>;
		clock-names = "aclk", "hclk";
		power-domains = <0x16 0x1f>;
		#iommu-cells = <0x0>;
		phandle = <0x90>;
	};

	rkvdec: rkvdec@ff660000 {
		compatible = "rockchip,rkvdec";
		rockchip,grf = <0x15>;
		iommus = <0x91>;
		iommu_enabled = <0x1>;
		reg = <0x0 0xff660000 0x0 0x400>;
		interrupts = <0x0 0x74 0x4 0x0>;
		interrupt-names = "irq_dec";
		clocks = <0x8 0xed 0x8 0x1ec 0x8 0x9f 0x8 0x9e>;
		clock-names = "aclk_vcodec", "hclk_vcodec", "clk_cabac", "clk_core";
		resets = <0x8 0x5b 0x8 0x59 0x8 0x5c 0x8 0x5d 0x8 0x58 0x8 0x5a>;
		reset-names = "video_h", "video_a", "video_core", "video_cabac", "niu_a", "niu_h";
		power-domains = <0x16 0x20>;
		dev_mode = <0x2>;
		allocator = <0x1>;
		status = "okay";
		phandle = <0x11e>;
	};

	vdec_mmu: iommu@ff660480 {
		compatible = "rockchip,iommu";
		reg = <0x0 0xff660480 0x0 0x40 0x0 0xff6604c0 0x0 0x40>;
		interrupts = <0x0 0x75 0x4 0x0>;
		interrupt-names = "vdec_mmu";
		clocks = <0x8 0xed 0x8 0x1ec>;
		clock-names = "aclk", "hclk";
		power-domains = <0x16 0x20>;
		#iommu-cells = <0x0>;
		phandle = <0x91>;
	};

	iep: iep@ff670000 {
		compatible = "rockchip,iep";
		iommu_enabled = <0x1>;
		iommus = <0x92>;
		reg = <0x0 0xff670000 0x0 0x800>;
		interrupts = <0x0 0x2a 0x4 0x0>;
		clocks = <0x8 0xe1 0x8 0x1dd>;
		clock-names = "aclk_iep", "hclk_iep";
		power-domains = <0x16 0x22>;
		allocator = <0x1>;
		version = <0x2>;
		status = "okay";
		phandle = <0x11f>;
	};

	iep_mmu: iommu@ff670800 {
		compatible = "rockchip,iommu";
		reg = <0x0 0xff670800 0x0 0x40>;
		interrupts = <0x0 0x2a 0x4 0x0>;
		interrupt-names = "iep_mmu";
		#iommu-cells = <0x0>;
		status = "okay";
		phandle = <0x92>;
	};

	rga: rga@ff680000 {
		compatible = "rockchip,rga2";
		reg = <0x0 0xff680000 0x0 0x1000>;
		interrupts = <0x0 0x37 0x4 0x0>;
		clocks = <0x8 0xdc 0x8 0x1e5 0x8 0x6d>;
		clock-names = "aclk_rga", "hclk_rga", "clk_rga";
		resets = <0x8 0x6a 0x8 0x67 0x8 0x69>;
		reset-names = "core", "axi", "ahb";
		power-domains = <0x16 0x21>;
		status = "okay";
		dev_mode = <0x1>;
		dma-coherent;
		phandle = <0x120>;
	};

	efuse0: efuse@ff690000 {
		compatible = "rockchip,rk3399-efuse";
		reg = <0x0 0xff690000 0x0 0x80>;
		#address-cells = <0x1>;
		#size-cells = <0x1>;
		clocks = <0x8 0x17d>;
		clock-names = "pclk_efuse";
		phandle = <0x121>;

		efuse_id: id@7 {
			reg = <0x7 0x10>;
			phandle = <0xd5>;
		};

		cpub_leakage: cpub-leakage@17 {
			reg = <0x17 0x1>;
			phandle = <0xc3>;
		};

		gpu_leakage: gpu-leakage@18 {
			reg = <0x18 0x1>;
			phandle = <0xc4>;
		};

		center_leakage: center-leakage@19 {
			reg = <0x19 0x1>;
			phandle = <0x122>;
		};

		cpul_leakage: cpul-leakage@1a {
			reg = <0x1a 0x1>;
			phandle = <0xc2>;
		};

		logic_leakage: logic-leakage@1b {
			reg = <0x1b 0x1>;
			phandle = <0x123>;
		};

		wafer_info: wafer-info@1c {
			reg = <0x1c 0x1>;
			phandle = <0x124>;
		};
	};

	pmucru: pmu-clock-controller@ff750000 {
		compatible = "rockchip,rk3399-pmucru";
		reg = <0x0 0xff750000 0x0 0x1000>;
		#clock-cells = <0x1>;
		#reset-cells = <0x1>;
		assigned-clocks = <0x31 0x1 0x31 0x2c>;
		assigned-clock-rates = <0x284af100 0x5c81a40>;
		phandle = <0x31>;
	};

	cru: clock-controller@ff760000 {
		compatible = "rockchip,rk3399-cru";
		reg = <0x0 0xff760000 0x0 0x1000>;
		#clock-cells = <0x1>;
		#reset-cells = <0x1>;
		assigned-clocks = <0x8 0xc0 0x8 0xc2 0x8 0x1c2 0x8 0x4c 0x8 0xf0 0x8 0xcd 0x8 0x1cd 0x8 0x9f 0x8 0x9e 0x8 0xf4 0x8 0xbe 0x8 0xc9 0x8 0x186 0x8 0xd5 0x8 0x88 0x8 0x87 0x8 0x8 0x8 0x9 0x8 0x6 0x8 0xd0 0x8 0x5 0x8 0xc0 0x8 0x1c0 0x8 0x140 0x8 0xc2 0x8 0x1c1 0x8 0x142 0x8 0x1c2 0x8 0x143 0x8 0x41 0x8 0x42 0x8 0x43 0x8 0x44 0x8 0x45 0x8 0x46 0x8 0x47 0x8 0x48 0x8 0x49 0x8 0x4a 0x8 0x4b 0x8 0xfa 0x8 0xe5 0x8 0xe6 0x8 0x6b 0x8 0x6c 0x8 0x16a 0x8 0xde 0x8 0xe3 0x8 0x1cd 0x8 0x85 0x8 0x86 0x8 0x4e 0x8 0xf0 0x8 0xcd 0x8 0xe1 0x8 0xdc 0x8 0x6d 0x8 0xed 0x8 0xeb 0x8 0x178 0x8 0xd5 0x8 0x9f 0x8 0x9e 0x8 0xf4 0x8 0xbe 0x8 0xc9 0x8 0x186 0x8 0x88 0x8 0x87 0x8 0xd9 0x8 0x1d9 0x8 0xdb 0x8 0x1db>;
		assigned-clock-rates = <0x47868c0 0x2faf080 0x2faf080 0x2faf080 0x2faf080 0x5f5e100 0x2faf080 0x8f0d180 0x8f0d180 0x8f0d180 0x2faf080 0x8f0d180 0x2faf080 0x5f5e100 0x47868c0 0x47868c0 0x30a32c00 0x30a32c00 0x23c34600 0xbebc200 0x2faf0800 0x8f0d180 0x47868c0 0x23c3460 0x5f5e100 0x5f5e100 0x2faf080 0x5f5e100 0x2faf080 0x5f5e100 0x5f5e100 0x5f5e100 0x5f5e100 0x5f5e100 0x5f5e100 0x2faf080 0x2faf080 0x2faf080 0x2faf080 0x2faf080 0xbebc200 0x17d78400 0x17d78400 0x5f5e100 0x5f5e100 0x5f5e100 0x17d78400 0x17d78400 0xbebc200 0x5f5e100 0xbebc200 0xbebc200 0x5f5e100 0x17d78400 0x17d78400 0x17d78400 0x17d78400 0x11e1a300 0x17d78400 0xbebc200 0x17d78400 0x11e1a300 0x11e1a300 0x11e1a300 0x11e1a300 0x11e1a300 0x5f5e100 0x8f0d180 0x8f0d180 0x17d78400 0x5f5e100 0x17d78400 0x5f5e100>;
		phandle = <0x8>;
	};

	grf: syscon@ff770000 {
		compatible = "rockchip,rk3399-grf", "syscon", "simple-mfd";
		reg = <0x0 0xff770000 0x0 0x10000>;
		#address-cells = <0x1>;
		#size-cells = <0x1>;
		phandle = <0x15>;

		io_domains: io-domains {
			compatible = "rockchip,rk3399-io-voltage-domain";
			status = "okay";
			bt656-supply = <0x39>;
			audio-supply = <0x93>;
			sdmmc-supply = <0x20>;
			gpio1830-supply = <0x39>;
			phandle = <0x125>;
		};

		emmc_phy: phy@f780 {
			compatible = "rockchip,rk3399-emmc-phy";
			reg = <0xf780 0x24>;
			clocks = <0x94>;
			clock-names = "emmcclk";
			#phy-cells = <0x0>;
			status = "okay";
			phandle = <0x25>;
		};

		u2phy0: usb2-phy@e450 {
			compatible = "rockchip,rk3399-usb2phy";
			reg = <0xe450 0x10>;
			clocks = <0x8 0x7b>;
			clock-names = "phyclk";
			#clock-cells = <0x0>;
			clock-output-names = "clk_usbphy0_480m";
			status = "okay";
			extcon = <0x28>;
			phandle = <0x126>;

			u2phy0_otg: otg-port {
				#phy-cells = <0x0>;
				interrupts = <0x0 0x67 0x4 0x0 0x0 0x68 0x4 0x0 0x0 0x6a 0x4 0x0>;
				interrupt-names = "otg-bvalid", "otg-id", "linestate";
				status = "okay";
				phandle = <0x29>;
			};

			u2phy0_host: host-port {
				#phy-cells = <0x0>;
				interrupts = <0x0 0x1b 0x4 0x0>;
				interrupt-names = "linestate";
				status = "okay";
				phy-supply = <0x2d>;
				phandle = <0x26>;
			};
		};

		u2phy1: usb2-phy@e460 {
			compatible = "rockchip,rk3399-usb2phy";
			reg = <0xe460 0x10>;
			clocks = <0x8 0x7c>;
			clock-names = "phyclk";
			#clock-cells = <0x0>;
			clock-output-names = "clk_usbphy1_480m";
			status = "okay";
			phandle = <0x127>;

			u2phy1_otg: otg-port {
				#phy-cells = <0x0>;
				interrupts = <0x0 0x6c 0x4 0x0 0x0 0x6d 0x4 0x0 0x0 0x6f 0x4 0x0>;
				interrupt-names = "otg-bvalid", "otg-id", "linestate";
				status = "okay";
				phandle = <0x2b>;
			};

			u2phy1_host: host-port {
				#phy-cells = <0x0>;
				interrupts = <0x0 0x1f 0x4 0x0>;
				interrupt-names = "linestate";
				status = "okay";
				phy-supply = <0x2d>;
				phandle = <0x27>;
			};
		};

		mipi_dphy_rx0: mipi-dphy-rx0 {
			compatible = "rockchip,rk3399-mipi-dphy";
			clocks = <0x8 0x77 0x8 0xa5 0x8 0x16f>;
			clock-names = "dphy-ref", "dphy-cfg", "grf";
			power-domains = <0x16 0xf>;
			status = "disabled";
			phandle = <0x128>;
		};

		pvtm: pvtm {
			compatible = "rockchip,rk3399-pvtm";
			clocks = <0x8 0x73 0x8 0x74 0x8 0x75 0x8 0x76>;
			clock-names = "core_l", "core_b", "gpu", "ddr";
			resets = <0x8 0x1f 0x8 0x2f 0x8 0x123 0x8 0x4f>;
			reset-names = "core_l", "core_b", "gpu", "ddr";
			status = "okay";
			phandle = <0x129>;
		};
	};

	tcphy0: phy@ff7c0000 {
		compatible = "rockchip,rk3399-typec-phy";
		reg = <0x0 0xff7c0000 0x0 0x40000>;
		rockchip,grf = <0x15>;
		#phy-cells = <0x1>;
		clocks = <0x8 0x7e 0x8 0x7d>;
		clock-names = "tcpdcore", "tcpdphy-ref";
		assigned-clocks = <0x8 0x7e>;
		assigned-clock-rates = <0x2faf080>;
		power-domains = <0x16 0x8>;
		resets = <0x8 0x95 0x8 0x94 0x8 0x14c>;
		reset-names = "uphy", "uphy-pipe", "uphy-tcphy";
		rockchip,typec-conn-dir = <0xe580 0x0 0x10>;
		rockchip,usb3tousb2-en = <0xe580 0x3 0x13>;
		rockchip,usb3-host-disable = <0x2434 0x0 0x10>;
		rockchip,usb3-host-port = <0x2434 0xc 0x1c>;
		rockchip,external-psm = <0xe588 0xe 0x1e>;
		rockchip,pipe-status = <0xe5c0 0x0 0x0>;
		rockchip,uphy-dp-sel = <0x6268 0x13 0x13>;
		status = "okay";
		extcon = <0x28>;
		phandle = <0x12a>;

		tcphy0_dp: dp-port {
			#phy-cells = <0x0>;
			phandle = <0x2e>;
		};

		tcphy0_usb3: usb3-port {
			#phy-cells = <0x0>;
			phandle = <0x2a>;
		};
	};

	tcphy1: phy@ff800000 {
		compatible = "rockchip,rk3399-typec-phy";
		reg = <0x0 0xff800000 0x0 0x40000>;
		rockchip,grf = <0x15>;
		#phy-cells = <0x1>;
		clocks = <0x8 0x80 0x8 0x7f>;
		clock-names = "tcpdcore", "tcpdphy-ref";
		assigned-clocks = <0x8 0x80>;
		assigned-clock-rates = <0x2faf080>;
		power-domains = <0x16 0x9>;
		resets = <0x8 0x9d 0x8 0x9c 0x8 0x14d>;
		reset-names = "uphy", "uphy-pipe", "uphy-tcphy";
		rockchip,typec-conn-dir = <0xe58c 0x0 0x10>;
		rockchip,usb3tousb2-en = <0xe58c 0x3 0x13>;
		rockchip,usb3-host-disable = <0x2444 0x0 0x10>;
		rockchip,usb3-host-port = <0x2444 0xc 0x1c>;
		rockchip,external-psm = <0xe594 0xe 0x1e>;
		rockchip,pipe-status = <0xe5c0 0x10 0x10>;
		rockchip,uphy-dp-sel = <0x6268 0x3 0x13>;
		status = "okay";
		phandle = <0x12b>;

		tcphy1_dp: dp-port {
			#phy-cells = <0x0>;
			phandle = <0x12c>;
		};

		tcphy1_usb3: usb3-port {
			#phy-cells = <0x0>;
			phandle = <0x2c>;
		};
	};

	watchdog@ff848000 {
		compatible = "snps,dw-wdt";
		reg = <0x0 0xff848000 0x0 0x100>;
		clocks = <0x8 0x17c>;
		interrupts = <0x0 0x78 0x4 0x0>;
	};

	rktimer: rktimer@ff850000 {
		compatible = "rockchip,rk3399-timer";
		reg = <0x0 0xff850000 0x0 0x1000>;
		interrupts = <0x0 0x51 0x4 0x0>;
		clocks = <0x8 0x168 0x8 0x5a>;
		clock-names = "pclk", "timer";
		phandle = <0x12d>;
	};

	spdif: spdif@ff870000 {
		compatible = "rockchip,rk3399-spdif";
		reg = <0x0 0xff870000 0x0 0x1000>;
		interrupts = <0x0 0x42 0x4 0x0>;
		dmas = <0x95 0x7>;
		dma-names = "tx";
		clock-names = "mclk", "hclk";
		clocks = <0x8 0x55 0x8 0x1d7>;
		pinctrl-names = "default";
		pinctrl-0 = <0x96>;
		power-domains = <0x16 0x1c>;
		status = "disabled";
		assigned-clocks = <0x8 0xb1>;
		assigned-clock-parents = <0x8 0x5>;
		phandle = <0x12e>;
	};

	i2s0: i2s@ff880000 {
		compatible = "rockchip,rk3399-i2s", "rockchip,rk3066-i2s";
		reg = <0x0 0xff880000 0x0 0x1000>;
		rockchip,grf = <0x15>;
		interrupts = <0x0 0x27 0x4 0x0>;
		dmas = <0x95 0x0 0x95 0x1>;
		dma-names = "tx", "rx";
		clock-names = "i2s_clk", "i2s_hclk";
		clocks = <0x8 0x56 0x8 0x1d4>;
		pinctrl-names = "default";
		pinctrl-0 = <0x97>;
		power-domains = <0x16 0x1c>;
		status = "okay";
		rockchip,i2s-broken-burst-len;
		rockchip,playback-channels = <0x8>;
		rockchip,capture-channels = <0x8>;
		#sound-dai-cells = <0x0>;
		assigned-clocks = <0x8 0xae>;
		assigned-clock-parents = <0x8 0x5>;
		phandle = <0xd4>;
	};

	i2s1: i2s@ff890000 {
		compatible = "rockchip,rk3399-i2s", "rockchip,rk3066-i2s";
		reg = <0x0 0xff890000 0x0 0x1000>;
		interrupts = <0x0 0x28 0x4 0x0>;
		dmas = <0x95 0x2 0x95 0x3>;
		dma-names = "tx", "rx";
		clock-names = "i2s_clk", "i2s_hclk";
		clocks = <0x8 0x57 0x8 0x1d5>;
		pinctrl-names = "default";
		pinctrl-0 = <0x98>;
		power-domains = <0x16 0x1c>;
		status = "okay";
		rockchip,i2s-broken-burst-len;
		rockchip,playback-channels = <0x2>;
		rockchip,capture-channels = <0x2>;
		#sound-dai-cells = <0x0>;
		assigned-clocks = <0x8 0x109>;
		assigned-clock-parents = <0x8 0x57>;
		phandle = <0xd1>;
	};

	i2s2: i2s@ff8a0000 {
		compatible = "rockchip,rk3399-i2s", "rockchip,rk3066-i2s";
		reg = <0x0 0xff8a0000 0x0 0x1000>;
		interrupts = <0x0 0x29 0x4 0x0>;
		dmas = <0x95 0x4 0x95 0x5>;
		dma-names = "tx", "rx";
		clock-names = "i2s_clk", "i2s_hclk";
		clocks = <0x8 0x58 0x8 0x1d6>;
		power-domains = <0x16 0x1c>;
		status = "okay";
		#sound-dai-cells = <0x0>;
		assigned-clocks = <0x8 0xb0>;
		assigned-clock-parents = <0x8 0x5>;
		rockchip,bclk-fs = <0x80>;
		phandle = <0xdc>;
	};

	gpu: gpu@ff9a0000 {
		compatible = "arm,malit860", "arm,malit86x", "arm,malit8xx", "arm,mali-midgard";
		reg = <0x0 0xff9a0000 0x0 0x10000>;
		interrupts = <0x0 0x13 0x4 0x0 0x0 0x14 0x4 0x0 0x0 0x15 0x4 0x0>;
		interrupt-names = "GPU", "JOB", "MMU";
		clocks = <0x8 0xd0>;
		clock-names = "clk_mali";
		#cooling-cells = <0x2>;
		power-domains = <0x16 0x23>;
		power-off-delay-ms = <0xc8>;
		status = "okay";
		operating-points-v2 = <0x99>;
		mali-supply = <0x9a>;
		phandle = <0x60>;

		gpu_power_model: power_model {
			compatible = "arm,mali-simple-power-model";
			static-coefficient = <0x64578>;
			dynamic-coefficient = <0x2dd>;
			ts = <0x7d00 0x125c 0xffffffb0 0x2>;
			thermal-zone = "gpu-thermal";
			phandle = <0x12f>;
		};
	};

	vopl: vop@ff8f0000 {
		compatible = "rockchip,rk3399-vop-lit";
		reg = <0x0 0xff8f0000 0x0 0x600 0x0 0xff8f1c00 0x0 0x200 0x0 0xff8f2000 0x0 0x400>;
		reg-names = "regs", "cabc_lut", "gamma_lut";
		interrupts = <0x0 0x77 0x4 0x0>;
		clocks = <0x8 0xdb 0x8 0xb5 0x8 0x1db 0x8 0xb7>;
		clock-names = "aclk_vop", "dclk_vop", "hclk_vop", "dclk_source";
		resets = <0x8 0x113 0x8 0x117 0x8 0x119>;
		reset-names = "axi", "ahb", "dclk";
		power-domains = <0x16 0x12>;
		iommus = <0x9b>;
		status = "okay";
		phandle = <0x130>;

		vopl_out: port {
			#address-cells = <0x1>;
			#size-cells = <0x0>;
			phandle = <0xba>;

			vopl_out_dsi: endpoint@0 {
				reg = <0x0>;
				remote-endpoint = <0x9c>;
				phandle = <0xb1>;
			};

			vopl_out_edp: endpoint@1 {
				reg = <0x1>;
				remote-endpoint = <0x9d>;
				phandle = <0xb8>;
			};

			vopl_out_hdmi: endpoint@2 {
				reg = <0x2>;
				remote-endpoint = <0x9e>;
				phandle = <0xaf>;
			};

			vopl_out_dp: endpoint@3 {
				reg = <0x3>;
				remote-endpoint = <0x9f>;
				phandle = <0x30>;
			};

			vopl_out_dsi1: endpoint@4 {
				reg = <0x4>;
				remote-endpoint = <0xa0>;
				phandle = <0xb5>;
			};
		};
	};

	vop1_pwm: voppwm@ff8f01a0 {
		compatible = "rockchip,vop-pwm";
		reg = <0x0 0xff8f01a0 0x0 0x10>;
		#pwm-cells = <0x3>;
		pinctrl-names = "active";
		pinctrl-0 = <0xa1>;
		clocks = <0x8 0x6c>;
		clock-names = "pwm";
		status = "disabled";
		phandle = <0x131>;
	};

	vopl_mmu: iommu@ff8f3f00 {
		compatible = "rockchip,iommu";
		reg = <0x0 0xff8f3f00 0x0 0x100>;
		interrupts = <0x0 0x77 0x4 0x0>;
		interrupt-names = "vopl_mmu";
		clocks = <0x8 0xdb 0x8 0x1db>;
		clock-names = "aclk", "hclk";
		power-domains = <0x16 0x12>;
		#iommu-cells = <0x0>;
		status = "okay";
		phandle = <0x9b>;
	};

	vopb: vop@ff900000 {
		compatible = "rockchip,rk3399-vop-big";
		reg = <0x0 0xff900000 0x0 0x600 0x0 0xff901c00 0x0 0x200 0x0 0xff902000 0x0 0x1000>;
		reg-names = "regs", "cabc_lut", "gamma_lut";
		interrupts = <0x0 0x76 0x4 0x0>;
		clocks = <0x8 0xd9 0x8 0xb4 0x8 0x1d9 0x8 0xb6>;
		clock-names = "aclk_vop", "dclk_vop", "hclk_vop", "dclk_source";
		resets = <0x8 0x112 0x8 0x116 0x8 0x118>;
		reset-names = "axi", "ahb", "dclk";
		power-domains = <0x16 0x11>;
		iommus = <0xa2>;
		status = "okay";
		phandle = <0x132>;

		vopb_out: port {
			#address-cells = <0x1>;
			#size-cells = <0x0>;
			phandle = <0xb9>;

			vopb_out_edp: endpoint@0 {
				reg = <0x0>;
				remote-endpoint = <0xa3>;
				phandle = <0xb7>;
			};

			vopb_out_dsi: endpoint@1 {
				reg = <0x1>;
				remote-endpoint = <0xa4>;
				phandle = <0xb0>;
			};

			vopb_out_hdmi: endpoint@2 {
				reg = <0x2>;
				remote-endpoint = <0xa5>;
				phandle = <0xae>;
			};

			vopb_out_dp: endpoint@3 {
				reg = <0x3>;
				remote-endpoint = <0xa6>;
				phandle = <0x2f>;
			};

			vopb_out_dsi1: endpoint@4 {
				reg = <0x4>;
				remote-endpoint = <0xa7>;
				phandle = <0xb4>;
			};
		};
	};

	vop0_pwm: voppwm@ff9001a0 {
		compatible = "rockchip,vop-pwm";
		reg = <0x0 0xff9001a0 0x0 0x10>;
		#pwm-cells = <0x3>;
		pinctrl-names = "active";
		pinctrl-0 = <0xa8>;
		clocks = <0x8 0x6b>;
		clock-names = "pwm";
		status = "disabled";
		phandle = <0x133>;
	};

	vopb_mmu: iommu@ff903f00 {
		compatible = "rockchip,iommu";
		reg = <0x0 0xff903f00 0x0 0x100>;
		interrupts = <0x0 0x76 0x4 0x0>;
		interrupt-names = "vopb_mmu";
		clocks = <0x8 0xd9 0x8 0x1d9>;
		clock-names = "aclk", "hclk";
		power-domains = <0x16 0x11>;
		#iommu-cells = <0x0>;
		status = "okay";
		phandle = <0xa2>;
	};

	rkisp1_0: rkisp1@ff910000 {
		compatible = "rockchip,rk3399-rkisp1";
		reg = <0x0 0xff910000 0x0 0x4000>;
		interrupts = <0x0 0x2b 0x4 0x0>;
		clocks = <0x8 0x6e 0x8 0xe5 0x8 0x1df 0x8 0xe9 0x8 0x1e3>;
		clock-names = "clk_isp", "aclk_isp", "hclk_isp", "aclk_isp_wrap", "hclk_isp_wrap";
		devfreq = <0xa9>;
		power-domains = <0x16 0x13>;
		iommus = <0xaa>;
		status = "disabled";
		phandle = <0x134>;
	};

	isp0_mmu: iommu@ff914000 {
		compatible = "rockchip,iommu";
		reg = <0x0 0xff914000 0x0 0x100 0x0 0xff915000 0x0 0x100>;
		interrupts = <0x0 0x2b 0x4 0x0>;
		interrupt-names = "isp0_mmu";
		#iommu-cells = <0x0>;
		clocks = <0x8 0xe9 0x8 0x1e3>;
		clock-names = "aclk", "hclk";
		power-domains = <0x16 0x13>;
		rk_iommu,disable_reset_quirk;
		status = "okay";
		phandle = <0xaa>;
	};

	rkisp1_1: rkisp1@ff920000 {
		compatible = "rockchip,rk3399-rkisp1";
		reg = <0x0 0xff920000 0x0 0x4000>;
		interrupts = <0x0 0x2c 0x4 0x0>;
		clocks = <0x8 0x6f 0x8 0xe6 0x8 0x1e0 0x8 0xea 0x8 0x1e4 0x8 0x17b>;
		clock-names = "clk_isp", "aclk_isp", "hclk_isp", "aclk_isp_wrap", "hclk_isp_wrap", "pclk_isp_wrap";
		devfreq = <0xa9>;
		power-domains = <0x16 0x14>;
		iommus = <0xab>;
		status = "disabled";
		phandle = <0x135>;
	};

	isp1_mmu: iommu@ff924000 {
		compatible = "rockchip,iommu";
		reg = <0x0 0xff924000 0x0 0x100 0x0 0xff925000 0x0 0x100>;
		interrupts = <0x0 0x2c 0x4 0x0>;
		interrupt-names = "isp1_mmu";
		#iommu-cells = <0x0>;
		clocks = <0x8 0xea 0x8 0x1e4>;
		clock-names = "aclk", "hclk";
		power-domains = <0x16 0x14>;
		rk_iommu,disable_reset_quirk;
		status = "okay";
		phandle = <0xab>;
	};

	hdmi: hdmi@ff940000 {
		compatible = "rockchip,rk3399-dw-hdmi";
		reg = <0x0 0xff940000 0x0 0x20000>;
		reg-io-width = <0x4>;
		rockchip,grf = <0x15>;
		pinctrl-names = "default";
		pinctrl-0 = <0xac 0xad>;
		power-domains = <0x16 0x15>;
		interrupts = <0x0 0x17 0x4 0x0>;
		clocks = <0x8 0x174 0x8 0x71 0x8 0x7 0x8 0x16f 0x8 0x70>;
		clock-names = "iahb", "isfr", "vpll", "grf", "cec";
		status = "okay";
		#address-cells = <0x1>;
		#size-cells = <0x0>;
		#sound-dai-cells = <0x0>;
		ddc-i2c-scl-high-time-ns = <0x2599>;
		ddc-i2c-scl-low-time-ns = <0x2710>;
		phandle = <0xdd>;

		ports {

			hdmi_in: port {
				#address-cells = <0x1>;
				#size-cells = <0x0>;
				phandle = <0x136>;

				hdmi_in_vopb: endpoint@0 {
					reg = <0x0>;
					remote-endpoint = <0xae>;
					phandle = <0xa5>;
				};

				hdmi_in_vopl: endpoint@1 {
					reg = <0x1>;
					remote-endpoint = <0xaf>;
					phandle = <0x9e>;
				};
			};
		};
	};

	dsi: dsi@ff960000 {
		compatible = "rockchip,rk3399-mipi-dsi";
		reg = <0x0 0xff960000 0x0 0x8000>;
		interrupts = <0x0 0x2d 0x4 0x0>;
		clocks = <0x8 0xa2 0x8 0x170 0x8 0xa3>;
		clock-names = "ref", "pclk", "phy_cfg";
		resets = <0x8 0xfb>;
		reset-names = "apb";
		power-domains = <0x16 0xf>;
		rockchip,grf = <0x15>;
		#address-cells = <0x1>;
		#size-cells = <0x0>;
		status = "okay";
		phandle = <0x137>;

		ports {

			port {
				#address-cells = <0x1>;
				#size-cells = <0x0>;

				dsi_in_vopb: endpoint@0 {
					reg = <0x0>;
					remote-endpoint = <0xb0>;
					status = "okay";
					phandle = <0xa4>;
				};

				dsi_in_vopl: endpoint@1 {
					reg = <0x1>;
					remote-endpoint = <0xb1>;
					status = "okay";
					phandle = <0x9c>;
				};
			};
		};

		panel@0 {
			compatible = "sitronix,st7703", "simple-panel-dsi";
			status = "okay";
			reg = <0x0>;
			backlight = <0xb2>;
			prepare-delay-ms = <0x2>;
			reset-delay-ms = <0x1>;
			init-delay-ms = <0x14>;
			enable-delay-ms = <0x78>;
			disable-delay-ms = <0x32>;
			unprepare-delay-ms = <0x14>;
			enable-gpios = <0x35 0xd 0x0>;
			width-mm = <0x44>;
			height-mm = <0x79>;
			dsi,flags = <0xa03>;
			dsi,format = <0x0>;
			dsi,lanes = <0x4>;
			panel-init-sequence = [05 fa 01 11 39 00 04 b9 f1 12 83 39 00 1c ba 33 81 05 f9 0e 0e 00 00 00 00 00 00 00 00 44 25 00 91 0a 00 00 02 4f 01 00 00 37 15 00 02 b8 25 39 00 04 bf 02 11 00 39 00 0b b3 0c 10 0a 50 03 ff 00 00 00 00 39 00 0a c0 73 73 50 50 00 00 08 70 00 15 00 02 bc 46 15 00 02 cc 0b 15 00 02 b4 80 39 00 04 b2 c8 12 30 39 00 0f e3 07 07 0b 0b 03 0b 00 00 00 00 ff 00 c0 10 39 00 0d c1 53 00 1e 1e 77 e1 cc dd 67 77 33 33 39 00 07 c6 00 00 ff ff 01 ff 39 00 03 b5 09 09 39 00 03 b6 87 95 39 00 40 e9 c2 10 05 05 10 05 a0 12 31 23 3f 81 0a a0 37 18 00 80 01 00 00 00 00 80 01 00 00 00 48 f8 86 42 08 88 88 80 88 88 88 58 f8 87 53 18 88 88 81 88 88 88 00 00 00 01 00 00 00 00 00 00 00 00 00 39 00 3e ea 00 1a 00 00 00 00 02 00 00 00 00 00 1f 88 81 35 78 88 88 85 88 88 88 0f 88 80 24 68 88 88 84 88 88 88 23 10 00 00 1c 00 00 00 00 00 00 00 00 00 00 00 00 00 00 00 30 05 a0 00 00 00 00 39 00 23 e0 00 06 08 2a 31 3f 38 36 07 0c 0d 11 13 12 13 11 18 00 06 08 2a 31 3f 38 36 07 0c 0d 11 13 12 13 11 18 05 32 01 29];
			panel-exit-sequence = <0x5000128 0x5000110>;

			display-timings {
				native-mode = <0xb3>;

				timing0: timing0 {
					clock-frequency = <0x3d09000>;
					hactive = <0x2d0>;
					vactive = <0x500>;
					hfront-porch = <0x28>;
					hsync-len = <0xa>;
					hback-porch = <0x28>;
					vfront-porch = <0x16>;
					vsync-len = <0x4>;
					vback-porch = <0xb>;
					hsync-active = <0x0>;
					vsync-active = <0x0>;
					de-active = <0x0>;
					pixelclk-active = <0x0>;
					phandle = <0xb3>;
				};
			};
		};
	};

	dsi1: dsi@ff968000 {
		compatible = "rockchip,rk3399-mipi-dsi";
		reg = <0x0 0xff968000 0x0 0x8000>;
		interrupts = <0x0 0x2e 0x4 0x0>;
		clocks = <0x8 0xa2 0x8 0x171 0x8 0xa4>;
		clock-names = "ref", "pclk", "phy_cfg";
		resets = <0x8 0xfc>;
		reset-names = "apb";
		power-domains = <0x16 0xf>;
		rockchip,grf = <0x15>;
		#address-cells = <0x1>;
		#size-cells = <0x0>;
		status = "disabled";
		phandle = <0x138>;

		ports {

			port {
				#address-cells = <0x1>;
				#size-cells = <0x0>;

				dsi1_in_vopb: endpoint@0 {
					reg = <0x0>;
					remote-endpoint = <0xb4>;
					phandle = <0xa7>;
				};

				dsi1_in_vopl: endpoint@1 {
					reg = <0x1>;
					remote-endpoint = <0xb5>;
					phandle = <0xa0>;
				};
			};
		};
	};

	mipi_dphy_tx1rx1: mipi-dphy-tx1rx1@0xff968000 {
		compatible = "rockchip,rk3399-mipi-dphy";
		reg = <0x0 0xff968000 0x0 0x8000>;
		clocks = <0x8 0x77 0x8 0xa4 0x8 0x16f 0x8 0x171>;
		clock-names = "dphy-ref", "dphy-cfg", "grf", "pclk_mipi_dsi";
		rockchip,grf = <0x15>;
		power-domains = <0x16 0xf>;
		status = "disabled";
		phandle = <0x139>;
	};

	edp: edp@ff970000 {
		compatible = "rockchip,rk3399-edp";
		reg = <0x0 0xff970000 0x0 0x8000>;
		interrupts = <0x0 0xa 0x4 0x0>;
		clocks = <0x8 0x16a 0x8 0x16c>;
		clock-names = "dp", "pclk";
		power-domains = <0x16 0x19>;
		resets = <0x8 0x11d>;
		reset-names = "dp";
		rockchip,grf = <0x15>;
		status = "disabled";
		pinctrl-names = "default";
		pinctrl-0 = <0xb6>;
		phandle = <0x13a>;

		ports {
			#address-cells = <0x1>;
			#size-cells = <0x0>;

			edp_in: port@0 {
				reg = <0x0>;
				#address-cells = <0x1>;
				#size-cells = <0x0>;
				phandle = <0x13b>;

				edp_in_vopb: endpoint@0 {
					reg = <0x0>;
					remote-endpoint = <0xb7>;
					phandle = <0xa3>;
				};

				edp_in_vopl: endpoint@1 {
					reg = <0x1>;
					remote-endpoint = <0xb8>;
					phandle = <0x9d>;
				};
			};
		};
	};

	hdmi_hdcp2: hdmi-hdcp2@ff988000 {
		compatible = "rockchip,rk3399-hdmi-hdcp2";
		reg = <0x0 0xff988000 0x0 0x2000>;
		interrupts = <0x0 0x16 0x4 0x0>;
		clocks = <0x8 0xe0 0x8 0x176 0x8 0x1e9>;
		clock-names = "aclk_hdcp2", "pclk_hdcp2", "hdcp2_clk_hdmi";
		status = "disabled";
		phandle = <0x13c>;
	};

	display_subsystem: display-subsystem {
		compatible = "rockchip,display-subsystem";
		ports = <0xb9 0xba>;
		clocks = <0x8 0x7 0x8 0x4>;
		clock-names = "hdmi-tmds-pll", "default-vop-pll";
		devfreq = <0xa9>;
		status = "okay";
		logo-memory-region = <0xbb>;
		secure-memory-region = <0xbc>;
		phandle = <0x13d>;

		route {

			route_hdmi: route-hdmi {
				status = "disabled";
				logo,uboot = "logo.bmp";
				logo,kernel = "logo_kernel.bmp";
				logo,mode = "center";
				charge_logo,mode = "center";
				connect = <0xae>;
				phandle = <0x13e>;
			};

			route_dsi: route-dsi {
				status = "okay";
				logo,uboot = "logo.bmp";
				logo,kernel = "logo_kernel.bmp";
				logo,mode = "center";
				charge_logo,mode = "center";
				connect = <0xb0>;
				phandle = <0x13f>;
			};

			route_dsi1: route-dsi1 {
				status = "disabled";
				logo,uboot = "logo.bmp";
				logo,kernel = "logo_kernel.bmp";
				logo,mode = "center";
				charge_logo,mode = "center";
				connect = <0xb5>;
				phandle = <0x140>;
			};

			route_edp: route-edp {
				status = "disabled";
				logo,uboot = "logo.bmp";
				logo,kernel = "logo_kernel.bmp";
				logo,mode = "center";
				charge_logo,mode = "center";
				connect = <0xb7>;
				phandle = <0x141>;
			};
		};
	};

	nocp_cci_msch0: nocp-cci-msch0@ffa86000 {
		compatible = "rockchip,rk3399-nocp";
		reg = <0x0 0xffa86000 0x0 0x400>;
		phandle = <0x142>;
	};

	nocp_gpu_msch0: nocp-gpu-msch0@ffa86400 {
		compatible = "rockchip,rk3399-nocp";
		reg = <0x0 0xffa86400 0x0 0x400>;
		phandle = <0x143>;
	};

	nocp_hp_msch0: nocp-hp-msch0@ffa86800 {
		compatible = "rockchip,rk3399-nocp";
		reg = <0x0 0xffa86800 0x0 0x400>;
		phandle = <0x144>;
	};

	nocp_lp_msch0: nocp-lp-msch0@ffa86c00 {
		compatible = "rockchip,rk3399-nocp";
		reg = <0x0 0xffa86c00 0x0 0x400>;
		phandle = <0x145>;
	};

	nocp_video_msch0: nocp-video-msch0@ffa87000 {
		compatible = "rockchip,rk3399-nocp";
		reg = <0x0 0xffa87000 0x0 0x400>;
		phandle = <0x146>;
	};

	nocp_vio0_msch0: nocp-vio0-msch0@ffa87400 {
		compatible = "rockchip,rk3399-nocp";
		reg = <0x0 0xffa87400 0x0 0x400>;
		phandle = <0x147>;
	};

	nocp_vio1_msch0: nocp-vio1-msch0@ffa87800 {
		compatible = "rockchip,rk3399-nocp";
		reg = <0x0 0xffa87800 0x0 0x400>;
		phandle = <0x148>;
	};

	nocp_cci_msch1: nocp-cci-msch1@ffa8e000 {
		compatible = "rockchip,rk3399-nocp";
		reg = <0x0 0xffa8e000 0x0 0x400>;
		phandle = <0x149>;
	};

	nocp_gpu_msch1: nocp-gpu-msch1@ffa8e400 {
		compatible = "rockchip,rk3399-nocp";
		reg = <0x0 0xffa8e400 0x0 0x400>;
		phandle = <0x14a>;
	};

	nocp_hp_msch1: nocp-hp-msch1@ffa8e800 {
		compatible = "rockchip,rk3399-nocp";
		reg = <0x0 0xffa8e800 0x0 0x400>;
		phandle = <0x14b>;
	};

	nocp_lp_msch1: nocp-lp-msch1@ffa8ec00 {
		compatible = "rockchip,rk3399-nocp";
		reg = <0x0 0xffa8ec00 0x0 0x400>;
		phandle = <0x14c>;
	};

	nocp_video_msch1: nocp-video-msch1@ffa8f000 {
		compatible = "rockchip,rk3399-nocp";
		reg = <0x0 0xffa8f000 0x0 0x400>;
		phandle = <0x14d>;
	};

	nocp_vio0_msch1: nocp-vio0-msch1@ffa8f400 {
		compatible = "rockchip,rk3399-nocp";
		reg = <0x0 0xffa8f400 0x0 0x400>;
		phandle = <0x14e>;
	};

	nocp_vio1_msch1: nocp-vio1-msch1@ffa8f800 {
		compatible = "rockchip,rk3399-nocp";
		reg = <0x0 0xffa8f800 0x0 0x400>;
		phandle = <0x14f>;
	};

	pinctrl: pinctrl {
		compatible = "rockchip,rk3399-pinctrl";
		rockchip,grf = <0x15>;
		rockchip,pmu = <0x8b>;
		#address-cells = <0x2>;
		#size-cells = <0x2>;
		ranges;
		phandle = <0x150>;

		gpio0: gpio0@ff720000 {
			compatible = "rockchip,gpio-bank";
			reg = <0x0 0xff720000 0x0 0x100>;
			clocks = <0x31 0x17>;
			interrupts = <0x0 0xe 0x4 0x0>;
			gpio-controller;
			#gpio-cells = <0x2>;
			interrupt-controller;
			#interrupt-cells = <0x2>;
			phandle = <0x3c>;
		};

		gpio1: gpio1@ff730000 {
			compatible = "rockchip,gpio-bank";
			reg = <0x0 0xff730000 0x0 0x100>;
			clocks = <0x31 0x18>;
			interrupts = <0x0 0xf 0x4 0x0>;
			gpio-controller;
			#gpio-cells = <0x2>;
			interrupt-controller;
			#interrupt-cells = <0x2>;
			phandle = <0x35>;
		};

		gpio2: gpio2@ff780000 {
			compatible = "rockchip,gpio-bank";
			reg = <0x0 0xff780000 0x0 0x100>;
			clocks = <0x8 0x150>;
			interrupts = <0x0 0x10 0x4 0x0>;
			gpio-controller;
			#gpio-cells = <0x2>;
			interrupt-controller;
			#interrupt-cells = <0x2>;
			phandle = <0xca>;
		};

		gpio3: gpio3@ff788000 {
			compatible = "rockchip,gpio-bank";
			reg = <0x0 0xff788000 0x0 0x100>;
			clocks = <0x8 0x151>;
			interrupts = <0x0 0x11 0x4 0x0>;
			gpio-controller;
			#gpio-cells = <0x2>;
			interrupt-controller;
			#interrupt-cells = <0x2>;
			phandle = <0x18>;
		};

		gpio4: gpio4@ff790000 {
			compatible = "rockchip,gpio-bank";
			reg = <0x0 0xff790000 0x0 0x100>;
			clocks = <0x8 0x152>;
			interrupts = <0x0 0x12 0x4 0x0>;
			gpio-controller;
			#gpio-cells = <0x2>;
			interrupt-controller;
			#interrupt-cells = <0x2>;
			phandle = <0x3d>;
		};

		pcfg_pull_up: pcfg-pull-up {
			bias-pull-up;
			phandle = <0xbd>;
		};

		pcfg_pull_down: pcfg-pull-down {
			bias-pull-down;
			phandle = <0xc1>;
		};

		pcfg_pull_none: pcfg-pull-none {
			bias-disable;
			phandle = <0xbf>;
		};

		pcfg_pull_up_20ma: pcfg-pull-up-20ma {
			bias-pull-up;
			drive-strength = <0x14>;
			phandle = <0x151>;
		};

		pcfg_pull_none_20ma: pcfg-pull-none-20ma {
			bias-disable;
			drive-strength = <0x14>;
			phandle = <0x152>;
		};

		pcfg_pull_none_18ma: pcfg-pull-none-18ma {
			bias-disable;
			drive-strength = <0x12>;
			phandle = <0x153>;
		};

		pcfg_pull_none_12ma: pcfg-pull-none-12ma {
			bias-disable;
			drive-strength = <0xc>;
			phandle = <0xc0>;
		};

		pcfg_pull_up_8ma: pcfg-pull-up-8ma {
			bias-pull-up;
			drive-strength = <0x8>;
			phandle = <0x154>;
		};

		pcfg_pull_down_4ma: pcfg-pull-down-4ma {
			bias-pull-down;
			drive-strength = <0x4>;
			phandle = <0x155>;
		};

		pcfg_pull_up_2ma: pcfg-pull-up-2ma {
			bias-pull-up;
			drive-strength = <0x2>;
			phandle = <0x156>;
		};

		pcfg_pull_down_12ma: pcfg-pull-down-12ma {
			bias-pull-down;
			drive-strength = <0xc>;
			phandle = <0x157>;
		};

		pcfg_pull_none_13ma: pcfg-pull-none-13ma {
			bias-disable;
			drive-strength = <0xd>;
			phandle = <0xbe>;
		};

		pcfg_output_high: pcfg-output-high {
			output-high;
			phandle = <0x158>;
		};

		pcfg_output_low: pcfg-output-low {
			output-low;
			phandle = <0x159>;
		};

		pcfg_input: pcfg-input {
			input-enable;
			phandle = <0x15a>;
		};

		emmc {

			emmc_pwr: emmc-pwr {
				rockchip,pins = <0x0 0x5 0x1 0xbd>;
				phandle = <0x15b>;
			};
		};

		gmac {

			rgmii_pins: rgmii-pins {
				rockchip,pins = <0x3 0x11 0x1 0xbe 0x3 0xe 0x1 0xbf 0x3 0xd 0x1 0xbf 0x3 0xc 0x1 0xbe 0x3 0xb 0x1 0xbf 0x3 0x9 0x1 0xbf 0x3 0x8 0x1 0xbf 0x3 0x7 0x1 0xbf 0x3 0x6 0x1 0xbf 0x3 0x5 0x1 0xbe 0x3 0x4 0x1 0xbe 0x3 0x3 0x1 0xbf 0x3 0x2 0x1 0xbf 0x3 0x1 0x1 0xbe 0x3 0x0 0x1 0xbe>;
				phandle = <0x1a>;
			};

			rmii_pins: rmii-pins {
				rockchip,pins = <0x3 0xd 0x1 0xbf 0x3 0xc 0x1 0xbe 0x3 0xb 0x1 0xbf 0x3 0xa 0x1 0xbf 0x3 0x9 0x1 0xbf 0x3 0x8 0x1 0xbf 0x3 0x7 0x1 0xbf 0x3 0x6 0x1 0xbf 0x3 0x5 0x1 0xbe 0x3 0x4 0x1 0xbe>;
				phandle = <0x15c>;
			};
		};

		i2c0 {

			i2c0_xfer: i2c0-xfer {
				rockchip,pins = <0x1 0xf 0x2 0xbf 0x1 0x10 0x2 0xbf>;
				phandle = <0x32>;
			};
		};

		i2c1 {

			i2c1_xfer: i2c1-xfer {
				rockchip,pins = <0x4 0x2 0x1 0xbf 0x4 0x1 0x1 0xbf>;
				phandle = <0x3a>;
			};
		};

		i2c2 {

			i2c2_xfer: i2c2-xfer {
				rockchip,pins = <0x2 0x1 0x2 0xc0 0x2 0x0 0x2 0xc0>;
				phandle = <0x3e>;
			};
		};

		i2c3 {

			i2c3_xfer: i2c3-xfer {
				rockchip,pins = <0x4 0x11 0x1 0xbf 0x4 0x10 0x1 0xbf>;
				phandle = <0x3f>;
			};

			i2c3_gpio: i2c3_gpio {
				rockchip,pins = <0x4 0x11 0x0 0xbf 0x4 0x10 0x0 0xbf>;
				phandle = <0x15d>;
			};
		};

		i2c4 {

			i2c4_xfer: i2c4-xfer {
				rockchip,pins = <0x1 0xc 0x1 0xbf 0x1 0xb 0x1 0xbf>;
				phandle = <0x81>;
			};
		};

		i2c5 {

			i2c5_xfer: i2c5-xfer {
				rockchip,pins = <0x3 0xb 0x2 0xbf 0x3 0xa 0x2 0xbf>;
				phandle = <0x40>;
			};
		};

		i2c6 {

			i2c6_xfer: i2c6-xfer {
				rockchip,pins = <0x2 0xa 0x2 0xbf 0x2 0x9 0x2 0xbf>;
				phandle = <0x41>;
			};
		};

		i2c7 {

			i2c7_xfer: i2c7-xfer {
				rockchip,pins = <0x2 0x8 0x2 0xbf 0x2 0x7 0x2 0xbf>;
				phandle = <0x42>;
			};
		};

		i2c8 {

			i2c8_xfer: i2c8-xfer {
				rockchip,pins = <0x1 0x15 0x1 0xbf 0x1 0x14 0x1 0xbf>;
				phandle = <0x83>;
			};
		};

		i2s0 {

			i2s0_8ch_bus: i2s0-8ch-bus {
				rockchip,pins = <0x3 0x18 0x1 0xbf 0x3 0x19 0x1 0xbf 0x3 0x1a 0x1 0xbf 0x3 0x1b 0x1 0xbf 0x3 0x1c 0x1 0xbf 0x3 0x1d 0x1 0xbf 0x3 0x1e 0x1 0xbf 0x3 0x1f 0x1 0xbf>;
				phandle = <0x97>;
			};

			i2s_8ch_mclk: i2s-8ch-mclk {
				rockchip,pins = <0x4 0x0 0x1 0xbf>;
				phandle = <0x3b>;
			};
		};

		i2s1 {

			i2s1_2ch_bus: i2s1-2ch-bus {
				rockchip,pins = <0x4 0x3 0x1 0xbf 0x4 0x4 0x1 0xbf 0x4 0x5 0x1 0xbf 0x4 0x6 0x1 0xbf 0x4 0x7 0x1 0xbf>;
				phandle = <0x98>;
			};
		};

		sdio0 {

			sdio0_bus1: sdio0-bus1 {
				rockchip,pins = <0x2 0x14 0x1 0xbd>;
				phandle = <0x15e>;
			};

			sdio0_bus4: sdio0-bus4 {
				rockchip,pins = <0x2 0x14 0x1 0xbd 0x2 0x15 0x1 0xbd 0x2 0x16 0x1 0xbd 0x2 0x17 0x1 0xbd>;
				phandle = <0x1c>;
			};

			sdio0_cmd: sdio0-cmd {
				rockchip,pins = <0x2 0x18 0x1 0xbd>;
				phandle = <0x1d>;
			};

			sdio0_clk: sdio0-clk {
				rockchip,pins = <0x2 0x19 0x1 0xbf>;
				phandle = <0x1e>;
			};

			sdio0_cd: sdio0-cd {
				rockchip,pins = <0x2 0x1a 0x1 0xbd>;
				phandle = <0x15f>;
			};

			sdio0_pwr: sdio0-pwr {
				rockchip,pins = <0x2 0x1b 0x1 0xbd>;
				phandle = <0x160>;
			};

			sdio0_bkpwr: sdio0-bkpwr {
				rockchip,pins = <0x2 0x1c 0x1 0xbd>;
				phandle = <0x161>;
			};

			sdio0_wp: sdio0-wp {
				rockchip,pins = <0x0 0x3 0x1 0xbd>;
				phandle = <0x162>;
			};

			sdio0_int: sdio0-int {
				rockchip,pins = <0x0 0x4 0x1 0xbd>;
				phandle = <0x163>;
			};
		};

		sdmmc {

			sdmmc_bus1: sdmmc-bus1 {
				rockchip,pins = <0x4 0x8 0x1 0xbd>;
				phandle = <0x164>;
			};

			sdmmc_bus4: sdmmc-bus4 {
				rockchip,pins = <0x4 0x8 0x1 0xbd 0x4 0x9 0x1 0xbd 0x4 0xa 0x1 0xbd 0x4 0xb 0x1 0xbd>;
				phandle = <0x24>;
			};

			sdmmc_clk: sdmmc-clk {
				rockchip,pins = <0x4 0xc 0x1 0xbf>;
				phandle = <0x21>;
			};

			sdmmc_cmd: sdmmc-cmd {
				rockchip,pins = <0x4 0xd 0x1 0xbd>;
				phandle = <0x22>;
			};

			sdmmc_cd: sdmcc-cd {
				rockchip,pins = <0x0 0x7 0x1 0xbd>;
				phandle = <0x23>;
			};

			sdmmc_wp: sdmmc-wp {
				rockchip,pins = <0x0 0x8 0x1 0xbd>;
				phandle = <0x165>;
			};
		};

		spdif {

			spdif_bus: spdif-bus {
				rockchip,pins = <0x4 0x15 0x1 0xbf>;
				phandle = <0x96>;
			};

			spdif_bus_1: spdif-bus-1 {
				rockchip,pins = <0x3 0x10 0x3 0xbf>;
				phandle = <0x166>;
			};
		};

		spi0 {

			spi0_clk: spi0-clk {
				rockchip,pins = <0x3 0x6 0x2 0xbd>;
				phandle = <0x4a>;
			};

			spi0_cs0: spi0-cs0 {
				rockchip,pins = <0x3 0x7 0x2 0xbd>;
				phandle = <0x4d>;
			};

			spi0_cs1: spi0-cs1 {
				rockchip,pins = <0x3 0x8 0x2 0xbd>;
				phandle = <0x167>;
			};

			spi0_tx: spi0-tx {
				rockchip,pins = <0x3 0x5 0x2 0xbd>;
				phandle = <0x4b>;
			};

			spi0_rx: spi0-rx {
				rockchip,pins = <0x3 0x4 0x2 0xbd>;
				phandle = <0x4c>;
			};
		};

		spi1 {

			spi1_clk: spi1-clk {
				rockchip,pins = <0x1 0x9 0x2 0xbd>;
				phandle = <0x4e>;
			};

			spi1_cs0: spi1-cs0 {
				rockchip,pins = <0x1 0xa 0x2 0xbd>;
				phandle = <0x51>;
			};

			spi1_rx: spi1-rx {
				rockchip,pins = <0x1 0x7 0x2 0xbd>;
				phandle = <0x50>;
			};

			spi1_tx: spi1-tx {
				rockchip,pins = <0x1 0x8 0x2 0xbd>;
				phandle = <0x4f>;
			};
		};

		spi2 {

			spi2_clk: spi2-clk {
				rockchip,pins = <0x2 0xb 0x1 0xbd>;
				phandle = <0x52>;
			};

			spi2_cs0: spi2-cs0 {
				rockchip,pins = <0x2 0xc 0x1 0xbd>;
				phandle = <0x55>;
			};

			spi2_rx: spi2-rx {
				rockchip,pins = <0x2 0x9 0x1 0xbd>;
				phandle = <0x54>;
			};

			spi2_tx: spi2-tx {
				rockchip,pins = <0x2 0xa 0x1 0xbd>;
				phandle = <0x53>;
			};
		};

		spi3 {

			spi3_clk: spi3-clk {
				rockchip,pins = <0x1 0x11 0x1 0xbd>;
				phandle = <0x7c>;
			};

			spi3_cs0: spi3-cs0 {
				rockchip,pins = <0x1 0x12 0x1 0xbd>;
				phandle = <0x7f>;
			};

			spi3_rx: spi3-rx {
				rockchip,pins = <0x1 0xf 0x1 0xbd>;
				phandle = <0x7e>;
			};

			spi3_tx: spi3-tx {
				rockchip,pins = <0x1 0x10 0x1 0xbd>;
				phandle = <0x7d>;
			};
		};

		spi4 {

			spi4_clk: spi4-clk {
				rockchip,pins = <0x3 0x2 0x2 0xbd>;
				phandle = <0x56>;
			};

			spi4_cs0: spi4-cs0 {
				rockchip,pins = <0x3 0x3 0x2 0xbd>;
				phandle = <0x59>;
			};

			spi4_rx: spi4-rx {
				rockchip,pins = <0x3 0x0 0x2 0xbd>;
				phandle = <0x58>;
			};

			spi4_tx: spi4-tx {
				rockchip,pins = <0x3 0x1 0x2 0xbd>;
				phandle = <0x57>;
			};
		};

		spi5 {

			spi5_clk: spi5-clk {
				rockchip,pins = <0x2 0x16 0x2 0xbd>;
				phandle = <0x5a>;
			};

			spi5_cs0: spi5-cs0 {
				rockchip,pins = <0x2 0x17 0x2 0xbd>;
				phandle = <0x5d>;
			};

			spi5_rx: spi5-rx {
				rockchip,pins = <0x2 0x14 0x2 0xbd>;
				phandle = <0x5c>;
			};

			spi5_tx: spi5-tx {
				rockchip,pins = <0x2 0x15 0x2 0xbd>;
				phandle = <0x5b>;
			};
		};

		tsadc {

			otp_gpio: otp-gpio {
				rockchip,pins = <0x1 0x6 0x0 0xbf>;
				phandle = <0x61>;
			};

			otp_out: otp-out {
				rockchip,pins = <0x1 0x6 0x1 0xbf>;
				phandle = <0x62>;
			};
		};

		uart0 {

			uart0_xfer: uart0-xfer {
				rockchip,pins = <0x2 0x10 0x1 0xbd 0x2 0x11 0x1 0xbf>;
				phandle = <0x43>;
			};

			uart0_cts: uart0-cts {
				rockchip,pins = <0x2 0x12 0x1 0xbf>;
				phandle = <0x44>;
			};

			uart0_rts: uart0-rts {
				rockchip,pins = <0x2 0x13 0x1 0xbf>;
				phandle = <0xcb>;
			};
		};

		uart1 {

			uart1_xfer: uart1-xfer {
				rockchip,pins = <0x3 0xc 0x2 0xbd 0x3 0xd 0x2 0xbf>;
				phandle = <0x45>;
			};
		};

		uart2a {

			uart2a_xfer: uart2a-xfer {
				rockchip,pins = <0x4 0x8 0x2 0xbd 0x4 0x9 0x2 0xbf>;
				phandle = <0x168>;
			};
		};

		uart2b {

			uart2b_xfer: uart2b-xfer {
				rockchip,pins = <0x4 0x10 0x2 0xbd 0x4 0x11 0x2 0xbf>;
				phandle = <0x169>;
			};
		};

		uart2c {

			uart2c_xfer: uart2c-xfer {
				rockchip,pins = <0x4 0x13 0x1 0xbd 0x4 0x14 0x1 0xbf>;
				phandle = <0x46>;
			};
		};

		uart3 {

			uart3_xfer: uart3-xfer {
				rockchip,pins = <0x3 0xe 0x2 0xbd 0x3 0xf 0x2 0xbf>;
				phandle = <0x47>;
			};

			uart3_cts: uart3-cts {
				rockchip,pins = <0x3 0x12 0x2 0xbf>;
				phandle = <0x48>;
			};

			uart3_rts: uart3-rts {
				rockchip,pins = <0x3 0x13 0x2 0xbf>;
				phandle = <0x49>;
			};
		};

		uart4 {

			uart4_xfer: uart4-xfer {
				rockchip,pins = <0x1 0x7 0x1 0xbd 0x1 0x8 0x1 0xbf>;
				phandle = <0x80>;
			};
		};

		uarthdcp {

			uarthdcp_xfer: uarthdcp-xfer {
				rockchip,pins = <0x4 0x15 0x2 0xbd 0x4 0x16 0x2 0xbf>;
				phandle = <0x16a>;
			};
		};

		pwm0 {

			pwm0_pin: pwm0-pin {
				rockchip,pins = <0x4 0x12 0x1 0xbf>;
				phandle = <0x87>;
			};

			pwm0_pin_pull_down: pwm0-pin-pull-down {
				rockchip,pins = <0x4 0x12 0x1 0xc1>;
				phandle = <0x16b>;
			};

			vop0_pwm_pin: vop0-pwm-pin {
				rockchip,pins = <0x4 0x12 0x2 0xbf>;
				phandle = <0xa8>;
			};

			vop1_pwm_pin: vop1-pwm-pin {
				rockchip,pins = <0x4 0x12 0x3 0xbf>;
				phandle = <0xa1>;
			};
		};

		pwm1 {

			pwm1_pin: pwm1-pin {
				rockchip,pins = <0x4 0x16 0x1 0xbf>;
				phandle = <0x88>;
			};

			pwm1_pin_pull_down: pwm1-pin-pull-down {
				rockchip,pins = <0x4 0x16 0x1 0xc1>;
				phandle = <0x16c>;
			};
		};

		pwm2 {

			pwm2_pin: pwm2-pin {
				rockchip,pins = <0x1 0x13 0x1 0xbf>;
				phandle = <0x89>;
			};

			pwm2_pin_pull_down: pwm2-pin-pull-down {
				rockchip,pins = <0x1 0x13 0x1 0xc1>;
				phandle = <0x16d>;
			};
		};

		pwm3a {

			pwm3a_pin: pwm3a-pin {
				rockchip,pins = <0x0 0x6 0x1 0xbf>;
				phandle = <0x8a>;
			};

			pwm3a_pin_pull_down: pwm3a-pin-pull-down {
				rockchip,pins = <0x0 0x6 0x1 0xc1>;
				phandle = <0x16e>;
			};
		};

		pwm3b {

			pwm3b_pin: pwm3b-pin {
				rockchip,pins = <0x1 0xe 0x1 0xbf>;
				phandle = <0x16f>;
			};

			pwm3b_pin_pull_down: pwm3b-pin-pull-down {
				rockchip,pins = <0x1 0xe 0x1 0xc1>;
				phandle = <0x170>;
			};
		};

		edp {

			edp_hpd: edp-hpd {
				rockchip,pins = <0x4 0x17 0x2 0xbf>;
				phandle = <0xb6>;
			};
		};

		hdmi {

			hdmi_i2c_xfer: hdmi-i2c-xfer {
				rockchip,pins = <0x4 0x11 0x3 0xbf 0x4 0x10 0x3 0xbf>;
				phandle = <0xac>;
			};

			hdmi_cec: hdmi-cec {
				rockchip,pins = <0x4 0x17 0x1 0xbf>;
				phandle = <0xad>;
			};
		};

		pcie {

			pcie_clkreqn: pci-clkreqn {
				rockchip,pins = <0x2 0x1a 0x2 0xbf>;
				phandle = <0x171>;
			};

			pcie_clkreqnb: pci-clkreqnb {
				rockchip,pins = <0x4 0x18 0x1 0xbf>;
				phandle = <0x172>;
			};

			pcie_clkreqn_cpm: pci-clkreqn-cpm {
				rockchip,pins = <0x2 0x1a 0x0 0xbf>;
				phandle = <0x173>;
			};

			pcie_clkreqnb_cpm: pci-clkreqnb-cpm {
				rockchip,pins = <0x4 0x18 0x0 0xbf>;
				phandle = <0x174>;
			};
		};

		pmic {

			pmic_int_l: pmic-int-l {
				rockchip,pins = <0x1 0x15 0x0 0xbd>;
				phandle = <0x37>;
			};

			vsel1_gpio: vsel1-gpio {
				rockchip,pins = <0x1 0x11 0x0 0xc1>;
				phandle = <0x34>;
			};

			vsel2_gpio: vsel2-gpio {
				rockchip,pins = <0x1 0xe 0x0 0xc1>;
				phandle = <0x36>;
			};
		};

		usb {

			host_vbus_drv_usb3: host-vbus-drv-usb3 {
				rockchip,pins = <0x0 0x6 0x0 0xbf>;
				phandle = <0xc5>;
			};

			host_vbus_drv_usb2: host-vbus-drv-usb2 {
				rockchip,pins = <0x0 0x8 0x0 0xbf>;
				phandle = <0xc6>;
			};
		};

		vcc_sd {

			vcc_sd_h: vcc-sd-h {
				rockchip,pins = <0x0 0x1 0x0 0xbd>;
				phandle = <0xc7>;
			};
		};

		fusb30x {

			fusb0_int: fusb0-int {
				rockchip,pins = <0x1 0x2 0x0 0xbd>;
				phandle = <0x82>;
			};
		};

		sdio-pwrseq {

			wifi_enable_h: wifi-enable-h {
				rockchip,pins = <0x0 0xa 0x0 0xbf>;
				phandle = <0xc9>;
			};
		};

		wireless-bluetooth {

			uart0_gpios: uart0-gpios {
				rockchip,pins = <0x2 0x13 0x0 0xbf>;
				phandle = <0xcc>;
			};
		};

		headphone {

			hp_det: hp-det {
				rockchip,pins = <0x4 0x1c 0x0 0xbd>;
				phandle = <0xcf>;
			};
		};

		gpio-leds {

			leds_gpio: leds-gpio {
				rockchip,pins = <0x0 0x2 0x0 0xbd 0x0 0xc 0x0 0xbd 0x0 0xd 0x0 0xbd 0x2 0x1b 0x0 0xbd 0x2 0x1c 0x0 0xbd>;
				phandle = <0xce>;
			};
		};

		isp {

			cif_clkout: cif-clkout {
				rockchip,pins = <0x2 0xb 0x3 0xbf>;
				phandle = <0xd7>;
			};

			isp_dvp_d0d7: isp-dvp-d0d7 {
				rockchip,pins = <0x2 0x0 0x3 0xbf 0x2 0x1 0x3 0xbf 0x2 0x2 0x3 0xbf 0x2 0x3 0x3 0xbf 0x2 0x4 0x3 0xbf 0x2 0x5 0x3 0xbf 0x2 0x6 0x3 0xbf 0x2 0x7 0x3 0xbf 0x2 0x8 0x3 0xbf 0x2 0x9 0x3 0xbf 0x2 0xa 0x3 0xbf>;
				phandle = <0xd8>;
			};

			isp_shutter: isp-shutter {
				rockchip,pins = <0x1 0x1 0x1 0xbf 0x1 0x0 0x1 0xbf>;
				phandle = <0x175>;
			};

			isp_flash_trigger: isp-flash-trigger {
				rockchip,pins = <0x1 0x3 0x1 0xbf>;
				phandle = <0xdb>;
			};

			isp_prelight: isp-prelight {
				rockchip,pins = <0x1 0x4 0x1 0xbf>;
				phandle = <0xd9>;
			};

			isp_flash_trigger_as_gpio: isp_flash_trigger_as_gpio {
				rockchip,pins = <0x1 0x3 0x0 0xbf>;
				phandle = <0xda>;
			};
		};
	};

	rockchip_suspend: rockchip-suspend {
		compatible = "rockchip,pm-rk3399";
		status = "okay";
		rockchip,sleep-debug-en = <0x1>;
		rockchip,virtual-poweroff = <0x0>;
		rockchip,sleep-mode-config = <0xde>;
		rockchip,wakeup-config = <0x804>;
		rockchip,pwm-regulator-config = <0x4>;
		rockchip,power-ctrl = <0x35 0x11 0x0 0x35 0xe 0x0>;
		phandle = <0x176>;
	};

	energy-costs {

		RK3399_CPU_COST_0: rk3399-core-cost0 {
			busy-cost-data = <0x6c 0x2e 0x9f 0x43 0xd8 0x5a 0x10b 0x78 0x13e 0x99 0x177 0xc6 0x191 0xde>;
			idle-cost-data = <0x6 0x6 0x0 0x0>;
			phandle = <0xc>;
		};

		RK3399_CPU_COST_1: rk3399-core-cost1 {
			busy-cost-data = <0xd2 0x81 0x134 0xb8 0x1a3 0xf6 0x206 0x14f 0x269 0x1ac 0x2d8 0x23d 0x33b 0x2d4 0x39d 0x384 0x400 0x454>;
			idle-cost-data = <0xf 0xf 0x0 0x0>;
			phandle = <0x10>;
		};

		RK3399_CLUSTER_COST_0: rk3399-cluster-cost0 {
			busy-cost-data = <0x6c 0x2e 0x9f 0x43 0xd8 0x5a 0x10b 0x78 0x13e 0x99 0x177 0xc6 0x191 0xde>;
			idle-cost-data = <0x38 0x38 0x38 0x38>;
			phandle = <0xd>;
		};

		RK3399_CLUSTER_COST_1: rk3399-cluster-cost1 {
			busy-cost-data = <0xd2 0x81 0x134 0xb8 0x1a3 0xf6 0x206 0x14f 0x269 0x1ac 0x2d8 0x23d 0x33b 0x2d4 0x39d 0x384 0x400 0x454>;
			idle-cost-data = <0x41 0x41 0x41 0x41>;
			phandle = <0x11>;
		};
	};

	cluster0_opp: opp-table0 {
		compatible = "operating-points-v2";
		opp-shared;
		nvmem-cells = <0xc2>;
		nvmem-cell-names = "cpu_leakage";
		rockchip,pvtm-voltage-sel = <0x0 0x2308c 0x0 0x2308d 0x24414 0x1 0x24415 0x251c0 0x2 0x251c1 0xf423f 0x3>;
		rockchip,pvtm-freq = <0x639c0>;
		rockchip,pvtm-volt = <0xf4240>;
		rockchip,pvtm-ch = <0x0 0x0>;
		rockchip,pvtm-sample-time = <0x3e8>;
		rockchip,pvtm-number = <0xa>;
		rockchip,pvtm-error = <0x3e8>;
		rockchip,pvtm-ref-temp = <0x29>;
		rockchip,pvtm-temp-prop = <0x73 0x42>;
		rockchip,pvtm-thermal-zone = "soc-thermal";
		phandle = <0xb>;

		opp-408000000 {
			opp-hz = <0x0 0x18519600>;
			opp-microvolt = <0xc3500 0xc3500 0x124f80>;
			opp-microvolt-L0 = <0xc3500 0xc3500 0x124f80>;
			opp-microvolt-L1 = <0xc3500 0xc3500 0x124f80>;
			opp-microvolt-L2 = <0xc3500 0xc3500 0x124f80>;
			opp-microvolt-L3 = <0xc3500 0xc3500 0x124f80>;
			clock-latency-ns = <0x9c40>;
		};

		opp-600000000 {
			opp-hz = <0x0 0x23c34600>;
			opp-microvolt = <0xc3500 0xc3500 0x124f80>;
			opp-microvolt-L0 = <0xc3500 0xc3500 0x124f80>;
			opp-microvolt-L1 = <0xc3500 0xc3500 0x124f80>;
			opp-microvolt-L2 = <0xc3500 0xc3500 0x124f80>;
			opp-microvolt-L3 = <0xc3500 0xc3500 0x124f80>;
			clock-latency-ns = <0x9c40>;
		};

		opp-816000000 {
			opp-hz = <0x0 0x30a32c00>;
			opp-microvolt = <0xcf850 0xcf850 0x124f80>;
			opp-microvolt-L0 = <0xcf850 0xcf850 0x124f80>;
			opp-microvolt-L1 = <0xc96a8 0xc96a8 0x124f80>;
			opp-microvolt-L2 = <0xc3500 0xc3500 0x124f80>;
			opp-microvolt-L3 = <0xc3500 0xc3500 0x124f80>;
			clock-latency-ns = <0x9c40>;
			opp-suspend;
		};

		opp-1008000000 {
			opp-hz = <0x0 0x3c14dc00>;
			opp-microvolt = <0xe1d48 0xe1d48 0x124f80>;
			opp-microvolt-L0 = <0xe1d48 0xe1d48 0x124f80>;
			opp-microvolt-L1 = <0xdbba0 0xdbba0 0x124f80>;
			opp-microvolt-L2 = <0xd59f8 0xd59f8 0x124f80>;
			opp-microvolt-L3 = <0xcf850 0xcf850 0x124f80>;
			clock-latency-ns = <0x9c40>;
		};

		opp-1200000000 {
			opp-hz = <0x0 0x47868c00>;
			opp-microvolt = <0xf4240 0xf4240 0x124f80>;
			opp-microvolt-L0 = <0xf4240 0xf4240 0x124f80>;
			opp-microvolt-L1 = <0xee098 0xee098 0x124f80>;
			opp-microvolt-L2 = <0xe7ef0 0xe7ef0 0x124f80>;
			opp-microvolt-L3 = <0xe1d48 0xe1d48 0x124f80>;
			clock-latency-ns = <0x9c40>;
		};

		opp-1416000000 {
			opp-hz = <0x0 0x54667200>;
			opp-microvolt = <0x112a88 0x112a88 0x124f80>;
			opp-microvolt-L0 = <0x112a88 0x112a88 0x124f80>;
			opp-microvolt-L1 = <0x10c8e0 0x10c8e0 0x124f80>;
			opp-microvolt-L2 = <0x106738 0x106738 0x124f80>;
			opp-microvolt-L3 = <0x100590 0x100590 0x124f80>;
			clock-latency-ns = <0x9c40>;
		};
	};

	cluster1_opp: opp-table1 {
		compatible = "operating-points-v2";
		opp-shared;
		nvmem-cells = <0xc3>;
		nvmem-cell-names = "cpu_leakage";
		rockchip,pvtm-voltage-sel = <0x0 0x24608 0x0 0x24609 0x25d78 0x1 0x25d79 0x27100 0x2 0x27101 0xf423f 0x3>;
		rockchip,pvtm-freq = <0x639c0>;
		rockchip,pvtm-volt = <0xf4240>;
		rockchip,pvtm-ch = <0x1 0x0>;
		rockchip,pvtm-sample-time = <0x3e8>;
		rockchip,pvtm-number = <0xa>;
		rockchip,pvtm-error = <0x3e8>;
		rockchip,pvtm-ref-temp = <0x29>;
		rockchip,pvtm-temp-prop = <0x47 0x23>;
		rockchip,pvtm-thermal-zone = "soc-thermal";
		phandle = <0xf>;

		opp-408000000 {
			opp-hz = <0x0 0x18519600>;
			opp-microvolt = <0xc3500 0xc3500 0x124f80>;
			opp-microvolt-L0 = <0xc3500 0xc3500 0x124f80>;
			opp-microvolt-L1 = <0xc3500 0xc3500 0x124f80>;
			opp-microvolt-L2 = <0xc3500 0xc3500 0x124f80>;
			opp-microvolt-L3 = <0xc3500 0xc3500 0x124f80>;
			clock-latency-ns = <0x9c40>;
		};

		opp-600000000 {
			opp-hz = <0x0 0x23c34600>;
			opp-microvolt = <0xc3500 0xc3500 0x124f80>;
			opp-microvolt-L0 = <0xc3500 0xc3500 0x124f80>;
			opp-microvolt-L1 = <0xc3500 0xc3500 0x124f80>;
			opp-microvolt-L2 = <0xc3500 0xc3500 0x124f80>;
			opp-microvolt-L3 = <0xc3500 0xc3500 0x124f80>;
			clock-latency-ns = <0x9c40>;
		};

		opp-816000000 {
			opp-hz = <0x0 0x30a32c00>;
			opp-microvolt = <0xc96a8 0xc96a8 0x124f80>;
			opp-microvolt-L0 = <0xc96a8 0xc96a8 0x124f80>;
			opp-microvolt-L1 = <0xc96a8 0xc96a8 0x124f80>;
			opp-microvolt-L2 = <0xc3500 0xc3500 0x124f80>;
			opp-microvolt-L3 = <0xc3500 0xc3500 0x124f80>;
			clock-latency-ns = <0x9c40>;
			opp-suspend;
		};

		opp-1008000000 {
			opp-hz = <0x0 0x3c14dc00>;
			opp-microvolt = <0xd59f8 0xd59f8 0x124f80>;
			opp-microvolt-L0 = <0xd59f8 0xd59f8 0x124f80>;
			opp-microvolt-L1 = <0xcf850 0xcf850 0x124f80>;
			opp-microvolt-L2 = <0xcf850 0xcf850 0x124f80>;
			opp-microvolt-L3 = <0xcf850 0xcf850 0x124f80>;
			clock-latency-ns = <0x9c40>;
		};

		opp-1200000000 {
			opp-hz = <0x0 0x47868c00>;
			opp-microvolt = <0xe7ef0 0xe7ef0 0x124f80>;
			opp-microvolt-L0 = <0xe7ef0 0xe7ef0 0x124f80>;
			opp-microvolt-L1 = <0xe1d48 0xe1d48 0x124f80>;
			opp-microvolt-L2 = <0xdbba0 0xdbba0 0x124f80>;
			opp-microvolt-L3 = <0xd59f8 0xd59f8 0x124f80>;
			clock-latency-ns = <0x9c40>;
		};

		opp-1416000000 {
			opp-hz = <0x0 0x54667200>;
			opp-microvolt = <0xfa3e8 0xfa3e8 0x124f80>;
			opp-microvolt-L0 = <0xfa3e8 0xfa3e8 0x124f80>;
			opp-microvolt-L1 = <0xf4240 0xf4240 0x124f80>;
			opp-microvolt-L2 = <0xf4240 0xf4240 0x124f80>;
			opp-microvolt-L3 = <0xee098 0xee098 0x124f80>;
			clock-latency-ns = <0x9c40>;
		};

		opp-1608000000 {
			opp-hz = <0x0 0x5fd82200>;
			opp-microvolt = <0x10c8e0 0x10c8e0 0x124f80>;
			opp-microvolt-L0 = <0x10c8e0 0x10c8e0 0x124f80>;
			opp-microvolt-L1 = <0x106738 0x106738 0x124f80>;
			opp-microvolt-L2 = <0x100590 0x100590 0x124f80>;
			opp-microvolt-L3 = <0xfa3e8 0xfa3e8 0x124f80>;
			clock-latency-ns = <0x9c40>;
		};

		opp-1800000000 {
			opp-hz = <0x0 0x6b49d200>;
			opp-microvolt = <0x124f80 0x124f80 0x124f80>;
			opp-microvolt-L0 = <0x124f80 0x124f80 0x124f80>;
			opp-microvolt-L1 = <0x11edd8 0x11edd8 0x124f80>;
			opp-microvolt-L2 = <0x118c30 0x118c30 0x124f80>;
			opp-microvolt-L3 = <0x112a88 0x112a88 0x124f80>;
			clock-latency-ns = <0x9c40>;
		};
	};

	gpu_opp_table: opp-table2 {
		compatible = "operating-points-v2";
		nvmem-cells = <0xc4>;
		nvmem-cell-names = "gpu_leakage";
		rockchip,pvtm-voltage-sel = <0x0 0x1d8a8 0x0 0x1d8a9 0x1ea3c 0x1 0x1ea3d 0x1f5f4 0x2 0x1f5f5 0xf423f 0x3>;
		rockchip,pvtm-freq = <0x30d40>;
		rockchip,pvtm-volt = <0xdbba0>;
		rockchip,pvtm-ch = <0x3 0x0>;
		rockchip,pvtm-sample-time = <0x3e8>;
		rockchip,pvtm-number = <0xa>;
		rockchip,pvtm-error = <0x3e8>;
		rockchip,pvtm-ref-temp = <0x29>;
		rockchip,pvtm-temp-prop = <0x2e 0xc>;
		rockchip,pvtm-thermal-zone = "gpu-thermal";
		phandle = <0x99>;

		opp-200000000 {
			opp-hz = <0x0 0xbebc200>;
			opp-microvolt = <0xc3500>;
			opp-microvolt-L0 = <0xc3500>;
			opp-microvolt-L1 = <0xc3500>;
			opp-microvolt-L2 = <0xc3500>;
			opp-microvolt-L3 = <0xc3500>;
		};

		opp-300000000 {
			opp-hz = <0x0 0x11e1a300>;
			opp-microvolt = <0xc3500>;
			opp-microvolt-L0 = <0xc3500>;
			opp-microvolt-L1 = <0xc3500>;
			opp-microvolt-L2 = <0xc3500>;
			opp-microvolt-L3 = <0xc3500>;
		};

		opp-400000000 {
			opp-hz = <0x0 0x17d78400>;
			opp-microvolt = <0xc96a8>;
			opp-microvolt-L0 = <0xc96a8>;
			opp-microvolt-L1 = <0xc96a8>;
			opp-microvolt-L2 = <0xc3500>;
			opp-microvolt-L3 = <0xc3500>;
		};

		opp-600000000 {
			opp-hz = <0x0 0x23c34600>;
			opp-microvolt = <0xe1d48>;
			opp-microvolt-L0 = <0xe1d48>;
			opp-microvolt-L1 = <0xe1d48>;
			opp-microvolt-L2 = <0xdbba0>;
			opp-microvolt-L3 = <0xdbba0>;
		};

		opp-800000000 {
			opp-hz = <0x0 0x2faf0800>;
			opp-microvolt = <0x10c8e0>;
			opp-microvolt-L0 = <0x10c8e0>;
			opp-microvolt-L1 = <0x106738>;
			opp-microvolt-L2 = <0x100590>;
			opp-microvolt-L3 = <0xfa3e8>;
		};
	};

	dmc_opp_table: opp-table3 {
		compatible = "operating-points-v2";
		phandle = <0x8e>;

		opp-200000000 {
			opp-hz = <0x0 0xbebc200>;
			opp-microvolt = <0xdbba0>;
		};

		opp-300000000 {
			opp-hz = <0x0 0x11e1a300>;
			opp-microvolt = <0xdbba0>;
		};

		opp-400000000 {
			opp-hz = <0x0 0x17d78400>;
			opp-microvolt = <0xdbba0>;
		};

		opp-528000000 {
			opp-hz = <0x0 0x1f78a400>;
			opp-microvolt = <0xdbba0>;
		};

		opp-600000000 {
			opp-hz = <0x0 0x23c34600>;
			opp-microvolt = <0xdbba0>;
		};

		opp-800000000 {
			opp-hz = <0x0 0x2faf0800>;
			opp-microvolt = <0xdbba0>;
		};
	};

	vcc5v0_sys: vcc5v0-sys {
		compatible = "regulator-fixed";
		regulator-name = "vcc5v0_sys";
		regulator-min-microvolt = <0x4c4b40>;
		regulator-max-microvolt = <0x4c4b40>;
		regulator-always-on;
		regulator-boot-on;
		phandle = <0x33>;
	};

	vcc3v3_sys: vcc3v3-sys {
		compatible = "regulator-fixed";
		regulator-name = "vcc3v3_sys";
		regulator-min-microvolt = <0x325aa0>;
		regulator-max-microvolt = <0x325aa0>;
		regulator-always-on;
		regulator-boot-on;
		vin-supply = <0x33>;
		phandle = <0x38>;
	};

	vcc5v0_host_usb3: vcc5v0-host-usb3-regulator {
		compatible = "regulator-fixed";
		enable-active-high;
		gpio = <0x3c 0x6 0x0>;
		pinctrl-names = "default";
		pinctrl-0 = <0xc5>;
		regulator-name = "vcc5v0_host_usb3";
		regulator-always-on;
		phandle = <0x177>;
	};

	vcc5v0_host_usb2: vcc5v0-host-usb2-regulator {
		compatible = "regulator-fixed";
		enable-active-high;
		gpio = <0x3c 0x8 0x0>;
		pinctrl-names = "default";
		pinctrl-0 = <0xc6>;
		regulator-name = "vcc5v0_host_usb2";
		regulator-always-on;
		phandle = <0x2d>;
	};

	vcc_sd: vcc-sd {
		compatible = "regulator-fixed";
		enable-active-high;
		gpio = <0x3c 0x1 0x0>;
		pinctrl-names = "default";
		pinctrl-0 = <0xc7>;
		regulator-name = "vcc_sd";
		regulator-min-microvolt = <0x325aa0>;
		regulator-max-microvolt = <0x325aa0>;
		phandle = <0x1f>;
	};

	vcc_phy: vcc-phy-regulator {
		compatible = "regulator-fixed";
		regulator-name = "vcc_phy";
		regulator-always-on;
		regulator-boot-on;
		phandle = <0x17>;
	};

	vdd_log: vdd-log {
		compatible = "pwm-regulator";
		regulator-name = "vdd_log";
		regulator-min-microvolt = <0xdbba0>;
		regulator-max-microvolt = <0xdbba0>;
		regulator-always-on;
		regulator-boot-on;
		phandle = <0x178>;
	};

	clkin_gmac: external-gmac-clock {
		compatible = "fixed-clock";
		clock-frequency = <0x7735940>;
		clock-output-names = "clkin_gmac";
		#clock-cells = <0x0>;
		phandle = <0x19>;
	};

	sdio_pwrseq: sdio-pwrseq {
		compatible = "mmc-pwrseq-simple";
		clocks = <0xc8 0x1>;
		clock-names = "ext_clock";
		pinctrl-names = "default";
		pinctrl-0 = <0xc9>;
		reset-gpios = <0x3c 0xa 0x1>;
		phandle = <0x1b>;
	};

	wireless-wlan {
		compatible = "wlan-platdata";
		rockchip,grf = <0x15>;
		wifi_chip_type = "ap6255";
		sdio_vref = <0x708>;
		WIFI,host_wake_irq = <0x3c 0x3 0x0>;
		WIFI,work_led_gpio = <0xca 0x1b 0x0>;
		status = "okay";
	};

	wireless-bluetooth {
		compatible = "bluetooth-platdata";
		clocks = <0xc8 0x1>;
		clock-names = "ext_clock";
		uart_rts_gpios = <0xca 0x13 0x1>;
		pinctrl-names = "default", "rts_gpio";
		pinctrl-0 = <0xcb>;
		pinctrl-1 = <0xcc>;
		BT,reset_gpio = <0x3c 0x9 0x0>;
		BT,wake_gpio = <0xca 0x1a 0x0>;
		BT,wake_host_irq = <0x3c 0x4 0x0>;
		BT,work_led_gpio = <0xca 0x1c 0x0>;
		status = "okay";
	};

	backlight: backlight {
		compatible = "pwm-backlight";
		pwms = <0xcd 0x0 0x61a8 0x0>;
		brightness-levels = <0x0 0x1 0x2 0x3 0x4 0x5 0x6 0x7 0x8 0x9 0xa 0xb 0xc 0xd 0xe 0xf 0x10 0x11 0x12 0x13 0x14 0x15 0x16 0x17 0x18 0x19 0x1a 0x1b 0x1c 0x1d 0x1e 0x1f 0x20 0x21 0x22 0x23 0x24 0x25 0x26 0x27 0x28 0x29 0x2a 0x2b 0x2c 0x2d 0x2e 0x2f 0x30 0x31 0x32 0x33 0x34 0x35 0x36 0x37 0x38 0x39 0x3a 0x3b 0x3c 0x3d 0x3e 0x3f 0x40 0x41 0x42 0x43 0x44 0x45 0x46 0x47 0x48 0x49 0x4a 0x4b 0x4c 0x4d 0x4e 0x4f 0x50 0x51 0x52 0x53 0x54 0x55 0x56 0x57 0x58 0x59 0x5a 0x5b 0x5c 0x5d 0x5e 0x5f 0x60 0x61 0x62 0x63 0x64 0x65 0x66 0x67 0x68 0x69 0x6a 0x6b 0x6c 0x6d 0x6e 0x6f 0x70 0x71 0x72 0x73 0x74 0x75 0x76 0x77 0x78 0x79 0x7a 0x7b 0x7c 0x7d 0x7e 0x7f 0x80 0x81 0x82 0x83 0x84 0x85 0x86 0x87 0x88 0x89 0x8a 0x8b 0x8c 0x8d 0x8e 0x8f 0x90 0x91 0x92 0x93 0x94 0x95 0x96 0x97 0x98 0x99 0x9a 0x9b 0x9c 0x9d 0x9e 0x9f 0xa0 0xa1 0xa2 0xa3 0xa4 0xa5 0xa6 0xa7 0xa8 0xa9 0xaa 0xab 0xac 0xad 0xae 0xaf 0xb0 0xb1 0xb2 0xb3 0xb4 0xb5 0xb6 0xb7 0xb8 0xb9 0xba 0xbb 0xbc 0xbd 0xbe 0xbf 0xc0 0xc1 0xc2 0xc3 0xc4 0xc5 0xc6 0xc7 0xc8 0xc9 0xca 0xcb 0xcc 0xcd 0xce 0xcf 0xd0 0xd1 0xd2 0xd3 0xd4 0xd5 0xd6 0xd7 0xd8 0xd9 0xda 0xdb 0xdc 0xdd 0xde 0xdf 0xe0 0xe1 0xe2 0xe3 0xe4 0xe5 0xe6 0xe7 0xe8 0xe9 0xea 0xeb 0xec 0xed 0xee 0xef 0xf0 0xf1 0xf2 0xf3 0xf4 0xf5 0xf6 0xf7 0xf8 0xf9 0xfa 0xfb 0xfc 0xfd 0xfe 0xff>;
		default-brightness-level = <0xc8>;
		status = "okay";
		phandle = <0xb2>;
	};

	leds: gpio-leds {
		compatible = "gpio-leds";
		pinctrl-names = "default";
		pinctrl-0 = <0xce>;
		phandle = <0x179>;

		led@1 {
			gpios = <0x3c 0x2 0x0>;
			label = "system_work_led1";
			retain-state-suspended;
		};

		led@2 {
			gpios = <0x3c 0xc 0x0>;
			label = "system_work_led2";
			retain-state-suspended;
		};

		led@3 {
			gpios = <0x3c 0xd 0x0>;
			label = "system_work_led3";
			retain-state-suspended;
		};

		led@4 {
			gpios = <0xca 0x1b 0x0>;
			label = "wifi_work_led";
		};

		led@5 {
			gpios = <0xca 0x1c 0x0>;
			label = "bt_work_led";
		};
	};

	rk_headset: rk-headset {
		compatible = "rockchip_headset";
		headset_gpio = <0x3d 0x1c 0x0>;
		spk_con_gpio = <0x3c 0xb 0x0>;
		pinctrl-names = "default";
		pinctrl-0 = <0xcf>;
		io-channels = <0xd0 0x2>;
		phandle = <0x17a>;
	};

	rt5651-sound {
		status = "okay";
		compatible = "simple-audio-card";
		simple-audio-card,format = "i2s";
		simple-audio-card,name = "realtek,rt5651-codec";
		simple-audio-card,mclk-fs = <0x100>;
		simple-audio-card,widgets = "Microphone", "Mic Jack", "Headphone", "Headphone Jack";
		simple-audio-card,routing = "Mic Jack", "MICBIAS1", "IN1P", "Mic Jack", "Headphone Jack", "HPOL", "Headphone Jack", "HPOR";

		simple-audio-card,cpu {
			sound-dai = <0xd1>;
		};

		simple-audio-card,codec {
			sound-dai = <0xd2>;
		};
	};

	rockchip_msm261s4030h0_codec: rockchip-msm261s4030h0-codec {
		status = "okay";
		compatible = "rockchip-msm261s4030h0-codec";
		phandle = <0xd3>;
	};

	rockchip_msm261s4030h0: rockchip-msm261s4030h0 {
		compatible = "rockchip-msm261s4030h0";
		status = "okay";
		rockchip,codec = <0xd3>;
		rockchip,cpu = <0xd4>;
		phandle = <0x17b>;
	};

	chosen {
		bootargs = "earlycon=uart8250,mmio32,0xff1a0000 swiotlb=1";
	};

	cpuinfo {
		compatible = "rockchip,cpuinfo";
		nvmem-cells = <0xd5>;
		nvmem-cell-names = "id";
	};

	ramoops_mem: ramoops_mem {
		reg = <0x0 0x110000 0x0 0xf0000>;
		reg-names = "ramoops_mem";
		phandle = <0xd6>;
	};

	ramoops {
		compatible = "ramoops";
		record-size = <0x0 0x20000>;
		console-size = <0x0 0x80000>;
		ftrace-size = <0x0 0x0>;
		pmsg-size = <0x0 0x50000>;
		memory-region = <0xd6>;
	};

	fiq_debugger: fiq-debugger {
		compatible = "rockchip,fiq-debugger";
		rockchip,serial-id = <0x2>;
		rockchip,wake-irq = <0x0>;
		rockchip,irq-mode-enable = <0x0>;
		rockchip,baudrate = <0x16e360>;
		pinctrl-names = "default";
		pinctrl-0 = <0x46>;
		interrupts = <0x0 0x96 0x4 0x0>;
		phandle = <0x17c>;
	};

	reserved-memory {
		#address-cells = <0x2>;
		#size-cells = <0x2>;
		ranges;

		drm_logo: drm-logo@00000000 {
			compatible = "rockchip,drm-logo";
			reg = <0x0 0x0 0x0 0x0>;
			phandle = <0xbb>;
		};

		secure_memory: secure-memory@20000000 {
			compatible = "rockchip,secure-memory";
			reg = <0x0 0x20000000 0x0 0x10000000>;
			status = "disabled";
			phandle = <0xbc>;
		};

		stb_devinfo: stb-devinfo@00000000 {
			compatible = "rockchip,stb-devinfo";
			reg = <0x0 0x0 0x0 0x0>;
			phandle = <0x17d>;
		};
	};

	rk_key: rockchip-key {
		compatible = "rockchip,key";
		status = "okay";
		io-channels = <0xd0 0x1>;
		phandle = <0x17e>;

		vol-up-key {
			linux,code = <0x73>;
			label = "volume up";
			rockchip,adc_value = <0x1>;
		};

		vol-down-key {
			linux,code = <0x72>;
			label = "volume down";
			rockchip,adc_value = <0xaa>;
		};

		power-key {
			gpios = <0x3c 0x5 0x1>;
			linux,code = <0x74>;
			label = "power";
			gpio-key,wakeup;
		};

		menu-key {
			linux,code = <0x3b>;
			label = "menu";
			rockchip,adc_value = <0x2ea>;
		};

		home-key {
			linux,code = <0x66>;
			label = "home";
			rockchip,adc_value = <0x163>;
		};

		back-key {
			linux,code = <0x9e>;
			label = "back";
			rockchip,adc_value = <0x230>;
		};

		camera-key {
			linux,code = <0xd4>;
			label = "camera";
			rockchip,adc_value = <0x1c2>;
		};
	};

	isp0: isp@ff910000 {
		compatible = "rockchip,rk3399-isp", "rockchip,isp";
		reg = <0x0 0xff910000 0x0 0x4000>;
		interrupts = <0x0 0x2b 0x4 0x0>;
		clocks = <0x8 0x89 0x8 0x89 0x8 0xa4 0x8 0x77 0x8 0xe7 0x8 0xe9 0x8 0x1e1 0x8 0x1e3 0x8 0x6e 0x8 0xa5>;
		clock-names = "clk_cif_out", "clk_cif_pll", "pclk_dphytxrx", "pclk_dphy_ref", "aclk_isp0_noc", "aclk_isp0_wrapper", "hclk_isp0_noc", "hclk_isp0_wrapper", "clk_isp0", "pclk_dphyrx";
		pinctrl-names = "cif_clkout", "isp_dvp8bit0", "isp_mipi_fl", "isp_mipi_fl_prefl", "isp_flash_as_gpio", "isp_flash_as_trigger_out";
		pinctrl-0 = <0xd7>;
		pinctrl-1 = <0xd7 0xd8>;
		pinctrl-2 = <0xd7>;
		pinctrl-3 = <0xd7 0xd9>;
		pinctrl-4 = <0xda>;
		pinctrl-5 = <0xdb>;
		rockchip,isp,mipiphy = <0x2>;
		rockchip,isp,cifphy = <0x1>;
		rockchip,isp,dsiphy,reg = <0xff968000 0x8000>;
		rockchip,grf = <0x15>;
		rockchip,cru = <0x8>;
		rockchip,gpios = <0x35 0x3 0x0>;
		rockchip,isp,iommu-enable = <0x1>;
		power-domains = <0x16 0x13>;
		iommus = <0xaa>;
		status = "okay";
		phandle = <0x17f>;
	};

	isp1: isp@ff920000 {
		compatible = "rockchip,rk3399-isp", "rockchip,isp";
		reg = <0x0 0xff920000 0x0 0x4000>;
		interrupts = <0x0 0x2c 0x4 0x0>;
		clocks = <0x8 0xe8 0x8 0xea 0x8 0x1e2 0x8 0x1e4 0x8 0x6f 0x8 0x89 0x8 0x89 0x8 0xa4 0x8 0x77 0x8 0x17b 0x8 0xa5 0x8 0x171 0x8 0x78>;
		clock-names = "aclk_isp1_noc", "aclk_isp1_wrapper", "hclk_isp1_noc", "hclk_isp1_wrapper", "clk_isp1", "clk_cif_out", "clk_cif_pll", "pclk_dphytxrx", "pclk_dphy_ref", "pclk_isp1", "pclk_dphyrx", "pclk_mipi_dsi", "mipi_dphy_cfg";
		pinctrl-names = "cif_clkout", "isp_dvp8bit0", "isp_mipi_fl", "isp_mipi_fl_prefl", "isp_flash_as_gpio", "isp_flash_as_trigger_out";
		pinctrl-0 = <0xd7>;
		pinctrl-1 = <0xd8>;
		pinctrl-2 = <0xd7>;
		pinctrl-3 = <0xd9>;
		pinctrl-4 = <0xda>;
		pinctrl-5 = <0xdb>;
		rockchip,isp,mipiphy = <0x2>;
		rockchip,isp,cifphy = <0x1>;
		rockchip,isp,dsiphy,reg = <0xff968000 0x8000>;
		rockchip,grf = <0x15>;
		rockchip,cru = <0x8>;
		rockchip,gpios = <0x35 0x3 0x0>;
		rockchip,isp,iommu-enable = <0x1>;
		power-domains = <0x16 0x14>;
		iommus = <0xab>;
		status = "okay";
		phandle = <0x180>;
	};

	uboot-charge {
		compatible = "rockchip,uboot-charge";
		rockchip,uboot-charge-on = <0x1>;
		rockchip,android-charge-on = <0x0>;
	};

	hdmi_dp_sound: hdmi-dp-sound {
		status = "okay";
		compatible = "rockchip,rk3399-hdmi-dp";
		rockchip,cpu = <0xdc>;
		rockchip,codec = <0xdd 0xde>;
		phandle = <0x181>;
	};

	firmware {

		android {
			compatible = "android,firmware";

			fstab {
				compatible = "android,fstab";

				system {
					compatible = "android,system";
					dev = "/dev/block/platform/fe330000.sdhci/by-name/system";
					type = "ext4";
					mnt_flags = "ro,barrier=1,inode_readahead_blks=8";
					fsmgr_flags = "wait,verify";
				};

				vendor {
					compatible = "android,vendor";
					dev = "/dev/block/platform/fe330000.sdhci/by-name/vendor";
					type = "ext4";
					mnt_flags = "ro,barrier=1,inode_readahead_blks=8";
					fsmgr_flags = "wait,verify";
				};
			};
		};
	};

	extbrd: extbrd {
		compatible = "eaidk-extboard";
		io-channels = <0xd0 0x0 0xd0 0x3>;
		phandle = <0x182>;
	};

	__symbols__ {
		ddr_timing = "/ddr_timing";
		cpu_l0 = "/cpus/cpu@0";
		cpu_l1 = "/cpus/cpu@1";
		cpu_l2 = "/cpus/cpu@2";
		cpu_l3 = "/cpus/cpu@3";
		cpu_b0 = "/cpus/cpu@100";
		cpu_b1 = "/cpus/cpu@101";
		CPU_SLEEP = "/cpus/idle-states/cpu-sleep";
		CLUSTER_SLEEP = "/cpus/idle-states/cluster-sleep";
		xin24m = "/xin24m";
		dummy_cpll = "/dummy_cpll";
		dummy_vpll = "/dummy_vpll";
		dmac_bus = "/amba/dma-controller@ff6d0000";
		dmac_peri = "/amba/dma-controller@ff6e0000";
		gmac = "/ethernet@fe300000";
		sdio0 = "/dwmmc@fe310000";
		sdmmc = "/dwmmc@fe320000";
		sdhci = "/sdhci@fe330000";
		usb_host0_ehci = "/usb@fe380000";
		usb_host0_ohci = "/usb@fe3a0000";
		usb_host1_ehci = "/usb@fe3c0000";
		usb_host1_ohci = "/usb@fe3e0000";
		usbdrd3_0 = "/usb@fe800000";
		usbdrd_dwc3_0 = "/usb@fe800000/dwc3@fe800000";
		usbdrd3_1 = "/usb@fe900000";
		usbdrd_dwc3_1 = "/usb@fe900000/dwc3@fe900000";
		cdn_dp = "/dp@fec00000";
		dp_in = "/dp@fec00000/ports/port";
		dp_in_vopb = "/dp@fec00000/ports/port/endpoint@0";
		dp_in_vopl = "/dp@fec00000/ports/port/endpoint@1";
		gic = "/interrupt-controller@fee00000";
		its = "/interrupt-controller@fee00000/interrupt-controller@fee20000";
		ppi_cluster0 = "/interrupt-controller@fee00000/ppi-partitions/interrupt-partition-0";
		ppi_cluster1 = "/interrupt-controller@fee00000/ppi-partitions/interrupt-partition-1";
		saradc = "/saradc@ff100000";
		i2c0 = "/i2c@ff3c0000";
		vdd_cpu_b = "/i2c@ff3c0000/syr827@40";
		vdd_gpu = "/i2c@ff3c0000/syr828@41";
		rk808 = "/i2c@ff3c0000/pmic@1b";
		vdd_center = "/i2c@ff3c0000/pmic@1b/regulators/DCDC_REG1";
		vdd_cpu_l = "/i2c@ff3c0000/pmic@1b/regulators/DCDC_REG2";
		vcc_ddr = "/i2c@ff3c0000/pmic@1b/regulators/DCDC_REG3";
		vcc_1v8 = "/i2c@ff3c0000/pmic@1b/regulators/DCDC_REG4";
		vcc1v8_dvp = "/i2c@ff3c0000/pmic@1b/regulators/LDO_REG1";
		vcc_avdd_2v8 = "/i2c@ff3c0000/pmic@1b/regulators/LDO_REG2";
		vcc1v8_pmupll = "/i2c@ff3c0000/pmic@1b/regulators/LDO_REG3";
		vcc_sdio = "/i2c@ff3c0000/pmic@1b/regulators/LDO_REG4";
		vcca3v0_codec = "/i2c@ff3c0000/pmic@1b/regulators/LDO_REG5";
		vcc_1v5 = "/i2c@ff3c0000/pmic@1b/regulators/LDO_REG6";
		vcca1v8_codec = "/i2c@ff3c0000/pmic@1b/regulators/LDO_REG7";
		vcc_3v0 = "/i2c@ff3c0000/pmic@1b/regulators/LDO_REG8";
		vcc3v3_s3 = "/i2c@ff3c0000/pmic@1b/regulators/SWITCH_REG1";
		vcc3v3_s0 = "/i2c@ff3c0000/pmic@1b/regulators/SWITCH_REG2";
		i2c1 = "/i2c@ff110000";
		rt5651 = "/i2c@ff110000/rt5651@1a";
		es7243 = "/i2c@ff110000/es7243@13";
		i2c2 = "/i2c@ff120000";
		ina219x41c2 = "/i2c@ff120000/ina219@41";
		i2c3 = "/i2c@ff130000";
		i2c5 = "/i2c@ff140000";
		i2c6 = "/i2c@ff150000";
		ina219x47c6 = "/i2c@ff150000/ina219@47";
		i2c7 = "/i2c@ff160000";
		ina219x40c7 = "/i2c@ff160000/ina219@40";
		uart0 = "/serial@ff180000";
		uart1 = "/serial@ff190000";
		uart2 = "/serial@ff1a0000";
		uart3 = "/serial@ff1b0000";
		spi0 = "/spi@ff1c0000";
		spi1 = "/spi@ff1d0000";
		spi2 = "/spi@ff1e0000";
		spi4 = "/spi@ff1f0000";
		spi5 = "/spi@ff200000";
		thermal_zones = "/thermal-zones";
		soc_thermal = "/thermal-zones/soc-thermal";
		threshold = "/thermal-zones/soc-thermal/trips/trip-point-0";
		target = "/thermal-zones/soc-thermal/trips/trip-point-1";
		soc_crit = "/thermal-zones/soc-thermal/trips/soc-crit";
		gpu_thermal = "/thermal-zones/gpu-thermal";
		tsadc = "/tsadc@ff260000";
		qos_emmc = "/qos@ffa58000";
		qos_gmac = "/qos@ffa5c000";
		qos_pcie = "/qos@ffa60080";
		qos_usb_host0 = "/qos@ffa60100";
		qos_usb_host1 = "/qos@ffa60180";
		qos_usb_otg0 = "/qos@ffa70000";
		qos_usb_otg1 = "/qos@ffa70080";
		qos_sd = "/qos@ffa74000";
		qos_sdioaudio = "/qos@ffa76000";
		qos_hdcp = "/qos@ffa90000";
		qos_iep = "/qos@ffa98000";
		qos_isp0_m0 = "/qos@ffaa0000";
		qos_isp0_m1 = "/qos@ffaa0080";
		qos_isp1_m0 = "/qos@ffaa8000";
		qos_isp1_m1 = "/qos@ffaa8080";
		qos_rga_r = "/qos@ffab0000";
		qos_rga_w = "/qos@ffab0080";
		qos_video_m0 = "/qos@ffab8000";
		qos_video_m1_r = "/qos@ffac0000";
		qos_video_m1_w = "/qos@ffac0080";
		qos_vop_big_r = "/qos@ffac8000";
		qos_vop_big_w = "/qos@ffac8080";
		qos_vop_little = "/qos@ffad0000";
		qos_perihp = "/qos@ffad8080";
		qos_gpu = "/qos@ffae0000";
		pmu = "/power-management@ff310000";
		power = "/power-management@ff310000/power-controller";
		pmugrf = "/syscon@ff320000";
		pmu_io_domains = "/syscon@ff320000/io-domains";
		pmu_pvtm = "/syscon@ff320000/pmu-pvtm";
		spi3 = "/spi@ff350000";
		uart4 = "/serial@ff370000";
		i2c4 = "/i2c@ff3d0000";
		fusb0 = "/i2c@ff3d0000/fusb30x@22";
		gt1x = "/i2c@ff3d0000/gt1x@14";
		i2c8 = "/i2c@ff3e0000";
		pcie_phy = "/pcie-phy";
		pcie0 = "/pcie@f8000000";
		pcie0_intc = "/pcie@f8000000/interrupt-controller";
		pwm0 = "/pwm@ff420000";
		pwm1 = "/pwm@ff420010";
		pwm2 = "/pwm@ff420020";
		pwm3 = "/pwm@ff420030";
		dfi = "/dfi@ff630000";
		dmc = "/dmc";
		vpu = "/vpu_service@ff650000";
		vpu_mmu = "/iommu@ff650800";
		rkvdec = "/rkvdec@ff660000";
		vdec_mmu = "/iommu@ff660480";
		iep = "/iep@ff670000";
		iep_mmu = "/iommu@ff670800";
		rga = "/rga@ff680000";
		efuse0 = "/efuse@ff690000";
		efuse_id = "/efuse@ff690000/id@7";
		cpub_leakage = "/efuse@ff690000/cpub-leakage@17";
		gpu_leakage = "/efuse@ff690000/gpu-leakage@18";
		center_leakage = "/efuse@ff690000/center-leakage@19";
		cpul_leakage = "/efuse@ff690000/cpul-leakage@1a";
		logic_leakage = "/efuse@ff690000/logic-leakage@1b";
		wafer_info = "/efuse@ff690000/wafer-info@1c";
		pmucru = "/pmu-clock-controller@ff750000";
		cru = "/clock-controller@ff760000";
		grf = "/syscon@ff770000";
		io_domains = "/syscon@ff770000/io-domains";
		emmc_phy = "/syscon@ff770000/phy@f780";
		u2phy0 = "/syscon@ff770000/usb2-phy@e450";
		u2phy0_otg = "/syscon@ff770000/usb2-phy@e450/otg-port";
		u2phy0_host = "/syscon@ff770000/usb2-phy@e450/host-port";
		u2phy1 = "/syscon@ff770000/usb2-phy@e460";
		u2phy1_otg = "/syscon@ff770000/usb2-phy@e460/otg-port";
		u2phy1_host = "/syscon@ff770000/usb2-phy@e460/host-port";
		mipi_dphy_rx0 = "/syscon@ff770000/mipi-dphy-rx0";
		pvtm = "/syscon@ff770000/pvtm";
		tcphy0 = "/phy@ff7c0000";
		tcphy0_dp = "/phy@ff7c0000/dp-port";
		tcphy0_usb3 = "/phy@ff7c0000/usb3-port";
		tcphy1 = "/phy@ff800000";
		tcphy1_dp = "/phy@ff800000/dp-port";
		tcphy1_usb3 = "/phy@ff800000/usb3-port";
		rktimer = "/rktimer@ff850000";
		spdif = "/spdif@ff870000";
		i2s0 = "/i2s@ff880000";
		i2s1 = "/i2s@ff890000";
		i2s2 = "/i2s@ff8a0000";
		gpu = "/gpu@ff9a0000";
		gpu_power_model = "/gpu@ff9a0000/power_model";
		vopl = "/vop@ff8f0000";
		vopl_out = "/vop@ff8f0000/port";
		vopl_out_dsi = "/vop@ff8f0000/port/endpoint@0";
		vopl_out_edp = "/vop@ff8f0000/port/endpoint@1";
		vopl_out_hdmi = "/vop@ff8f0000/port/endpoint@2";
		vopl_out_dp = "/vop@ff8f0000/port/endpoint@3";
		vopl_out_dsi1 = "/vop@ff8f0000/port/endpoint@4";
		vop1_pwm = "/voppwm@ff8f01a0";
		vopl_mmu = "/iommu@ff8f3f00";
		vopb = "/vop@ff900000";
		vopb_out = "/vop@ff900000/port";
		vopb_out_edp = "/vop@ff900000/port/endpoint@0";
		vopb_out_dsi = "/vop@ff900000/port/endpoint@1";
		vopb_out_hdmi = "/vop@ff900000/port/endpoint@2";
		vopb_out_dp = "/vop@ff900000/port/endpoint@3";
		vopb_out_dsi1 = "/vop@ff900000/port/endpoint@4";
		vop0_pwm = "/voppwm@ff9001a0";
		vopb_mmu = "/iommu@ff903f00";
		rkisp1_0 = "/rkisp1@ff910000";
		isp0_mmu = "/iommu@ff914000";
		rkisp1_1 = "/rkisp1@ff920000";
		isp1_mmu = "/iommu@ff924000";
		hdmi = "/hdmi@ff940000";
		hdmi_in = "/hdmi@ff940000/ports/port";
		hdmi_in_vopb = "/hdmi@ff940000/ports/port/endpoint@0";
		hdmi_in_vopl = "/hdmi@ff940000/ports/port/endpoint@1";
		dsi = "/dsi@ff960000";
		dsi_in_vopb = "/dsi@ff960000/ports/port/endpoint@0";
		dsi_in_vopl = "/dsi@ff960000/ports/port/endpoint@1";
		timing0 = "/dsi@ff960000/panel@0/display-timings/timing0";
		dsi1 = "/dsi@ff968000";
		dsi1_in_vopb = "/dsi@ff968000/ports/port/endpoint@0";
		dsi1_in_vopl = "/dsi@ff968000/ports/port/endpoint@1";
		mipi_dphy_tx1rx1 = "/mipi-dphy-tx1rx1@0xff968000";
		edp = "/edp@ff970000";
		edp_in = "/edp@ff970000/ports/port@0";
		edp_in_vopb = "/edp@ff970000/ports/port@0/endpoint@0";
		edp_in_vopl = "/edp@ff970000/ports/port@0/endpoint@1";
		hdmi_hdcp2 = "/hdmi-hdcp2@ff988000";
		display_subsystem = "/display-subsystem";
		route_hdmi = "/display-subsystem/route/route-hdmi";
		route_dsi = "/display-subsystem/route/route-dsi";
		route_dsi1 = "/display-subsystem/route/route-dsi1";
		route_edp = "/display-subsystem/route/route-edp";
		nocp_cci_msch0 = "/nocp-cci-msch0@ffa86000";
		nocp_gpu_msch0 = "/nocp-gpu-msch0@ffa86400";
		nocp_hp_msch0 = "/nocp-hp-msch0@ffa86800";
		nocp_lp_msch0 = "/nocp-lp-msch0@ffa86c00";
		nocp_video_msch0 = "/nocp-video-msch0@ffa87000";
		nocp_vio0_msch0 = "/nocp-vio0-msch0@ffa87400";
		nocp_vio1_msch0 = "/nocp-vio1-msch0@ffa87800";
		nocp_cci_msch1 = "/nocp-cci-msch1@ffa8e000";
		nocp_gpu_msch1 = "/nocp-gpu-msch1@ffa8e400";
		nocp_hp_msch1 = "/nocp-hp-msch1@ffa8e800";
		nocp_lp_msch1 = "/nocp-lp-msch1@ffa8ec00";
		nocp_video_msch1 = "/nocp-video-msch1@ffa8f000";
		nocp_vio0_msch1 = "/nocp-vio0-msch1@ffa8f400";
		nocp_vio1_msch1 = "/nocp-vio1-msch1@ffa8f800";
		pinctrl = "/pinctrl";
		gpio0 = "/pinctrl/gpio0@ff720000";
		gpio1 = "/pinctrl/gpio1@ff730000";
		gpio2 = "/pinctrl/gpio2@ff780000";
		gpio3 = "/pinctrl/gpio3@ff788000";
		gpio4 = "/pinctrl/gpio4@ff790000";
		pcfg_pull_up = "/pinctrl/pcfg-pull-up";
		pcfg_pull_down = "/pinctrl/pcfg-pull-down";
		pcfg_pull_none = "/pinctrl/pcfg-pull-none";
		pcfg_pull_up_20ma = "/pinctrl/pcfg-pull-up-20ma";
		pcfg_pull_none_20ma = "/pinctrl/pcfg-pull-none-20ma";
		pcfg_pull_none_18ma = "/pinctrl/pcfg-pull-none-18ma";
		pcfg_pull_none_12ma = "/pinctrl/pcfg-pull-none-12ma";
		pcfg_pull_up_8ma = "/pinctrl/pcfg-pull-up-8ma";
		pcfg_pull_down_4ma = "/pinctrl/pcfg-pull-down-4ma";
		pcfg_pull_up_2ma = "/pinctrl/pcfg-pull-up-2ma";
		pcfg_pull_down_12ma = "/pinctrl/pcfg-pull-down-12ma";
		pcfg_pull_none_13ma = "/pinctrl/pcfg-pull-none-13ma";
		pcfg_output_high = "/pinctrl/pcfg-output-high";
		pcfg_output_low = "/pinctrl/pcfg-output-low";
		pcfg_input = "/pinctrl/pcfg-input";
		emmc_pwr = "/pinctrl/emmc/emmc-pwr";
		rgmii_pins = "/pinctrl/gmac/rgmii-pins";
		rmii_pins = "/pinctrl/gmac/rmii-pins";
		i2c0_xfer = "/pinctrl/i2c0/i2c0-xfer";
		i2c1_xfer = "/pinctrl/i2c1/i2c1-xfer";
		i2c2_xfer = "/pinctrl/i2c2/i2c2-xfer";
		i2c3_xfer = "/pinctrl/i2c3/i2c3-xfer";
		i2c3_gpio = "/pinctrl/i2c3/i2c3_gpio";
		i2c4_xfer = "/pinctrl/i2c4/i2c4-xfer";
		i2c5_xfer = "/pinctrl/i2c5/i2c5-xfer";
		i2c6_xfer = "/pinctrl/i2c6/i2c6-xfer";
		i2c7_xfer = "/pinctrl/i2c7/i2c7-xfer";
		i2c8_xfer = "/pinctrl/i2c8/i2c8-xfer";
		i2s0_8ch_bus = "/pinctrl/i2s0/i2s0-8ch-bus";
		i2s_8ch_mclk = "/pinctrl/i2s0/i2s-8ch-mclk";
		i2s1_2ch_bus = "/pinctrl/i2s1/i2s1-2ch-bus";
		sdio0_bus1 = "/pinctrl/sdio0/sdio0-bus1";
		sdio0_bus4 = "/pinctrl/sdio0/sdio0-bus4";
		sdio0_cmd = "/pinctrl/sdio0/sdio0-cmd";
		sdio0_clk = "/pinctrl/sdio0/sdio0-clk";
		sdio0_cd = "/pinctrl/sdio0/sdio0-cd";
		sdio0_pwr = "/pinctrl/sdio0/sdio0-pwr";
		sdio0_bkpwr = "/pinctrl/sdio0/sdio0-bkpwr";
		sdio0_wp = "/pinctrl/sdio0/sdio0-wp";
		sdio0_int = "/pinctrl/sdio0/sdio0-int";
		sdmmc_bus1 = "/pinctrl/sdmmc/sdmmc-bus1";
		sdmmc_bus4 = "/pinctrl/sdmmc/sdmmc-bus4";
		sdmmc_clk = "/pinctrl/sdmmc/sdmmc-clk";
		sdmmc_cmd = "/pinctrl/sdmmc/sdmmc-cmd";
		sdmmc_cd = "/pinctrl/sdmmc/sdmcc-cd";
		sdmmc_wp = "/pinctrl/sdmmc/sdmmc-wp";
		spdif_bus = "/pinctrl/spdif/spdif-bus";
		spdif_bus_1 = "/pinctrl/spdif/spdif-bus-1";
		spi0_clk = "/pinctrl/spi0/spi0-clk";
		spi0_cs0 = "/pinctrl/spi0/spi0-cs0";
		spi0_cs1 = "/pinctrl/spi0/spi0-cs1";
		spi0_tx = "/pinctrl/spi0/spi0-tx";
		spi0_rx = "/pinctrl/spi0/spi0-rx";
		spi1_clk = "/pinctrl/spi1/spi1-clk";
		spi1_cs0 = "/pinctrl/spi1/spi1-cs0";
		spi1_rx = "/pinctrl/spi1/spi1-rx";
		spi1_tx = "/pinctrl/spi1/spi1-tx";
		spi2_clk = "/pinctrl/spi2/spi2-clk";
		spi2_cs0 = "/pinctrl/spi2/spi2-cs0";
		spi2_rx = "/pinctrl/spi2/spi2-rx";
		spi2_tx = "/pinctrl/spi2/spi2-tx";
		spi3_clk = "/pinctrl/spi3/spi3-clk";
		spi3_cs0 = "/pinctrl/spi3/spi3-cs0";
		spi3_rx = "/pinctrl/spi3/spi3-rx";
		spi3_tx = "/pinctrl/spi3/spi3-tx";
		spi4_clk = "/pinctrl/spi4/spi4-clk";
		spi4_cs0 = "/pinctrl/spi4/spi4-cs0";
		spi4_rx = "/pinctrl/spi4/spi4-rx";
		spi4_tx = "/pinctrl/spi4/spi4-tx";
		spi5_clk = "/pinctrl/spi5/spi5-clk";
		spi5_cs0 = "/pinctrl/spi5/spi5-cs0";
		spi5_rx = "/pinctrl/spi5/spi5-rx";
		spi5_tx = "/pinctrl/spi5/spi5-tx";
		otp_gpio = "/pinctrl/tsadc/otp-gpio";
		otp_out = "/pinctrl/tsadc/otp-out";
		uart0_xfer = "/pinctrl/uart0/uart0-xfer";
		uart0_cts = "/pinctrl/uart0/uart0-cts";
		uart0_rts = "/pinctrl/uart0/uart0-rts";
		uart1_xfer = "/pinctrl/uart1/uart1-xfer";
		uart2a_xfer = "/pinctrl/uart2a/uart2a-xfer";
		uart2b_xfer = "/pinctrl/uart2b/uart2b-xfer";
		uart2c_xfer = "/pinctrl/uart2c/uart2c-xfer";
		uart3_xfer = "/pinctrl/uart3/uart3-xfer";
		uart3_cts = "/pinctrl/uart3/uart3-cts";
		uart3_rts = "/pinctrl/uart3/uart3-rts";
		uart4_xfer = "/pinctrl/uart4/uart4-xfer";
		uarthdcp_xfer = "/pinctrl/uarthdcp/uarthdcp-xfer";
		pwm0_pin = "/pinctrl/pwm0/pwm0-pin";
		pwm0_pin_pull_down = "/pinctrl/pwm0/pwm0-pin-pull-down";
		vop0_pwm_pin = "/pinctrl/pwm0/vop0-pwm-pin";
		vop1_pwm_pin = "/pinctrl/pwm0/vop1-pwm-pin";
		pwm1_pin = "/pinctrl/pwm1/pwm1-pin";
		pwm1_pin_pull_down = "/pinctrl/pwm1/pwm1-pin-pull-down";
		pwm2_pin = "/pinctrl/pwm2/pwm2-pin";
		pwm2_pin_pull_down = "/pinctrl/pwm2/pwm2-pin-pull-down";
		pwm3a_pin = "/pinctrl/pwm3a/pwm3a-pin";
		pwm3a_pin_pull_down = "/pinctrl/pwm3a/pwm3a-pin-pull-down";
		pwm3b_pin = "/pinctrl/pwm3b/pwm3b-pin";
		pwm3b_pin_pull_down = "/pinctrl/pwm3b/pwm3b-pin-pull-down";
		edp_hpd = "/pinctrl/edp/edp-hpd";
		hdmi_i2c_xfer = "/pinctrl/hdmi/hdmi-i2c-xfer";
		hdmi_cec = "/pinctrl/hdmi/hdmi-cec";
		pcie_clkreqn = "/pinctrl/pcie/pci-clkreqn";
		pcie_clkreqnb = "/pinctrl/pcie/pci-clkreqnb";
		pcie_clkreqn_cpm = "/pinctrl/pcie/pci-clkreqn-cpm";
		pcie_clkreqnb_cpm = "/pinctrl/pcie/pci-clkreqnb-cpm";
		pmic_int_l = "/pinctrl/pmic/pmic-int-l";
		vsel1_gpio = "/pinctrl/pmic/vsel1-gpio";
		vsel2_gpio = "/pinctrl/pmic/vsel2-gpio";
		host_vbus_drv_usb3 = "/pinctrl/usb/host-vbus-drv-usb3";
		host_vbus_drv_usb2 = "/pinctrl/usb/host-vbus-drv-usb2";
		vcc_sd_h = "/pinctrl/vcc_sd/vcc-sd-h";
		fusb0_int = "/pinctrl/fusb30x/fusb0-int";
		wifi_enable_h = "/pinctrl/sdio-pwrseq/wifi-enable-h";
		uart0_gpios = "/pinctrl/wireless-bluetooth/uart0-gpios";
		hp_det = "/pinctrl/headphone/hp-det";
		leds_gpio = "/pinctrl/gpio-leds/leds-gpio";
		cif_clkout = "/pinctrl/isp/cif-clkout";
		isp_dvp_d0d7 = "/pinctrl/isp/isp-dvp-d0d7";
		isp_shutter = "/pinctrl/isp/isp-shutter";
		isp_flash_trigger = "/pinctrl/isp/isp-flash-trigger";
		isp_prelight = "/pinctrl/isp/isp-prelight";
		isp_flash_trigger_as_gpio = "/pinctrl/isp/isp_flash_trigger_as_gpio";
		rockchip_suspend = "/rockchip-suspend";
		RK3399_CPU_COST_0 = "/energy-costs/rk3399-core-cost0";
		RK3399_CPU_COST_1 = "/energy-costs/rk3399-core-cost1";
		RK3399_CLUSTER_COST_0 = "/energy-costs/rk3399-cluster-cost0";
		RK3399_CLUSTER_COST_1 = "/energy-costs/rk3399-cluster-cost1";
		cluster0_opp = "/opp-table0";
		cluster1_opp = "/opp-table1";
		gpu_opp_table = "/opp-table2";
		dmc_opp_table = "/opp-table3";
		vcc5v0_sys = "/vcc5v0-sys";
		vcc3v3_sys = "/vcc3v3-sys";
		vcc5v0_host_usb3 = "/vcc5v0-host-usb3-regulator";
		vcc5v0_host_usb2 = "/vcc5v0-host-usb2-regulator";
		vcc_sd = "/vcc-sd";
		vcc_phy = "/vcc-phy-regulator";
		vdd_log = "/vdd-log";
		clkin_gmac = "/external-gmac-clock";
		sdio_pwrseq = "/sdio-pwrseq";
		backlight = "/backlight";
		leds = "/gpio-leds";
		rk_headset = "/rk-headset";
		rockchip_msm261s4030h0_codec = "/rockchip-msm261s4030h0-codec";
		rockchip_msm261s4030h0 = "/rockchip-msm261s4030h0";
		ramoops_mem = "/ramoops_mem";
		fiq_debugger = "/fiq-debugger";
		drm_logo = "/reserved-memory/drm-logo@00000000";
		secure_memory = "/reserved-memory/secure-memory@20000000";
		stb_devinfo = "/reserved-memory/stb-devinfo@00000000";
		rk_key = "/rockchip-key";
		isp0 = "/isp@ff910000";
		isp1 = "/isp@ff920000";
		hdmi_dp_sound = "/hdmi-dp-sound";
		extbrd = "/extbrd";
	};
};
